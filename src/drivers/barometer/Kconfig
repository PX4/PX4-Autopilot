## src/drivers/barometer/Kconfig
```kconfig
menu "barometer"
    menuconfig COMMON_BAROMETERS
        bool "Common barometers"
        default n
        imply DRIVERS_BAROMETER_BMP280
        imply DRIVERS_BAROMETER_BMP388
        imply DRIVERS_BAROMETER_BMP581
        imply DRIVERS_BAROMETER_DPS310
        imply DRIVERS_BAROMETER_LPS22HB
        imply DRIVERS_BAROMETER_LPS33HW
        imply DRIVERS_BAROMETER_MS5611
        imply DRIVERS_BAROMETER_MAIERTEK_MPC2520
        imply DRIVERS_BAROMETER_GOERTEK_SPL06
        imply DRIVERS_BAROMETER_GOERTEK_SPA06
        imply DRIVERS_BAROMETER_INVENSENSE_ICP101XX
        imply DRIVERS_BAROMETER_INVENSENSE_ICP201XX
        ---help---
            Enable default set of barometer drivers
    rsource "*/Kconfig"
endmenu #barometer
```

## src/drivers/differential_pressure/Kconfig
```kconfig
menu "Differential pressure"
    menuconfig COMMON_DIFFERENTIAL_PRESSURE
        bool "Common differential pressure module's"
        default n
        imply DRIVERS_DIFFERENTIAL_PRESSURE_MS4525DO
        imply DRIVERS_DIFFERENTIAL_PRESSURE_MS5525DSO
        imply DRIVERS_DIFFERENTIAL_PRESSURE_SDP3X
        ---help---
            Enable default set of differential pressure drivers
    rsource "*/Kconfig"
endmenu
```

## src/drivers/distance_sensor/Kconfig
```kconfig
menu "Distance sensors"
    menuconfig COMMON_DISTANCE_SENSOR
        bool "Common distance sensor's"
        default n
        imply DRIVERS_DISTANCE_SENSOR_LIGHTWARE_LASER_I2C
        imply DRIVERS_DISTANCE_SENSOR_LIGHTWARE_LASER_SERIAL
        imply DRIVERS_DISTANCE_SENSOR_LL40LS
        imply DRIVERS_DISTANCE_SENSOR_TF02PRO
        imply DRIVERS_DISTANCE_SENSOR_TFMINI
        imply DRIVERS_DISTANCE_SENSOR_ULANDING_RADAR
        imply DRIVERS_DISTANCE_SENSOR_VL53L0X
        imply DRIVERS_DISTANCE_SENSOR_VL53L1X
        ---help---
            Enable default set of distance sensor drivers

    rsource "*/Kconfig"
endmenu
```

## src/drivers/imu/Kconfig
```kconfig
menu "IMU"
    menuconfig COMMON_IMU
        bool "Common IMU's"
        default n
        select DRIVERS_IMU_ANALOG_DEVICES_ADIS16477 if !DRIVERS_IMU_ANALOG_DEVICES_ADISBURST
        select DRIVERS_IMU_ANALOG_DEVICES_ADIS16497
        select DRIVERS_IMU_ANALOG_DEVICES_ADIS16448
        select DRIVERS_IMU_ANALOG_DEVICES_ADIS16470 if !DRIVERS_IMU_ANALOG_DEVICES_ADISBURST
        select DRIVERS_IMU_ANALOG_DEVICES_ADIS16607
        select DRIVERS_IMU_BOSCH_BMI055 if !DRIVERS_IMU_BOSCH_BMI_HYBRID
        select DRIVERS_IMU_BOSCH_BMI088 if !DRIVERS_IMU_BOSCH_BMI_HYBRID
        select DRIVERS_IMU_MURATA_SCH16T
        select DRIVERS_IMU_MURATA_ZEROONE_SCH16T
        select DRIVERS_IMU_NXP_FXAS21002C
        select DRIVERS_IMU_NXP_FXOS8701CQ
        select DRIVERS_IMU_INVENSENSE_ICM20602 if !DRIVERS_IMU_INVENSENSE_MPU_DIRECT
        select DRIVERS_IMU_INVENSENSE_ICM20608G if !DRIVERS_IMU_INVENSENSE_MPU_DIRECT
        select DRIVERS_IMU_INVENSENSE_ICM20649 if !DRIVERS_IMU_INVENSENSE_ICM20X
        select DRIVERS_IMU_INVENSENSE_ICM20689 if !DRIVERS_IMU_INVENSENSE_MPU_DIRECT
        #select DRIVERS_IMU_INVENSENSE_ICM20948
        select DRIVERS_IMU_INVENSENSE_ICM40609D if !DRIVERS_IMU_INVENSENSE_ICM42X
        select DRIVERS_IMU_INVENSENSE_ICM42605 if !DRIVERS_IMU_INVENSENSE_ICM42X
        select DRIVERS_IMU_INVENSENSE_ICM42688P if !DRIVERS_IMU_INVENSENSE_ICM42X
        select DRIVERS_IMU_INVENSENSE_MPU6000 if !DRIVERS_IMU_INVENSENSE_MPU_DIRECT
        select DRIVERS_IMU_INVENSENSE_MPU6500 if !DRIVERS_IMU_INVENSENSE_MPU_DIRECT
        select DRIVERS_IMU_INVENSENSE_MPU9250
        select DRIVERS_IMU_ST_L3GD20
        select DRIVERS_IMU_ST_LSM303D
        select DRIVERS_IMU_ST_LSM9DS1
        ---help---
            Enable default set of IMU drivers
    rsource "*/Kconfig"
endmenu
```

## src/drivers/imu/analog_devices/adis16470/Kconfig
```kconfig
menuconfig DRIVERS_IMU_ANALOG_DEVICES_ADIS16470
	bool "ADIS16470"
	default n
	depends on !DRIVERS_IMU_ANALOG_DEVICES_ADISBURST
	---help---
		Enable support for analog_devices ADIS16470
```

## src/drivers/imu/analog_devices/adis16477/Kconfig
```kconfig
menuconfig DRIVERS_IMU_ANALOG_DEVICES_ADIS16477
	bool "adis16477"
	default n
	depends on !DRIVERS_IMU_ANALOG_DEVICES_ADISBURST
	---help---
		Enable support for adis16477
```

## src/drivers/imu/analog_devices/adis16507/Kconfig
```kconfig
menuconfig DRIVERS_IMU_ANALOG_DEVICES_ADIS16507
	bool "ADIS16507"
	default n
	depends on !DRIVERS_IMU_ANALOG_DEVICES_ADISBURST
	---help---
		Enable support for analog_devices ADIS16507
```

## src/drivers/imu/analog_devices/adisburst/Kconfig
```kconfig
menuconfig DRIVERS_IMU_ANALOG_DEVICES_ADISBURST
	bool "ADI single-sample SPI burst family"
	default n
	help
	  Shared SPI burst acquisition for ADIS16470, ADIS16477, ADIS1650x and ADIS1657x.
	  Start requires an exact -T model; stop and status accept optional -T and -B filters.
```

## src/drivers/imu/bosch/bmi055/Kconfig
```kconfig
menuconfig DRIVERS_IMU_BOSCH_BMI055
	bool "bosch bmi055"
	default n
	depends on !DRIVERS_IMU_BOSCH_BMI_HYBRID
	---help---
		Enable support for bosch bmi055
```

## src/drivers/imu/bosch/bmi085/Kconfig
```kconfig
menuconfig DRIVERS_IMU_BOSCH_BMI085
	bool "bosch bmi085"
	default n
	depends on !DRIVERS_IMU_BOSCH_BMI_HYBRID
	---help---
		Enable support for bosch bmi085
```

## src/drivers/imu/bosch/bmi270/Kconfig
```kconfig
menuconfig DRIVERS_IMU_BOSCH_BMI270
	bool "bosch bmi270"
	default n
	depends on !DRIVERS_IMU_BOSCH_BMI_HYBRID
	---help---
		Enable support for bosch bmi270
```

## src/drivers/imu/bosch/bmi_hybrid/Kconfig
```kconfig
menuconfig DRIVERS_IMU_BOSCH_BMI_HYBRID
	bool "Bosch BMI055/BMI085/BMI088/BMI270 SPI family"
	default n
	help
	  Fixed and tagged FIFO acquisition. Split devices retain independent
	  accel/gyro registrations; BMI270 uses one integrated IMU registration.

if DRIVERS_IMU_BOSCH_BMI_HYBRID

config BMI_HYBRID_BMI270
	bool "BMI270"
	default n

choice
	prompt "BMI085/BMI088 accelerometer interrupt pin"
	default BMI_HYBRID_ACCELEROMETER_INT1

config BMI_HYBRID_ACCELEROMETER_INT_NONE
	bool "No interrupts"

config BMI_HYBRID_ACCELEROMETER_INT1
	bool "INT1"

config BMI_HYBRID_ACCELEROMETER_INT2
	bool "INT2"

endchoice

choice
	prompt "BMI085/BMI088 gyroscope interrupt pin"
	default BMI_HYBRID_GYROSCOPE_INT3

config BMI_HYBRID_GYROSCOPE_INT_NONE
	bool "No interrupts"

config BMI_HYBRID_GYROSCOPE_INT3
	bool "INT3"

config BMI_HYBRID_GYROSCOPE_INT4
	bool "INT4"

endchoice

endif # DRIVERS_IMU_BOSCH_BMI_HYBRID
```

## src/drivers/imu/invensense/iam20680hp/Kconfig
```kconfig
menuconfig DRIVERS_IMU_INVENSENSE_IAM20680HP
	bool "iam20680hp"
	default n
	depends on !DRIVERS_IMU_INVENSENSE_MPU_DIRECT
	---help---
		Enable support for iam20680hp
```

## src/drivers/imu/invensense/icm20602/Kconfig
```kconfig
menuconfig DRIVERS_IMU_INVENSENSE_ICM20602
	bool "icm20602"
	default n
	depends on !DRIVERS_IMU_INVENSENSE_MPU_DIRECT
	---help---
		Enable support for icm20602
```

## src/drivers/imu/invensense/icm20608g/Kconfig
```kconfig
menuconfig DRIVERS_IMU_INVENSENSE_ICM20608G
	bool "icm20608g"
	default n
	depends on !DRIVERS_IMU_INVENSENSE_MPU_DIRECT
	---help---
		Enable support for icm20608g
```

## src/drivers/imu/invensense/icm20649/Kconfig
```kconfig
menuconfig DRIVERS_IMU_INVENSENSE_ICM20649
	bool "icm20649"
	default n
	depends on !DRIVERS_IMU_INVENSENSE_ICM20X
	---help---
		Enable support for icm20649
```

## src/drivers/imu/invensense/icm20689/Kconfig
```kconfig
menuconfig DRIVERS_IMU_INVENSENSE_ICM20689
	bool "icm20689"
	default n
	depends on !DRIVERS_IMU_INVENSENSE_MPU_DIRECT
	---help---
		Enable support for icm20689
```

## src/drivers/imu/invensense/icm20x/Kconfig
```kconfig
menuconfig DRIVERS_IMU_INVENSENSE_ICM20X
	bool "TDK ICM20x banked SPI FIFO family"
	default n
	help
	  Shared SPI six-axis implementation for ICM20649 and ICM20948.
	  Does not provide AK09916, auxiliary I2C master or passthrough functionality.
```

## src/drivers/imu/invensense/icm40609d/Kconfig
```kconfig
menuconfig DRIVERS_IMU_INVENSENSE_ICM40609D
	bool "icm40609d"
	default n
	depends on !DRIVERS_IMU_INVENSENSE_ICM42X
	---help---
		Enable support for icm40609d
```

## src/drivers/imu/invensense/icm42605/Kconfig
```kconfig
menuconfig DRIVERS_IMU_INVENSENSE_ICM42605
	bool "icm42605"
	default n
	depends on !DRIVERS_IMU_INVENSENSE_ICM42X
	---help---
		Enable support for icm42605
```

## src/drivers/imu/invensense/icm42688p/Kconfig
```kconfig
menuconfig DRIVERS_IMU_INVENSENSE_ICM42688P
	bool "icm42688p"
	default n
	depends on !DRIVERS_IMU_INVENSENSE_ICM42X
	---help---
		Enable support for icm42688p
```

## src/drivers/imu/invensense/icm42x/Kconfig
```kconfig
menuconfig DRIVERS_IMU_INVENSENSE_ICM42X
	bool "TDK ICM42x SPI IMU family"
	default n
	help
		Enable support for the banked TDK ICM-40609-D, ICM-42605,
		ICM-42688-P, ICM-42686-P, IIM-42652 and IIM-42653 SPI IMU family.
```

## src/drivers/imu/invensense/icm45686/Kconfig
```kconfig
menuconfig DRIVERS_IMU_INVENSENSE_ICM45686
	bool "icm45686"
	default n
	depends on !DRIVERS_IMU_INVENSENSE_ICM45X
	---help---
		Enable support for icm45686
```

## src/drivers/imu/invensense/icm45x/Kconfig
```kconfig
menuconfig DRIVERS_IMU_INVENSENSE_ICM45X
	bool "TDK ICM45x/ICM56x SPI IMU family"
	default n
	help
		Enable support for the Gen-4 IREG little-endian FIFO TDK ICM-45686
		and ICM-56686 SPI IMU family.
```

## src/drivers/imu/invensense/iim42652/Kconfig
```kconfig
menuconfig DRIVERS_IMU_INVENSENSE_IIM42652
	bool "iim42652"
	default n
	depends on !DRIVERS_IMU_INVENSENSE_ICM42X
	---help---
		Enable support for iim42652
```
