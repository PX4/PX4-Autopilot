## src/drivers/manual_control_input_udp/Kconfig
```kconfig
menuconfig DRIVERS_MANUAL_CONTROL_INPUT_UDP
	bool "manual_control_input_udp"
	default n
	---help---
		Enable manual control input via UDP
```

## src/drivers/mc_in_udp/Kconfig
```kconfig
menuconfig DRIVERS_MC_IN_UDP
	bool "mc_in_udp"
	default n
	---help---
		Enable manual control input via UDP
```

## src/drivers/optical_flow/Kconfig
```kconfig
menu "Optical flow"
    menuconfig COMMON_OPTICAL_FLOW
        bool "Common Optical flow"
        default n
        select DRIVERS_OPTICAL_FLOW_PAA3905
        select DRIVERS_OPTICAL_FLOW_PAW3902
        select DRIVERS_OPTICAL_FLOW_PMW3901
        select DRIVERS_OPTICAL_FLOW_PX4FLOW
        select DRIVERS_OPTICAL_FLOW_THONEFLOW
        ---help---
            Enable default set of magnetometer drivers
    rsource "*/Kconfig"
endmenu
```

## src/drivers/optical_flow/paa3905/Kconfig
```kconfig
menuconfig DRIVERS_OPTICAL_FLOW_PAA3905
	bool "paa3905"
	default n
	---help---
		Enable support for PixArt paa3905
```

## src/drivers/optical_flow/paw3902/Kconfig
```kconfig
menuconfig DRIVERS_OPTICAL_FLOW_PAW3902
	bool "paw3902"
	default n
	---help---
		Enable support for PixArt paw3902
```

## src/drivers/osd/Kconfig
```kconfig
menu "OSD"
    menuconfig COMMON_OSD
        bool "Common OSD drivers"
        default n
        select DRIVERS_OSD_ATXXXX
        select DRIVERS_OSD_MSP_OSD
        ---help---
            Enable default set of OSD drivers
    rsource "*/Kconfig"
endmenu
```

## src/drivers/osd/msp_dp/Kconfig
```kconfig
menuconfig DRIVERS_OSD_MSP_DP
	bool "msp_dp"
	default n
	---help---
		Enable support for msp_dp osd

menuconfig USER_MSP_DP
	bool "msp_dp osd running as userspace module"
	default y
	depends on BOARD_PROTECTED && DRIVERS_OSD_MSP_DP
	---help---
		Put msp_dp osd in userspace memory
```

## src/drivers/osd/msp_osd/Kconfig
```kconfig
menuconfig DRIVERS_OSD_MSP_OSD
	bool "msp_osd"
	default n
	---help---
		Enable support for msp_osd

menuconfig USER_MSP_OSD
	bool "msp_osd running as userspace module"
	default y
	depends on BOARD_PROTECTED && DRIVERS_OSD_MSP_OSD
	---help---
		Put msp_osd in userspace memory
```

## src/drivers/payload_board/Kconfig
```kconfig
menuconfig DRIVERS_PAYLOAD_BOARD
	bool "payload_board"
	default n
	---help---
		Enable support for payload board MSP feedback
```

## src/drivers/pca9685_pwm_out/Kconfig
```kconfig
menuconfig DRIVERS_PCA9685_PWM_OUT
	bool "pca9685_pwm_out"
	default n
	---help---
		Enable support for pca9685_pwm_out

if DRIVERS_PCA9685_PWM_OUT
	config PCA9685_USE_EXTERNAL_CRYSTAL
	    bool "Use external crystal for clock reference"
	    default n

    config PCA9685_EXTERNAL_CRYSTAL_FREQ
        int "External crystal frequency"
        depends on PCA9685_USE_EXTERNAL_CRYSTAL
        default 25000000

    config PCA9685_INTERNAL_CRYSTAL_FREQ
        int "Corrected frequency of internal oscillator"
        depends on !PCA9685_USE_EXTERNAL_CRYSTAL
        default 26075000
endif
```

## src/drivers/pca9685_ucan/Kconfig
```kconfig
menuconfig DRIVERS_PCA9685_UCAN
	bool "pca9685_ucan"
	default n
	---help---
		Enable support for pca9685_ucan
```

## src/drivers/pfsoc_crypto/Kconfig
```kconfig
menuconfig DRIVERS_PFSOC_CRYPTO
	bool "pfsoc_crypto"
	depends on BOARD_CRYPTO
	default n
	---help---
		Enable support for pfsoc_crypto
```

## src/drivers/power_monitor/ina220/Kconfig
```kconfig
menuconfig DRIVERS_POWER_MONITOR_INA220
	bool "ina220"
	default n
	---help---
		Enable support for ina220
```

## src/drivers/power_monitor/ina228/Kconfig
```kconfig
menuconfig DRIVERS_POWER_MONITOR_INA228
	bool "ina228"
	default n
	---help---
		Enable support for ina228
```

## src/drivers/power_monitor/ina231/Kconfig
```kconfig
menuconfig DRIVERS_POWER_MONITOR_INA231
	bool "ina231"
	default n
	---help---
		Enable support for ina231
```

## src/drivers/power_monitor/ina238/Kconfig
```kconfig
menuconfig DRIVERS_POWER_MONITOR_INA238
	bool "ina238"
	default n
	---help---
		Enable support for ina238
```

## src/drivers/power_monitor/pm_selector_auterion/Kconfig
```kconfig
menuconfig DRIVERS_POWER_MONITOR_PM_SELECTOR_AUTERION
	bool "pm_selector_auterion"
	default n
	---help---
		Enable support for pm_selector_auterion
```

## src/drivers/pps_capture/Kconfig
```kconfig
menuconfig DRIVERS_PPS_CAPTURE
	bool "pps_capture"
	default n
	---help---
		Enable support for pps_capture
```

## src/drivers/pwm_esc/Kconfig
```kconfig
menuconfig DRIVERS_PWM_ESC
	bool "pwm_esc"
	default n
	---help---
		Enable support for pwm_esc

menuconfig USER_PWM_ESC
	bool "pwm_esc running as userspace module"
	default y
	depends on BOARD_PROTECTED && DRIVERS_PWM_ESC
	---help---
		Put pwm_esc in userspace memory
```

## src/drivers/px4io/Kconfig
```kconfig
menuconfig DRIVERS_PX4IO
	bool "px4io"
	default n
	depends on PLATFORM_NUTTX
	---help---
		Enable support for px4io
```

## src/drivers/qshell/Kconfig
```kconfig
menu "qshell"
depends on PLATFORM_QURT || PLATFORM_POSIX
rsource "*/Kconfig"
endmenu #qshell
```

## src/drivers/qshell/posix/Kconfig
```kconfig
menuconfig DRIVERS_QSHELL_POSIX
	bool "posix"
	default n
	depends on PLATFORM_POSIX
	---help---
		Enable support for posix
```

## src/drivers/qshell/qurt/Kconfig
```kconfig
menuconfig DRIVERS_QSHELL_QURT
	bool "qurt"
	default n
	depends on PLATFORM_QURT
	---help---
		Enable support for qurt
```

## src/drivers/rainmaker/todd_sensor/Kconfig
```kconfig
menuconfig DRIVERS_RAINMAKER_TODD_SENSOR
	bool "todd_sensor"
	default n
	---help---
		Enable support for Todd Sensor
```
