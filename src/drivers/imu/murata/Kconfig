## src/drivers/imu/murata/sch16t/Kconfig
```kconfig
menuconfig DRIVERS_IMU_MURATA_SCH16T
	bool "SCH16T"
	default n
	---help---
		Enable support for murata SCH16T
```

## src/drivers/imu/murata/sch16t_fifo/Kconfig
```kconfig
menuconfig DRIVERS_IMU_MURATA_SCH16T_FIFO
	bool "SCH16T_FIFO"
	default n
	---help---
		Enable support for murata SCH16T_FIFO
```

## src/drivers/imu/murata/scha63t/Kconfig
```kconfig
menuconfig DRIVERS_IMU_MURATA_SCHA63T
	bool "scha63t"
	default n
	---help---
		Enable support for scha63t
```

## src/drivers/imu/murata/zeroone_sch16t/Kconfig
```kconfig
menuconfig DRIVERS_IMU_MURATA_ZEROONE_SCH16T
	bool "ZEROONE_SCH16T"
	default n
	---help---
		Enable support for murata ZEROONE_SCH16T
```

## src/drivers/imu/st/l3gd20h/Kconfig
```kconfig
menuconfig DRIVERS_IMU_ST_L3GD20H
	bool "l3gd20h"
	default n
	---help---
		Enable support for l3gd20h
```

## src/drivers/imu/st/lsm303d/Kconfig
```kconfig
menuconfig DRIVERS_IMU_ST_LSM303D
	bool "lsm303d"
	default n
	---help---
		Enable support for lsm303d
```

## src/drivers/imu/st/lsm6dsv/Kconfig
```kconfig
menuconfig DRIVERS_IMU_ST_LSM6DSV
	bool "lsm6dsv"
	default n
	---help---
		Enable support for lsm6dsv
```

## src/drivers/imu/st/lsm9ds1/Kconfig
```kconfig
menuconfig DRIVERS_IMU_ST_LSM9DS1
	bool "lsm9ds1"
	default n
	---help---
		Enable support for lsm9ds1
```

## src/drivers/imu_server/Kconfig
```kconfig
menuconfig DRIVERS_IMU_SERVER
	bool "imu_server"
	default n
	---help---
		Enable support for RB5 IMU server
```

## src/drivers/input_capture/Kconfig
```kconfig
menuconfig DRIVERS_INPUT_CAPTURE
	bool "input_capture"
	default n
	---help---
		Enable support for input_capture
```

## src/drivers/ins/Kconfig
```kconfig
menu "Inertial Navigation Systems (INS)"
    menuconfig COMMON_INS
        bool "All INS sensors"
        default n
        select DRIVERS_INS_VECTORNAV
        select DRIVERS_INS_ILABS
        select DRIVERS_INS_MICROSTRAIN
        select DRIVERS_INS_EULERNAV_BAHRS
        select DRIVERS_INS_SBGECOM
        ---help---
            Enable default set of INS sensors
    rsource "*/Kconfig"
endmenu
```

## src/drivers/ins/eulernav_bahrs/Kconfig
```kconfig
menuconfig DRIVERS_INS_EULERNAV_BAHRS
	bool "eulernav_bahrs"
	default n
	---help---
		Enable support for EULER-NAV Baro-Inertial AHRS
```

## src/drivers/ins/ilabs/Kconfig
```kconfig
menuconfig DRIVERS_INS_ILABS
	bool "ilabs"
	default n
	---help---
		Enable support for ilabs
```

## src/drivers/ins/microstrain/Kconfig
```kconfig
menuconfig DRIVERS_INS_MICROSTRAIN
	bool "microstrain"
	default n
	---help---
		Enable support for Microstrain Sensors
```

## src/drivers/ins/sbgecom/Kconfig
```kconfig
menuconfig DRIVERS_INS_SBGECOM
	bool "sbgecom"
	default n
	---help---
		Enable support for sbgecom
```

## src/drivers/ins/vectornav/Kconfig
```kconfig
menuconfig DRIVERS_INS_VECTORNAV
	bool "vectornav"
	default n
	---help---
		Enable support for vectornav
```

## src/drivers/lights/Kconfig
```kconfig
menu "Lights"
    menuconfig COMMON_LIGHT
        bool "Common Light's"
        default n
        select DRIVERS_LIGHTS_RGBLED
        select DRIVERS_LIGHTS_RGBLED_NCP5623C
        select DRIVERS_LIGHTS_RGBLED_IS31FL3195
        select DRIVERS_LIGHTS_RGBLED_LP5562
        ---help---
            Enable default set of light drivers
    rsource "*/Kconfig"
endmenu
```

## src/drivers/lights/apa102/Kconfig
```kconfig
menuconfig DRIVERS_LIGHTS_APA102
	bool "apa102"
	default n
	---help---
		Enable support for apa102
```

## src/drivers/lights/blinkm/Kconfig
```kconfig
menuconfig DRIVERS_LIGHTS_BLINKM
	bool "blinkm"
	default n
	---help---
		Enable support for blinkm
```

## src/drivers/lights/rgbled_apa102/Kconfig
```kconfig
menuconfig DRIVERS_LIGHTS_RGBLED_APA102
	bool "rgbled_apa102"
	default n
	---help---
		Enable support for rgbled_apa102
```

## src/drivers/lights/rgbled_aw2023/Kconfig
```kconfig
menuconfig DRIVERS_LIGHTS_RGBLED_AW2023
	bool "rgbled_aw2013"
	default n
	---help---
		Enable support for rgbled_aw2023
```

## src/drivers/lights/rgbled_is31fl3195/Kconfig
```kconfig
menuconfig DRIVERS_LIGHTS_RGBLED_IS31FL3195
	bool "rgbled is31fl3195"
	default n
	---help---
		Enable support for rgbled IS3FL3195 driver
```
