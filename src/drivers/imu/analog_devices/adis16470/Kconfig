## src/drivers/imu/analog_devices/adis16470/Kconfig
```kconfig
menuconfig DRIVERS_IMU_ANALOG_DEVICES_ADIS16470
	bool "ADIS16470"
	default n
	select DRIVERS_IMU_ANALOG_DEVICES_COMMON
	---help---
		Enable support for analog_devices ADIS16470
```

## src/drivers/imu/analog_devices/adis16477/Kconfig
```kconfig
menuconfig DRIVERS_IMU_ANALOG_DEVICES_ADIS16477
	bool "adis16477"
	default n
	select DRIVERS_IMU_ANALOG_DEVICES_COMMON
	---help---
		Enable support for adis16477
```

## src/drivers/imu/analog_devices/adis16497/Kconfig
```kconfig
menuconfig DRIVERS_IMU_ANALOG_DEVICES_ADIS16497
	bool "adis16497"
	default n
	---help---
		Enable support for adis16497
```

## src/drivers/imu/analog_devices/adis16507/Kconfig
```kconfig
menuconfig DRIVERS_IMU_ANALOG_DEVICES_ADIS16507
	bool "ADIS16507"
	default n
	select DRIVERS_IMU_ANALOG_DEVICES_COMMON
	---help---
		Enable support for analog_devices ADIS16507
```

## src/drivers/imu/analog_devices/adis1650x/Kconfig
```kconfig
menuconfig DRIVERS_IMU_ANALOG_DEVICES_ADIS1650X
	bool "adis1650x (ADIS16500 / ADIS16501 / ADIS16505 / ADIS16507)"
	default n
	---help---
		Enable support for the Analog Devices ADIS1650x IMU family.
		Supported variants: ADIS16500, ADIS16501, ADIS16505, ADIS16507.
		The variant is detected automatically at runtime via PROD_ID.
```

## src/drivers/imu/analog_devices/adis1657x/Kconfig
```kconfig
menuconfig DRIVERS_IMU_ANALOG_DEVICES_ADIS1657X
	bool "adis1657x (ADIS16575 / ADIS16576 / ADIS16577)"
	default n
	---help---
		Enable support for the Analog Devices ADIS1657x IMU family.
		Supported variants: ADIS16575-2/3, ADIS16576-2/3, ADIS16577-2/3.
		The variant is picked automatically at runtime.
```

## src/drivers/imu/analog_devices/adis16607/Kconfig
```kconfig
menuconfig DRIVERS_IMU_ANALOG_DEVICES_ADIS16607
	bool "ADIS16607"
	default n
	---help---
		Enable support for analog_devices ADIS16607
```

## src/drivers/imu/anello/x3/Kconfig
```kconfig
menuconfig DRIVERS_IMU_ANELLO_X3
	bool "anello_x3"
	default n
	---help---
		Enable support for anello_x3
```

## src/drivers/imu/bno055/Kconfig
```kconfig
menuconfig DRIVERS_IMU_BNO055
	bool "bno055"
	default n
	---help---
		Enable experimental BNO055 IMU+Compass driver
```

## src/drivers/imu/bosch/bmi055/Kconfig
```kconfig
menuconfig DRIVERS_IMU_BOSCH_BMI055
	bool "bosch bmi055"
	default n
	---help---
		Enable support for bosch bmi055
```

## src/drivers/imu/bosch/bmi085/Kconfig
```kconfig
menuconfig DRIVERS_IMU_BOSCH_BMI085
	bool "bosch bmi085"
	default n
	---help---
		Enable support for bosch bmi085
```

## src/drivers/imu/bosch/bmi088/Kconfig
```kconfig
menuconfig DRIVERS_IMU_BOSCH_BMI088
	bool "bosch bmi088"
	default n
	---help---
		Enable support for bosch bmi088

if DRIVERS_IMU_BOSCH_BMI088

choice
	prompt "BMI088 accelerometer interrupt pin"
	default BMI088_ACCELEROMETER_INT1

config BMI088_ACCELEROMETER_INT_NONE
	bool "No interrupts"
	---help---
		No pin on the BMI088 will output accelerometer interrupts

config BMI088_ACCELEROMETER_INT1
	bool "INT1"
	---help---
		Use INT1 pin of the BMI088 to output accelerometer interrupts

config BMI088_ACCELEROMETER_INT2
	bool "INT2"
	---help---
		Use INT2 pin of the BMI088 to output accelerometer interrupts
endchoice

choice
	prompt "BMI088 gyroscope interrupt pin"
	default BMI088_GYROSCOPE_INT3

config BMI088_GYROSCOPE_INT_NONE
	bool "No interrupts"
	---help---
		No pin on the BMI088 will output gyroscope interrupts

config BMI088_GYROSCOPE_INT3
	bool "INT3"
	---help---
		Use INT3 pin of the BMI088 to output gyroscope interrupts

config BMI088_GYROSCOPE_INT4
	bool "INT4"
	---help---
		Use INT4 pin of the BMI088 to output gyroscope interrupts
endchoice

endif
```

## src/drivers/imu/bosch/bmi088_i2c/Kconfig
```kconfig
menuconfig DRIVERS_IMU_BOSCH_BMI088_I2C
	bool "bosch bmi088_i2c"
	default n
	depends on !DRIVERS_IMU_BOSCH_BMI088
	---help---
		Enable support for bosch bmi088_i2c
```

## src/drivers/imu/bosch/bmi270/Kconfig
```kconfig
menuconfig DRIVERS_IMU_BOSCH_BMI270
	bool "bosch bmi270"
	default n
	---help---
		Enable support for bosch bmi270
```

## src/drivers/imu/invensense/Kconfig
```kconfig
menuconfig DRIVERS_IMU_INVENSENSE
	bool "invensense"
	default n
	---help---
		Enable support for invensense
```

## src/drivers/imu/invensense/iam20680hp/Kconfig
```kconfig
menuconfig DRIVERS_IMU_INVENSENSE_IAM20680HP
	bool "iam20680hp"
	default n
	---help---
		Enable support for iam20680hp
```

## src/drivers/imu/invensense/icm42670p/Kconfig
```kconfig
menuconfig DRIVERS_IMU_INVENSENSE_ICM42670P
	bool "icm42670p"
	default n
	---help---
		Enable support for icm42670p
```

## src/drivers/imu/invensense/icm42688/Kconfig
```kconfig
menuconfig DRIVERS_IMU_INVENSENSE_ICM42688
	bool "icm42688"
	default n
	---help---
		Enable support for icm42688
```

## src/drivers/imu/invensense/icm45686/Kconfig
```kconfig
menuconfig DRIVERS_IMU_INVENSENSE_ICM45686
	bool "icm45686"
	default n
	---help---
		Enable support for icm45686
```

## src/drivers/imu/invensense/iim20670/Kconfig
```kconfig
menuconfig DRIVERS_IMU_INVENSENSE_IIM20670
	bool "iim20670"
	default n
	---help---
		Enable support for iim20670
```

## src/drivers/imu/invensense/iim42652/Kconfig
```kconfig
menuconfig DRIVERS_IMU_INVENSENSE_IIM42652
	bool "iim42652"
	default n
	---help---
		Enable support for iim42652
```

## src/drivers/imu/invensense/iim42653/Kconfig
```kconfig
menuconfig DRIVERS_IMU_INVENSENSE_IIM42653
	bool "iim42653"
	default n
	---help---
		Enable support for iim42653
```
