## src/drivers/imu/invensense/iim42653/Kconfig
```kconfig
menuconfig DRIVERS_IMU_INVENSENSE_IIM42653
	bool "iim42653"
	default n
	depends on !DRIVERS_IMU_INVENSENSE_ICM42X
	---help---
		Enable support for iim42653
```

## src/drivers/imu/invensense/mpu6000/Kconfig
```kconfig
menuconfig DRIVERS_IMU_INVENSENSE_MPU6000
	bool "mpu6000"
	default n
	depends on !DRIVERS_IMU_INVENSENSE_MPU_DIRECT
	---help---
		Enable support for mpu6000
```

## src/drivers/imu/invensense/mpu6500/Kconfig
```kconfig
menuconfig DRIVERS_IMU_INVENSENSE_MPU6500
	bool "mpu6500"
	default n
	depends on !DRIVERS_IMU_INVENSENSE_MPU_DIRECT
	---help---
		Enable support for mpu6500
```

## src/drivers/imu/invensense/mpu_direct/Kconfig
```kconfig
menuconfig DRIVERS_IMU_INVENSENSE_MPU_DIRECT
	bool "TDK direct-register SPI FIFO family"
	default n
	help
	  Shared SPI six-axis implementation for flat-register InvenSense/TDK IMUs
	  (MPU6000, MPU6500, ICM20602, ICM20608G, ICM20689, IAM20680HP).
```

## src/drivers/ins/Kconfig
```kconfig
menu "Inertial Navigation Systems (INS)"
    menuconfig COMMON_INS
        bool "All INS sensors"
        default n
        imply DRIVERS_INS_VECTORNAV
        imply DRIVERS_INS_ILABS
        imply DRIVERS_INS_MICROSTRAIN
        imply DRIVERS_INS_EULERNAV_BAHRS
        imply DRIVERS_INS_SBGECOM
        ---help---
            Enable default set of INS sensors
    rsource "*/Kconfig"
endmenu
```

## src/drivers/lights/Kconfig
```kconfig
menu "Lights"
    menuconfig COMMON_LIGHT
        bool "Common Light's"
        default n
        imply DRIVERS_LIGHTS_RGBLED
        imply DRIVERS_LIGHTS_RGBLED_NCP5623C
        imply DRIVERS_LIGHTS_RGBLED_IS31FL3195
        imply DRIVERS_LIGHTS_RGBLED_LP5562
        ---help---
            Enable default set of light drivers
    rsource "*/Kconfig"
endmenu
```

## src/drivers/magnetometer/Kconfig
```kconfig
menu "Magnetometer"
    menuconfig COMMON_MAGNETOMETER
        bool "Common Magnetometer's"
        default n
        imply DRIVERS_MAGNETOMETER_AKM_AK8963
        imply DRIVERS_MAGNETOMETER_AKM_AK09916
        imply DRIVERS_MAGNETOMETER_BOSCH_BMM150
        imply DRIVERS_MAGNETOMETER_BOSCH_BMM350
        imply DRIVERS_MAGNETOMETER_HMC5883
        imply DRIVERS_MAGNETOMETER_QMC5883L
        imply DRIVERS_MAGNETOMETER_QMC5883P
        imply DRIVERS_MAGNETOMETER_ISENTEK_IST8308
        imply DRIVERS_MAGNETOMETER_ISENTEK_IST8310
        imply DRIVERS_MAGNETOMETER_LIS3MDL
        imply DRIVERS_MAGNETOMETER_LSM303AGR
        imply DRIVERS_MAGNETOMETER_RM3100
        imply DRIVERS_MAGNETOMETER_MEMSIC_MMC5983MA
        imply DRIVERS_MAGNETOMETER_ST_IIS2MDC
        imply DRIVERS_MAGNETOMETER_VOLTAFIELD_AF9838
        ---help---
            Enable default set of magnetometer drivers
    rsource "*/Kconfig"
endmenu
```

## src/drivers/optical_flow/Kconfig
```kconfig
menu "Optical flow"
    menuconfig COMMON_OPTICAL_FLOW
        bool "Common Optical flow"
        default n
        imply DRIVERS_OPTICAL_FLOW_PAA3905
        imply DRIVERS_OPTICAL_FLOW_PAW3902
        imply DRIVERS_OPTICAL_FLOW_PMW3901
        imply DRIVERS_OPTICAL_FLOW_PX4FLOW
        imply DRIVERS_OPTICAL_FLOW_THONEFLOW
        ---help---
            Enable default set of optical flow drivers
    rsource "*/Kconfig"
endmenu
```

## src/drivers/osd/Kconfig
```kconfig
menu "OSD"
    menuconfig COMMON_OSD
        bool "Common OSD drivers"
        default n
        imply DRIVERS_OSD_ATXXXX
        imply DRIVERS_OSD_MSP_OSD
        ---help---
            Enable default set of OSD drivers
    rsource "*/Kconfig"
endmenu
```

## src/drivers/rc/Kconfig
```kconfig
menu "RC"
    menuconfig COMMON_RC
        bool "Common RC"
        default n
        imply DRIVERS_RC_CRSF_RC
        imply DRIVERS_RC_DSM_RC
        imply DRIVERS_RC_GHST_RC
        imply DRIVERS_RC_SBUS_RC
        ---help---
            Enable default set of radio control drivers
    rsource "*/Kconfig"
endmenu
```

## src/drivers/rpm/Kconfig
```kconfig
menu "RPM"
    menuconfig COMMON_RPM
        bool "Common RPM drivers"
        default n
        imply DRIVERS_RPM_PCF8583
        imply DRIVERS_RPM_RPM_SIMULATOR
        ---help---
            Enable default set of RPM drivers
    rsource "*/Kconfig"
endmenu
```

## src/drivers/telemetry/Kconfig
```kconfig
menu "Telemetry"
    menuconfig COMMON_TELEMETRY
        bool "Common telemetry module's"
        default n
        imply DRIVERS_TELEMETRY_BST
        imply DRIVERS_TELEMETRY_FRSKY_TELEMETRY
        imply DRIVERS_TELEMETRY_HOTT
        ---help---
            Enable default set of telemetry drivers
    rsource "*/Kconfig"
endmenu
```

## src/modules/airship_att_control/Kconfig
```kconfig
config PACKAGE_AIRSHIP
	bool "Airship package"
	imply MODULES_AIRSHIP_ATT_CONTROL
	imply MODULES_CONTROL_ALLOCATOR
	imply MODULES_LAND_DETECTOR
	---help---
		Modules rc.airship_apps starts unconditionally.

		Modules are implied: each one defaults to enabled and can
		still be disabled individually with CONFIG_MODULES_<NAME>=n.

menuconfig MODULES_AIRSHIP_ATT_CONTROL
	bool "airship_att_control"
	default n
	---help---
		Enable support for airship_att_control

menuconfig USER_AIRSHIP_ATT_CONTROL
	bool "airship_att_control running as userspace module"
	default y
	depends on BOARD_PROTECTED && MODULES_AIRSHIP_ATT_CONTROL
	---help---
		Put airship_att_control in userspace memory
```

## src/modules/commander/Kconfig
```kconfig
config PACKAGE_CORE
	bool "Core package"
	imply MODULES_COMMANDER
	imply MODULES_DATAMAN
	imply MODULES_EKF2
	imply MODULES_EVENTS
	imply MODULES_LOAD_MON
	imply MODULES_LOGGER
	imply MODULES_MANUAL_CONTROL
	imply MODULES_MAVLINK
	imply MODULES_NAVIGATOR
	imply MODULES_RC_UPDATE
	imply MODULES_SENSORS
	imply SYSTEMCMDS_PARAM
	imply SYSTEMCMDS_REBOOT
	imply SYSTEMCMDS_TUNE_CONTROL
	imply SYSTEMCMDS_VER
	---help---
		Modules rcS starts and commands rcS runs for every vehicle type.

		Modules and commands are implied: each one defaults to enabled
		and can still be disabled individually, e.g. with
		CONFIG_MODULES_<NAME>=n or CONFIG_SYSTEMCMDS_<NAME>=n.

menuconfig MODULES_COMMANDER
	bool "commander"
	default n
	---help---
		Enable support for commander

menuconfig USER_COMMANDER
	bool "commander running as userspace module"
	default y
	depends on BOARD_PROTECTED && MODULES_COMMANDER
	---help---
		Put commander in userspace memory
```

## src/modules/dataman/Kconfig
```kconfig
menuconfig MODULES_DATAMAN
	bool "dataman"
	default n
	---help---
		Enable support for dataman


menuconfig USER_DATAMAN
	bool "dataman running as userspace module"
	default y
	depends on BOARD_PROTECTED && MODULES_DATAMAN
	---help---
		Put dataman in userspace memory


menuconfig DATAMAN_PERSISTENT_STORAGE
	bool "dataman supports persistent storage"
	default y
	depends on MODULES_DATAMAN
	---help---
		Dataman supports reading/writing to persistent storage

menuconfig NUM_MISSION_ITEMS_SUPPORTED
	int "Maximum number of mission items"
	default 500
	---help---
		This limit sizes mission storage constants used by dataman and dataman clients.
		It applies whether mission items are stored on the SD card or in RAM. It should
		be set adequately per board such that if the items are stored in RAM they still
		fit the available memory.
		The runtime parameter to configure the storage option is `SYS_DM_BACKEND`.

config NUM_FENCE_ITEMS_SUPPORTED
	int "Maximum number of geofence items"
	default 64
	range 3 255
	---help---
		This limit sizes the geofence storage. It counts the items of both fence levels:
		polygon vertices, circles, fence level items and the return point. It is also the
		largest polygon. Each item costs 72 bytes of dataman storage (RAM on boards without
		persistent storage or with `SYS_DM_BACKEND` set to RAM storage) and 8 bytes of RAM
		in the Return geofence avoidance planner. The maximum keeps the fence item index
		in 8 bits.
```

## src/modules/fw_rate_control/Kconfig
```kconfig
config PACKAGE_FIXEDWING
	bool "Fixed-wing package"
	imply MODULES_AIRSPEED_SELECTOR
	imply MODULES_CONTROL_ALLOCATOR
	imply MODULES_FW_ATT_CONTROL
	imply MODULES_FW_AUTOTUNE_ATTITUDE_CONTROL
	imply MODULES_FW_LATERAL_LONGITUDINAL_CONTROL
	imply MODULES_FW_MODE_MANAGER
	imply MODULES_FW_RATE_CONTROL
	imply MODULES_LAND_DETECTOR
	---help---
		Modules rc.fw_apps starts unconditionally.

		Modules are implied: each one defaults to enabled and can
		still be disabled individually with CONFIG_MODULES_<NAME>=n.

menuconfig MODULES_FW_RATE_CONTROL
	bool "fw_rate_control"
	default n
	---help---
		Enable support for fw_att_control

menuconfig USER_FW_RATE_CONTROL
	bool "fw_rate_control running as userspace module"
	default n
	depends on BOARD_PROTECTED && MODULES_FW_RATE_CONTROL
	---help---
		Put fw_rate_control in userspace memory
```

## src/modules/mavlink/Kconfig
```kconfig
menuconfig MODULES_MAVLINK
	bool "mavlink"
	default n
	---help---
		Enable support for mavlink

menuconfig MAVLINK_DIALECT
depends on MODULES_MAVLINK
        string "Mavlink dialect"
        default "common"
	---help---
		Select the Mavlink dialect to generate and use.

menuconfig MAVLINK_EXTENSION_EXAMPLE
depends on MODULES_MAVLINK
	bool "Example MAVLink extension"
	default n
	---help---
		Build the example of px4_add_mavlink_extension(): a handler that counts the
		MEMORY_VECT messages PX4 receives on any MAVLink instance, and a MEMORY_VECT
		stream that reports the count.

menuconfig MAVLINK_NUM_CONFIG_INSTANCES
depends on MODULES_MAVLINK
	int "Number of MAVLink instance configurations"
	default 3
	range 1 3 if BOARD_CONSTRAINED_MEMORY
	range 1 5
	---help---
		Number of MAV_x_* parameter sets. At most 6 MAVLink instances can
		run at once (4 on constrained-memory boards), and USB takes one.

menuconfig MAVLINK_UAVCAN_PARAMETERS
depends on MODULES_MAVLINK && DRIVERS_UAVCAN
        bool "Mavlink UAVCAN parameter support"
        default y
	---help---
		Expose UAVCAN parameters over Mavlink.

menuconfig USER_MAVLINK
	bool "mavlink running as userspace module"
	default y
	depends on BOARD_PROTECTED && MODULES_MAVLINK
	---help---
		Put mavlink in userspace memory
```

## src/modules/mc_att_control/Kconfig
```kconfig
menuconfig MODULES_MC_ATT_CONTROL
	bool "mc_att_control"
	default n
	---help---
		Enable support for mc_att_control

menuconfig USER_MC_ATT_CONTROL
	bool "mc_att_control running as userspace module"
	default n
	depends on BOARD_PROTECTED && MODULES_MC_ATT_CONTROL
	---help---
		Put mc_att_control in userspace memory

config MODE_TURTLE
	bool "Turtle recovery mode"
	default n
	depends on MODULES_MC_ATT_CONTROL && MODULES_CONTROL_ALLOCATOR
	depends on DRIVERS_DSHOT || PLATFORM_POSIX
```

## src/modules/mc_rate_control/Kconfig
```kconfig
config PACKAGE_MULTICOPTER
	bool "Multicopter package"
	imply MODULES_CONTROL_ALLOCATOR
	imply MODULES_FLIGHT_MODE_MANAGER
	imply MODULES_LAND_DETECTOR
	imply MODULES_MC_ATT_CONTROL
	imply MODULES_MC_HOVER_THRUST_ESTIMATOR
	imply MODULES_MC_POS_CONTROL
	imply MODULES_MC_RATE_CONTROL
	---help---
		Modules rc.mc_apps starts unconditionally.

		Modules are implied: each one defaults to enabled and can
		still be disabled individually with CONFIG_MODULES_<NAME>=n.

menuconfig MODULES_MC_RATE_CONTROL
	bool "mc_rate_control"
	default n
	---help---
		Enable support for mc_rate_control

menuconfig USER_MC_RATE_CONTROL
	bool "mc_rate_control running as userspace module"
	default n
	depends on BOARD_PROTECTED && MODULES_MC_RATE_CONTROL
	---help---
		Put mc_rate_control in userspace memory
```

## src/modules/rover_ackermann/Kconfig
```kconfig
config PACKAGE_ROVER
	bool "Rover package"
	select PACKAGE_ROVER_ACKERMANN
	select PACKAGE_ROVER_DIFFERENTIAL
	select PACKAGE_ROVER_MECANUM
	---help---
		All rover types. To build a single rover type, enable its own
		package instead.

config PACKAGE_ROVER_ACKERMANN
	bool "Ackermann rover package"
	imply MODULES_LAND_DETECTOR
	imply MODULES_ROVER_ACKERMANN
	---help---
		Modules rc.rover_ackermann_apps starts unconditionally.

		Modules are implied: each one defaults to enabled and can
		still be disabled individually with CONFIG_MODULES_<NAME>=n.

menuconfig MODULES_ROVER_ACKERMANN
	bool "rover_ackermann"
	default n
	---help---
		Enable support for ackermann rovers
```

## src/modules/rover_differential/Kconfig
```kconfig
config PACKAGE_ROVER_DIFFERENTIAL
	bool "Differential rover package"
	imply MODULES_LAND_DETECTOR
	imply MODULES_ROVER_DIFFERENTIAL
	---help---
		Modules rc.rover_differential_apps starts unconditionally.

		Modules are implied: each one defaults to enabled and can
		still be disabled individually with CONFIG_MODULES_<NAME>=n.

menuconfig MODULES_ROVER_DIFFERENTIAL
	bool "rover_differential"
	default n
	---help---
		Enable support for differential rovers
```

## src/modules/rover_mecanum/Kconfig
```kconfig
config PACKAGE_ROVER_MECANUM
	bool "Mecanum rover package"
	imply MODULES_LAND_DETECTOR
	imply MODULES_ROVER_MECANUM
	---help---
		Modules rc.rover_mecanum_apps starts unconditionally.

		Modules are implied: each one defaults to enabled and can
		still be disabled individually with CONFIG_MODULES_<NAME>=n.

menuconfig MODULES_ROVER_MECANUM
	bool "rover_mecanum"
	default n
	---help---
		Enable support for mecanum rovers
```

## src/modules/simulation/Kconfig
```kconfig
menu "Simulation"
    menuconfig COMMON_SIMULATION
        bool "Common simulation modules"
        default n
        depends on PLATFORM_POSIX
        imply MODULES_SIMULATION_BATTERY_SIMULATOR
        imply MODULES_SIMULATION_PWM_OUT_SIM
        imply MODULES_SIMULATION_SENSOR_AIRSPEED_SIM
        imply MODULES_SIMULATION_SENSOR_BARO_SIM
        imply MODULES_SIMULATION_SENSOR_GPS_SIM
        imply MODULES_SIMULATION_SENSOR_MAG_SIM
        imply MODULES_SIMULATION_SYSTEM_POWER_SIMULATOR
        imply MODULES_SIMULATION_SIMULATOR_MAVLINK
        imply MODULES_SIMULATION_SIMULATOR_SIH
        ---help---
            Enable default set of simulation modules
    rsource "*/Kconfig"
endmenu
```

## src/modules/spacecraft/Kconfig
```kconfig
config PACKAGE_SPACECRAFT
	bool "Spacecraft package"
	imply MODULES_CONTROL_ALLOCATOR
	imply MODULES_SPACECRAFT
	---help---
		Modules rc.sc_apps starts unconditionally.

		Modules are implied: each one defaults to enabled and can
		still be disabled individually with CONFIG_MODULES_<NAME>=n.

menuconfig MODULES_SPACECRAFT
	bool "SPACECRAFT"
	default n
	---help---
		Enable support for spacecraft

menuconfig USER_SPACECRAFT
	bool "spacecraft running as userspace module"
	default y
	depends on BOARD_PROTECTED && MODULES_SPACECRAFT
	---help---
		Put SPACECRAFT in userspace memory
```

## src/modules/uuv_att_control/Kconfig
```kconfig
config PACKAGE_UUV
	bool "Unmanned underwater vehicle package"
	imply MODULES_CONTROL_ALLOCATOR
	imply MODULES_UUV_ATT_CONTROL
	imply MODULES_UUV_POS_CONTROL
	---help---
		Modules rc.uuv_apps starts unconditionally.

		Modules are implied: each one defaults to enabled and can
		still be disabled individually with CONFIG_MODULES_<NAME>=n.

menuconfig MODULES_UUV_ATT_CONTROL
	bool "uuv_att_control"
	default n
	---help---
		Enable support for uuv_att_control

menuconfig USER_UUV_ATT_CONTROL
	bool "uuv_att_control running as userspace module"
	default y
	depends on BOARD_PROTECTED && MODULES_UUV_ATT_CONTROL
	---help---
		Put uuv_att_control in userspace memory
```
