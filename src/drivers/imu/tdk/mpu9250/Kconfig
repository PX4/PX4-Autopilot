## src/drivers/imu/tdk/mpu9250/Kconfig
```kconfig
menuconfig DRIVERS_IMU_TDK_MPU9250
	bool "TDK MPU9250 SPI driver"
	depends on !DRIVERS_IMU_INVENSENSE_MPU9250
	default n
	help
	  Independent MPU9250 SPI accelerometer and gyroscope acquisition.
	  The original product driver remains available.
```

## src/drivers/imu/tdk/tdk_direct/Kconfig
```kconfig
menuconfig DRIVERS_IMU_TDK_TDK_DIRECT
	bool "TDK direct-register SPI FIFO family"
	default n
	help
	  Shared SPI six-axis implementation. All commands require an exact -T model.
	  Original drivers remain available for comparison.

if DRIVERS_IMU_TDK_TDK_DIRECT

config TDK_DIRECT_MPU6500
	bool "MPU6500"
	default y

config TDK_DIRECT_ICM20608G
	bool "ICM20608G"
	default y

config TDK_DIRECT_ICM20689
	bool "ICM20689"
	default y

config TDK_DIRECT_IAM20680HP
	bool "IAM20680HP"
	default y

endif # DRIVERS_IMU_TDK_TDK_DIRECT
```

## src/drivers/imu/tdk/tdk_icm20x/Kconfig
```kconfig
menuconfig DRIVERS_IMU_TDK_TDK_ICM20X
	bool "TDK ICM20x banked SPI FIFO family"
	default n

if DRIVERS_IMU_TDK_TDK_ICM20X

config TDK_ICM20X_ICM20649
	bool "ICM20649"
	default y

config TDK_ICM20X_ICM20948
	bool "ICM20948 six-axis SPI only"
	default n
	help
	  Does not provide AK09916, auxiliary I2C or passthrough functionality.
	  Keep the original driver wherever these functions are required.

endif # DRIVERS_IMU_TDK_TDK_ICM20X
```

## src/drivers/imu/tdk/tdk_icm42x/Kconfig
```kconfig
menuconfig DRIVERS_IMU_TDK_TDK_ICM42X
	bool "TDK ICM4x headered SPI FIFO family"
	default n
	help
	  Shared FIFO implementation. Select an exact model with -T at start.
	  Existing Invensense drivers remain available for comparison.

if DRIVERS_IMU_TDK_TDK_ICM42X

config TDK_ICM42X_ICM40609D
	bool "ICM40609D"
	default n

config TDK_ICM42X_ICM42605
	bool "ICM42605"
	default n

config TDK_ICM42X_ICM42670P
	bool "ICM42670P"
	default n

config TDK_ICM42X_ICM45686
	bool "ICM45686"
	default n

config TDK_ICM42X_ICM42688P
	bool "ICM42688P"
	default y

config TDK_ICM42X_ICM42686P
	bool "ICM42686P"
	default y

config TDK_ICM42X_IIM42652
	bool "IIM42652"
	default y

config TDK_ICM42X_IIM42653
	bool "IIM42653"
	default y

endif # DRIVERS_IMU_TDK_TDK_ICM42X
```

## src/drivers/ins/anello/Kconfig
```kconfig
menuconfig DRIVERS_INS_ANELLO
	bool "anello"
	default n
	depends on MODULES_MAVLINK
	---help---
		ANELLO Maritime INS fused navigation over a dedicated MAVLink UART.
```

## src/drivers/ins/naviguider/Kconfig
```kconfig
menuconfig DRIVERS_INS_NAVIGUIDER
	bool "naviguider"
	default n
	---help---
		Enable support for pni drivers
```

## src/drivers/osd/msp_osd_ws/Kconfig
```kconfig
menuconfig DRIVERS_OSD_MSP_OSD_WS
	bool "MSP Walksnail OSD (msp_osd_ws)"
	default n
	---help---
		Enable support for msp_osd_ws

menuconfig USER_MSP_OSD_WS
	bool "msp_osd_ws running as userspace module"
	default y
	depends on BOARD_PROTECTED && DRIVERS_OSD_MSP_OSD_WS
	---help---
		Put msp_osd_ws in userspace memory
```

## src/drivers/rc/Kconfig
```kconfig
menu "RC"
    menuconfig COMMON_RC
        bool "Common RC"
        default n
        select DRIVERS_RC_CRSF_RC
        select DRIVERS_RC_DSM_RC
        select DRIVERS_RC_GHST_RC
        select DRIVERS_RC_SBUS_RC
        select DRIVERS_RC_SUMD_RC
        select DRIVERS_RC_ST24_RC
        select DRIVERS_RC_PPM_RC
        ---help---
            Enable default set of radio control drivers
    rsource "*/Kconfig"
endmenu
```

## src/drivers/rc/ppm_rc/Kconfig
```kconfig
menuconfig DRIVERS_RC_PPM_RC
	bool "ppm_rc"
	default n
	---help---
		Enable support for ppm_rc
```

## src/drivers/rc/st24_rc/Kconfig
```kconfig
menuconfig DRIVERS_RC_ST24_RC
	bool "st24_rc"
	default n
	---help---
		Enable support for st24_rc
```

## src/drivers/rc/sumd_rc/Kconfig
```kconfig
menuconfig DRIVERS_RC_SUMD_RC
	bool "sumd_rc"
	default n
	---help---
		Enable support for sumd_rc
```

## src/drivers/serialpassthrough/Kconfig
```kconfig
menuconfig DRIVERS_SERIALPASSTHROUGH
	bool "serialpassthrough"
	default n
	---help---
		Enable the serialpassthrough module.
		Forwards data between a UART and a MAVLink via
		SERIAL_CONTROL messages.

if DRIVERS_SERIALPASSTHROUGH

config SERIALPASSTHROUGH_BITBANG
	bool "Enable bit-bang UART support (ESC channel mode)"
	default n
	depends on PLATFORM_NUTTX
	select UART_BITBANG
	---help---
		Enable bit-bang UART.

endif # DRIVERS_SERIALPASSTHROUGH
```

## src/drivers/slcan/Kconfig
```kconfig
menuconfig DRIVERS_SLCAN
	bool "slcan"
	default n
	depends on PLATFORM_NUTTX
	depends on DRIVERS_UAVCAN || DRIVERS_UAVCANNODE
	---help---
		LAWICEL SLCAN bridge from a NuttX SocketCAN iface (can0/can1)
		to a serial/USB port. Used by DroneCAN GUI Tool.

		Requires NuttX CONFIG_NET_CAN. Does not take the CAN controller
		from UAVCAN: it opens a second PF_CAN socket. Does not change
		the bus bitrate (UAVCAN_BITRATE / CANNODE_BITRATE remains the
		source of truth). Disabled while armed.
```

## src/examples/fake_gnss/Kconfig
```kconfig
menuconfig EXAMPLES_FAKE_GNSS
	bool "fake_gnss"
	default n
	---help---
		Enable support for fake_gnss
```

## src/modules/commander/Kconfig
```kconfig
menuconfig MODULES_COMMANDER
	bool "commander"
	default n
	---help---
		Enable support for commander

menuconfig USER_COMMANDER
	bool "commander running as userspace module"
	default y
	depends on BOARD_PROTECTED && MODULES_COMMANDER
	---help---
		Put commander in userspace memory

config RID_UOM_TEST_MOCK
	bool "Allow mock UOM status in a bench-test firmware"
	default n
	depends on MODULES_COMMANDER
	---help---
		TEST ONLY: permit a mock reporting service to satisfy the RID/UOM
		preflight check. Production firmware must leave this disabled.
```

## src/modules/comp_filter/Kconfig
```kconfig
config MODULES_COMP_FILTER
	bool "comp_filter"
	default y
	---help---
		Enable support for the complementary filter module.
```

## src/modules/complementary_filter/Kconfig
```kconfig
config MODULES_COMPLEMENTARY_FILTER
    bool "complementary_filter"
    default y
```

## src/modules/flip_after_crash/Kconfig
```kconfig
menuconfig MODULES_FLIP_AFTER_CRASH
	bool "flip_after_crash"
	default n
	---help---
		Enable support for flip_after_crash module
```

## src/modules/formic_logger_flag/Kconfig
```kconfig
menuconfig MODULES_FORMIC_LOGGER_FLAG
	bool "Formic Logger Flag Module"
	default n
```

## src/modules/hello_kotb/Kconfig
```kconfig
menuconfig MODULES_HELLO_KOTB
	bool "hello_kotb"
	default y
	---help---
		Enable support for hello_kotb
```

## src/modules/logger/Kconfig
```kconfig
menuconfig MODULES_LOGGER
	bool "logger"
	default n
	---help---
		Enable support for logger

menuconfig USER_LOGGER
	bool "logger running as userspace module"
	default y
	depends on BOARD_PROTECTED && MODULES_LOGGER
	---help---
		Put logger in userspace memory

menuconfig LOGGER_ESC_EEPROM
	bool "log the ESC EEPROM settings"
	default y
	depends on MODULES_LOGGER && DRIVERS_DSHOT
	---help---
		Write the EEPROM settings reported by the ESCs into the logs
menuconfig LOGGER_STACK_SIZE
	int "stack size of logger task"
	default 3700
	depends on MODULES_LOGGER
	---help---
		Stack size of the logger task. Some configurations require more stack
		than the default.
```

## src/modules/mavlink/Kconfig
```kconfig
menuconfig MODULES_MAVLINK
	bool "mavlink"
	default n
	---help---
		Enable support for mavlink

menuconfig MAVLINK_DIALECT
depends on MODULES_MAVLINK
        string "Mavlink dialect"
        default "common"
	---help---
		Select the Mavlink dialect to generate and use.

menuconfig MAVLINK_EXTENSION_EXAMPLE
depends on MODULES_MAVLINK
	bool "Example MAVLink extension"
	default n
	---help---
		Build the example of px4_add_mavlink_extension(): a handler that counts the
		MEMORY_VECT messages PX4 receives on any MAVLink instance, and a MEMORY_VECT
		stream that reports the count.

menuconfig MAVLINK_UAVCAN_PARAMETERS
depends on MODULES_MAVLINK && DRIVERS_UAVCAN
        bool "Mavlink UAVCAN parameter support"
        default y
	---help---
		Expose UAVCAN parameters over Mavlink.

menuconfig USER_MAVLINK
	bool "mavlink running as userspace module"
	default y
	depends on BOARD_PROTECTED && MODULES_MAVLINK
	---help---
		Put mavlink in userspace memory
```

## src/modules/mc_autotune_attitude_control/Kconfig
```kconfig
menuconfig MODULES_MC_AUTOTUNE_ATTITUDE_CONTROL
	bool "mc_autotune_attitude_control"
	default n
	---help---
		Enable support for mc_autotune_attitude_control

config MC_AUTOTUNE_EXPERIMENTAL
	bool "Experimental response-verified MC autotune"
	depends on MODULES_MC_AUTOTUNE_ATTITUDE_CONTROL
	default n
	---help---
		Select the experimental response-verification method instead of standard
		MC autotune. Requires additional FLASH and approximately 35 KiB of heap.
		Only one implementation is included in the firmware.
```

## src/modules/navigator/Kconfig
```kconfig
menuconfig MODULES_NAVIGATOR
	bool "navigator"
	default n
	---help---
		Enable support for navigator

menuconfig USER_NAVIGATOR
	bool "navigator running as userspace module"
	default y
	depends on BOARD_PROTECTED && MODULES_NAVIGATOR
	---help---
		Put navigator in userspace memory

menuconfig MODE_NAVIGATOR_VTOL_TAKEOFF
	bool "Include VTOL takeoff mode support"
	default n
	depends on MODULES_NAVIGATOR
	---help---
		Add VTOL takeoff mode to enable support for MAV_CMD_NAV_VTOL_TAKEOFF.
		The VTOL takes off in MC mode and transition to FW. The mode ends with
		an infinite loiter

menuconfig NAVIGATOR_ADSB
	bool "Include traffic reporting and avoidance"
	default y
	depends on MODULES_NAVIGATOR
	---help---
		Evaluate cooperative traffic reports and request configured warnings or
		navigation actions. The crosstrack conflict model is built by default;
		enabling NAVIGATOR_ADSB_F3442 selects the F3442-derived model instead.

menuconfig NAVIGATOR_ADSB_F3442
	bool "Use F3442-derived traffic conflict evaluation"
	default n
	depends on NAVIGATOR_ADSB
	---help---
		Build the conflict model based on selected ASTM F3442 alert concepts
		instead of the crosstrack model. This option alone does not establish
		compliance.

menuconfig NAVIGATOR_GEOFENCE_AVOIDANCE
	bool "Include geofence avoidance path planning for Return mode"
	default y
	depends on MODULES_NAVIGATOR
	---help---
		Add support for Return mode to route around geofences.
		The node budget (and thus RAM usage) is set at runtime with GF_AVOID_NODES.

menuconfig NAVIGATOR_GEOFENCE_PATH_CHECKS
	bool "Check the mission flight path against the geofence at upload"
	default y
	depends on MODULES_NAVIGATOR
	---help---
		Reject an uploaded mission whose flight path crosses a geofence, not only a
		mission with a waypoint outside it. Boards without the flash for it keep the
		waypoint-only check.

menuconfig NAVIGATOR_ADSB_FAKE_TRAFFIC
	bool "Include fake-traffic injection for DAA testing"
	default n
	depends on NAVIGATOR_ADSB
	---help---
		Adds the `navigator fake_traffic` shell command and the scripted scenarios
		used to validate the Detect and Avoid pipeline without a real transponder.

config NAVIGATOR_FULL_MISSION_CACHE_SIZE
	int "Maximum number of mission items cached for route planning"
	default 500 if PLATFORM_POSIX
	default 0
	range 0 NUM_MISSION_ITEMS_SUPPORTED
	depends on MODULES_NAVIGATOR
	---help---
		Maximum number of mission items reserved in RAM for full-route planning helpers:
		56 bytes per item, allocated once at Navigator start. Set to 0 to disable the
		cache on boards without the extra RAM. Longer missions are not cached at all.
		After upload or reboot the cache refills asynchronously. Navigator polls the
		Dataman response subscription while each read is pending, then immediately
		queues the next item without blocking its main loop.

config NAVIGATOR_SAFE_POINT_BATCH_SIZE
	int "Rally points per route planning batch"
	default 32 if BOARD_TESTING
	default 16
	range 16 32
	depends on MODULES_NAVIGATOR
	---help---
		Number of rally points the route planner projects onto the mission
		route in one pass. Each batch takes one pass over the route.
		The minimum of 16 keeps planning fast by limiting the number of
		passes. The maximum of 32 is the number of rally points that can be
		stored, so they all fit in one batch.
		Each slot uses 504 bytes of static RAM, plus 1.4 KB in total for
		geofence path checks. Only used when NAVIGATOR_FULL_MISSION_CACHE_SIZE
		is above 0.
```
