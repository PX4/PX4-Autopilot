## src/drivers/distance_sensor/tfa1500/Kconfig
```kconfig
menuconfig DRIVERS_DISTANCE_SENSOR_TFA1500
	bool "tfa1500"
	default n
	---help---
		Enable support for tfa1500
```

## src/drivers/distance_sensor/tfluna_i2c/Kconfig
```kconfig
menuconfig DRIVERS_DISTANCE_SENSOR_TFLUNA_I2C
	bool "tfluna_i2c"
	default n
	---help---
		Enable support for tfluna_i2c
```

## src/drivers/distance_sensor/tfmini_i2c/Kconfig
```kconfig
menuconfig DRIVERS_DISTANCE_SENSOR_TFMINI_I2C
	bool "tfmini_i2c"
	default n
	---help---
		Enable support for tfmini_i2c
```

## src/drivers/distance_sensor/usonicv2/Kconfig
```kconfig
menuconfig DRIVERS_DISTANCE_SENSOR_USONICV2
	bool "usonicv2"
	default n
	---help---
		Enable support for SRF05 Single Pin mode
```

## src/drivers/dj_app/Kconfig
```kconfig
menuconfig DRIVERS_DJ_APP
	bool "dj_app"
	default n
	---help---
		Enable support for dj_app
```

## src/drivers/dshot/Kconfig
```kconfig
menuconfig DRIVERS_DSHOT
	bool "dshot"
	default n
	---help---
		Enable support for dshot

config DSHOT_BITBANG
	bool "Use bitbang DShot"
	default n
	depends on DRIVERS_DSHOT
	---help---
		Use bitbang GPIO DShot instead of DMA burst to timer registers
```

## src/drivers/extreme_switch/Kconfig
```kconfig
menuconfig DRIVERS_EXTREME_SWITCH
	bool "extreme_switch"
	default n
	---help---
		Enable support for extreme_switch
```

## src/drivers/freefly_escs/Kconfig
```kconfig
menuconfig DRIVERS_FREEFLY_ESCS
	bool "ff_escs"
	default n
	---help---
		Enable support for ff_escs
```

## src/drivers/freefly_smartbattery/Kconfig
```kconfig
menuconfig DRIVERS_FREEFLY_SMARTBATTERY
	bool "ff_smartbattery"
	default n
	---help---
		Enable support for freefly smart battery
```

## src/drivers/gas_sensor/dfrobot_gas/Kconfig
```kconfig
menuconfig DRIVERS_GAS_SENSOR_DFROBOT_GAS
	bool "DFRobot Gravity gas sensors"
	default n
	---help---
		Enable support for DFRobot Gravity electrochemical gas sensors.
```

## src/drivers/gnss/septentrio/Kconfig
```kconfig
menuconfig DRIVERS_GNSS_SEPTENTRIO
	bool "Septentrio GNSS receivers"
	default n
	---help---
		Enable support for Septentrio receivers
```

## src/drivers/gnss/ublox/Kconfig
```kconfig
menuconfig DRIVERS_GNSS_UBLOX
	bool "u-blox GNSS receivers"
	default n
	---help---
		Enable support for a dedicated, self-contained u-blox GNSS driver.

		Unlike the generic "gps" driver, this driver vendors the UBX protocol
		parser in-tree (no PX4-GPSDrivers submodule) and only supports u-blox
		receivers. It is the basis for firmware-update-over-CAN on cannodes.
```

## src/drivers/gpio/mcp/Kconfig
```kconfig
menuconfig DRIVERS_GPIO_MCP
	bool "mcp230xx"
	default n
	---help---
		Enable support for mcp230xx
```

## src/drivers/gpio/mcp23009/Kconfig
```kconfig
menuconfig DRIVERS_GPIO_MCP23009
	bool "MCP23009"
	default n
	---help---
		Enable support for MCP23009 8-bit GPIO expander
```

## src/drivers/gpio/mcp23017/Kconfig
```kconfig
menuconfig DRIVERS_GPIO_MCP23017
	bool "MCP23017"
	default n
	---help---
		Enable support for MCP23017 16-bit GPIO expander
```

## src/drivers/gps/Kconfig
```kconfig
menuconfig DRIVERS_GPS
	bool "gps"
	default n
	---help---
		Enable support for gps

if DRIVERS_GPS
	config GPS_UBX
		bool "u-blox protocol support (UBX)"
		default y
		---help---
			Driver for u-blox GNSS receivers (M8, F9P, M10, X20, ...).

	config GPS_MTK
		bool "MediaTek protocol support (MTK)"
		default !BOARD_CONSTRAINED_FLASH
		---help---
			Driver for MediaTek GNSS receivers (custom binary protocol).

	config GPS_ASHTECH
		bool "Ashtech/Trimble protocol support"
		default !BOARD_CONSTRAINED_FLASH
		---help---
			Driver for Ashtech/Trimble GNSS receivers.

	config GPS_EMLIDREACH
		bool "Emlid Reach protocol support (ERB)"
		default !BOARD_CONSTRAINED_FLASH
		---help---
			Driver for Emlid Reach GNSS receivers (ERB protocol).

	config GPS_FEMTOMES
		bool "Femtomes protocol support"
		default !BOARD_CONSTRAINED_FLASH
		---help---
			Driver for Femtomes GNSS receivers.

	config GPS_NMEA
		bool "NMEA protocol support (incl. Unicore)"
		default !BOARD_CONSTRAINED_FLASH
		---help---
			Generic NMEA driver, including Unicore extensions.
			Never auto-detected: it must be selected explicitly via
			GPS_x_PROTOCOL or the -p command line option.

	config GPS_SPARTN
		bool "SPARTN correction framing (e.g. PointPerfect)"
		default n
		---help---
			Frame and inject SPARTN corrections (e.g. u-blox PointPerfect)
			from gps_inject_data alongside RTCM3.
			Enable on targets that receive a SPARTN correction service.
			Left off, the SPARTN framer is not built and the receiver only
			ever sees RTCM3, which is the common RTK setup.
endif # DRIVERS_GPS

menuconfig USER_GPS
	bool "gps running as userspace module"
	default y
	depends on BOARD_PROTECTED && DRIVERS_GPS
	---help---
		Put gps in userspace memory
```

## src/drivers/heater/Kconfig
```kconfig
menuconfig DRIVERS_HEATER
	bool "heater"
	default n
	---help---
		Enable support for heater

if DRIVERS_HEATER

config HEATER_FAST_UPDATE_MODE
	bool "Enable fast update mode"
	default n
	---help---
		When enabled, the heater will use the last known temperature reading
		for up to a defined threshold if no new temperature update is received. This allows
		faster update time compared to the default behavior where the heater
		waits idle for an entire control period on each missed update.
		After a certain time without a valid update, the heater is turned off for
		safety reasons and remains off until a new temperature reading is received.

endif # DRIVERS_HEATER
```

## src/drivers/hiwonder_emm/Kconfig
```kconfig
menuconfig DRIVERS_HIWONDER_EMM
	bool "hiwonder_emm"
	default n
	---help---
		Enable support for hiwonder encoder motor module
```

## src/drivers/hygrometer/Kconfig
```kconfig
menu "Hygrometers"
    menuconfig COMMON_HYGROMETERS
        bool "Hygrometer sensors"
        default n
        select DRIVERS_HYGROMETER_SHT3x
        ---help---
            Enable default set of hygrometer sensors
    rsource "*/Kconfig"
endmenu #Hygrometers
```

## src/drivers/hygrometer/sht3x/Kconfig
```kconfig
menuconfig DRIVERS_HYGROMETER_SHT3x
	bool "SHT3x temperature and humidity sensor"
	default n
	---help---
		Enable support SHT35 temperature/humidity sensor
```

## src/drivers/imu/Kconfig
```kconfig
menu "IMU"
    menuconfig COMMON_IMU
        bool "Common IMU's"
        default n
        select DRIVERS_IMU_ADIS16477
        select DRIVERS_IMU_ADIS16497
        select DRIVERS_IMU_ANALOG_DEVICES_ADIS16448
        select DRIVERS_IMU_ANALOG_DEVICES_ADIS16470
        select DRIVERS_IMU_BOSCH_BMI055
        select DRIVERS_IMU_BOSCH_BMI088
        select DRIVERS_IMU_FXAS21002C
        select DRIVERS_IMU_FXOS8701CQ
        select DRIVERS_IMU_INVENSENSE_ICM20602
        select DRIVERS_IMU_INVENSENSE_ICM20608G
        select DRIVERS_IMU_INVENSENSE_ICM20649
        select DRIVERS_IMU_INVENSENSE_ICM20689
        #select DRIVERS_IMU_INVENSENSE_ICM20948
        select DRIVERS_IMU_INVENSENSE_ICM40609D
        select DRIVERS_IMU_INVENSENSE_ICM42605
        select DRIVERS_IMU_INVENSENSE_ICM42688P
        select DRIVERS_IMU_INVENSENSE_MPU6000
        select DRIVERS_IMU_INVENSENSE_MPU6500
        select DRIVERS_IMU_INVENSENSE_MPU9250
        select DRIVERS_IMU_L3GD20
        select DRIVERS_IMU_LSM303D
        select DRIVERS_IMU_ST
        ---help---
            Enable default set of IMU drivers
    rsource "*/Kconfig"
endmenu
```

## src/drivers/imu/analog_devices/adis16448/Kconfig
```kconfig
menuconfig DRIVERS_IMU_ANALOG_DEVICES_ADIS16448
	bool "ADIS16448"
	default n
	---help---
		Enable support for analog_devices ADIS16448
```
