## src/drivers/actuators/voxl_esc/Kconfig
```kconfig
menuconfig DRIVERS_ACTUATORS_VOXL_ESC
	bool "voxl_esc"
	default n
	---help---
		Enable support for voxl_esc
```

## src/drivers/adc/ads7128/Kconfig
```kconfig
menuconfig DRIVERS_ADC_ADS7128
	bool "ADS7128 driver"
	default n
	---help---
		Enable support for ADS7128
```

## src/drivers/adc/ads7953/Kconfig
```kconfig
menuconfig DRIVERS_ADC_ADS7953
	bool "ADS7953 driver"
	default n
	---help---
		Enable support for ADS7953
```

## src/drivers/adc/tla2528/Kconfig
```kconfig
menuconfig DRIVERS_ADC_TLA2528
	bool "TLA2528 driver"
	default n
	---help---
		Enable support for TLA2528
```

## src/drivers/auterion_autostarter/Kconfig
```kconfig
menuconfig DRIVERS_AUTERION_AUTOSTARTER
	bool "auterion_autostarter"
	default n
	---help---
		Enable support for auterion_autostarter
```

## src/drivers/barometer/Kconfig
```kconfig
menu "barometer"
    menuconfig COMMON_BAROMETERS
        bool "Common barometers"
        default n
        select DRIVERS_BAROMETER_BMP280
        select DRIVERS_BAROMETER_BMP388
        select DRIVERS_BAROMETER_DPS310
        select DRIVERS_BAROMETER_LPS22HB
        select DRIVERS_BAROMETER_LPS33HW
        select DRIVERS_BAROMETER_MS5611
        select DRIVERS_BAROMETER_MAIERTEK_MPC2520
	select DRIVERS_BAROMETER_GOERTEK_SPL06 
        ---help---
            Enable default set of barometer drivers
    rsource "*/Kconfig"
endmenu #barometer
```

## src/drivers/barometer/bar100/Kconfig
```kconfig
menuconfig DRIVERS_BAROMETER_BAR100
	bool "bar100"
	default n
	---help---
		Enable support for bar100
```

## src/drivers/barometer/bmp581/Kconfig
```kconfig
menuconfig DRIVERS_BAROMETER_BMP581
	bool "bmp581"
	default n
	---help---
		Enable support for bmp581
```

## src/drivers/barometer/goertek/spa06/Kconfig
```kconfig
menuconfig DRIVERS_BAROMETER_GOERTEK_SPA06
	bool "spa06"
	default n
	---help---
		Enable support for spa06
```

## src/drivers/barometer/goertek/spl06/Kconfig
```kconfig
menuconfig DRIVERS_BAROMETER_GOERTEK_SPL06
	bool "spl06"
	default n
	---help---
		Enable support for spl06
```

## src/drivers/barometer/goertek/spl07/Kconfig
```kconfig
menuconfig DRIVERS_BAROMETER_GOERTEK_SPL07
	bool "spl07"
	default n
	---help---
		Enable support for spl07
```

## src/drivers/barometer/invensense/icp10100/Kconfig
```kconfig
menuconfig DRIVERS_BAROMETER_INVENSENSE_ICP10100
	bool "icp10100"
	default n
	---help---
		Enable support for icp10100
```

## src/drivers/barometer/invensense/icp10111/Kconfig
```kconfig
menuconfig DRIVERS_BAROMETER_INVENSENSE_ICP10111
	bool "icp10100"
	default n
	---help---
		Enable support for icp10111
```

## src/drivers/barometer/invensense/icp101xx/Kconfig
```kconfig
menuconfig DRIVERS_BAROMETER_INVENSENSE_ICP101XX
	bool "icp101xx"
	default n
	---help---
		Enable support for icp101xx
```

## src/drivers/barometer/invensense/icp201xx/Kconfig
```kconfig
menuconfig DRIVERS_BAROMETER_INVENSENSE_ICP201XX
	bool "icp201xx"
	default n
	---help---
		Enable support for icp201xx
```

## src/drivers/barometer/maiertek/mpc2520/Kconfig
```kconfig
menuconfig DRIVERS_BAROMETER_MAIERTEK_MPC2520
	bool "MPC2520"
	default n
	---help---
		Enable support for MPC2520
```

## src/drivers/barometer/ms5837/Kconfig
```kconfig
menuconfig DRIVERS_BAROMETER_MS5837
	bool "ms5837"
	default n
	---help---
		Enable support for ms5837
```

## src/drivers/barometer/spl06/Kconfig
```kconfig
menuconfig DRIVERS_BAROMETER_SPL06
	bool "spl06"
	default n
	---help---
		Enable support for spl06
```

## src/drivers/bootloaders/Kconfig
```kconfig
menuconfig DRIVERS_BOOTLOADERS
	bool "bootloaders"
	default n
	depends on BOARD_ROMFSROOT = "cannode" || BOARD_ROMFSROOT = ""
	---help---
		Enable support for bootloaders
		Note: This is only supported on UAVCAN node boards (CAN peripherals)
```

## src/drivers/can_open/Kconfig
```kconfig
#
# For a description of the syntax of this configuration file,
# see the file kconfig-language.txt in the NuttX tools repository.
#
menuconfig DRIVERS_CAN_OPEN
	bool "CANOPEN"
	default n
	---help---
		Enable support for CANOpen
```

## src/drivers/cdcacm_autostart/Kconfig
```kconfig
menuconfig DRIVERS_CDCACM_AUTOSTART
	bool "cdcacm_autostart"
	default n
	depends on MODULES_MAVLINK
	---help---
		Enable support for cdcacm_autostart

menuconfig USER_CDCACM_AUTOSTART
	bool "CDC ACM monitor running as userspace module"
	default y
	depends on BOARD_PROTECTED && DRIVERS_CDCACM_AUTOSTART
	---help---
		Put CDC ACM monitor in userspace memory
```
