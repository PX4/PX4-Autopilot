## src/drivers/cubered_bridge/primary/Kconfig
```kconfig
menuconfig DRIVERS_CUBERED_BRIDGE_PRIMARY
	bool "cubered_bridge_primary"
	default n
	depends on PLATFORM_NUTTX
	---help---
		Enable the CubeRed bridge driver running on the primary MCU.
		Talks over the IO serial link to the cubered_bridge_secondary
		running on the secondary MCU, using the PX4IO register protocol.
```

## src/drivers/cubered_bridge/secondary/Kconfig
```kconfig
menuconfig DRIVERS_CUBERED_BRIDGE_SECONDARY
	bool "cubered_bridge_secondary"
	default n
	---help---
		Enable support for CubeRed IO module - PX4IO simulation for CubeRed Secondary
```

## src/drivers/cyphal/Kconfig
```kconfig
#
# For a description of the syntax of this configuration file,
# see the file kconfig-language.txt in the NuttX tools repository.
#
menuconfig DRIVERS_CYPHAL
	bool "Cyphal"
	default n
	---help---
		Enable support for Cyphal

if DRIVERS_CYPHAL
    choice
        prompt "Cyphal Mode"

    config CYPHAL_FMU
        bool "Server (FMU)"

    config CYPHAL_CLIENT
        bool "Client (Peripheral)"

    endchoice

    config CYPHAL_NODE_MANAGER
        bool "Node manager"
        default y
        depends on CYPHAL_FMU
        help
            Implement Cyphal PNP server functionality and manages discovered nodes

    config CYPHAL_NODE_CLIENT
        bool "Node client"
        default y
        depends on CYPHAL_CLIENT
        help
            Implement Cyphal PNP client functionality

    config CYPHAL_APP_DESCRIPTOR
        bool "UAVCAN v0 bootloader app descriptor"
        default n
        depends on CYPHAL_CLIENT && DRIVERS_BOOTLOADERS
        help
            When the board uses the UAVCANv0 bootloader functionality you need a AppImageDescriptor defined


    menu "Publisher support"

        config CYPHAL_GNSS_PUBLISHER
            bool "GNSS Publisher"
            default n

        config CYPHAL_ESC_CONTROLLER
            bool "ESC Controller"
            default n

        config CYPHAL_READINESS_PUBLISHER
            bool "Readiness Publisher"
            default n

        config CYPHAL_UORB_ACTUATOR_OUTPUTS_PUBLISHER
            bool "uORB actuator_outputs publisher"
            default n

        config CYPHAL_UORB_SENSOR_GPS_PUBLISHER
            bool "uORB sensor_gps publisher"
            default n

    endmenu

    menu "Subscriber support"

        config CYPHAL_ESC_SUBSCRIBER
            bool "ESC Subscriber"
            default n

        config CYPHAL_GNSS_SUBSCRIBER_0
            bool "GNSS Subscriber 0"
            default n

        config CYPHAL_GNSS_SUBSCRIBER_1
            bool "GNSS Subscriber 1"
            default n

        config CYPHAL_BMS_SUBSCRIBER
            bool "BMS Subscriber"
            default n

        config CYPHAL_UORB_SENSOR_GPS_SUBSCRIBER
            bool "uORB sensor_gps Subscriber"
            default n
    endmenu

    menu "Advertised Services"
        config CYPHAL_GETINFO_RESPONDER
            bool "GetInfo1.0 responder"
            default y
            help
                Responds to uavcan.node.GetInfo.1.0 request sending over node information
                See https://github.com/UAVCAN/public_regulated_data_types/blob/master/uavcan/node/430.GetInfo.1.0.uavcan for full response

        config CYPHAL_EXECUTECOMMAND_RESPONDER
            bool "ExecuteCommand1.0 responder"
            default n
            help
                To be implemented
    endmenu

    menu "Service invokers"
    endmenu

endif #DRIVERS_CYPHAL
```

## src/drivers/differential_pressure/Kconfig
```kconfig
menu "Differential pressure"
    menuconfig COMMON_DIFFERENTIAL_PRESSURE
        bool "Common differential pressure module's"
        default n
        select DRIVERS_DIFFERENTIAL_PRESSURE_ETS
        select DRIVERS_DIFFERENTIAL_PRESSURE_MS4515
        select DRIVERS_DIFFERENTIAL_PRESSURE_MS4525DO
        select DRIVERS_DIFFERENTIAL_PRESSURE_MS5525DSO
        select DRIVERS_DIFFERENTIAL_PRESSURE_SDP3X
        ---help---
            Enable default set of differential pressure drivers
    rsource "*/Kconfig"
endmenu
```

## src/drivers/differential_pressure/asp5033/Kconfig
```kconfig
menuconfig DRIVERS_DIFFERENTIAL_PRESSURE_ASP5033
	bool "asp5033"
	default n
	---help---
		Enable support for asp5033
```

## src/drivers/differential_pressure/asp5033driver/Kconfig
```kconfig
menuconfig DRIVERS_DIFFERENTIAL_PRESSURE_ASP5033DRIVER
	bool "asp5033driver"
	default n
	---help---
		Enable support for asp5033driver
```

## src/drivers/differential_pressure/auav/Kconfig
```kconfig
menuconfig DRIVERS_DIFFERENTIAL_PRESSURE_AUAV
	bool "auav"
	default n
	---help---
		Enable support for AUAV
```

## src/drivers/differential_pressure/dlvr/Kconfig
```kconfig
menuconfig DRIVERS_DIFFERENTIAL_PRESSURE_DLVR
	bool "dlvr"
	default n
	---help---
		Enable support for DLVR
```

## src/drivers/differential_pressure/ms4515/Kconfig
```kconfig
menuconfig DRIVERS_DIFFERENTIAL_PRESSURE_MS4515
	bool "ms4515"
	default n
	---help---
		Enable support for ms4515
```

## src/drivers/differential_pressure/ms4525do/Kconfig
```kconfig
menuconfig DRIVERS_DIFFERENTIAL_PRESSURE_MS4525DO
	bool "ms4525do"
	default n
	---help---
		Enable support for ms4525do
```

## src/drivers/differential_pressure/ms5525dso/Kconfig
```kconfig
menuconfig DRIVERS_DIFFERENTIAL_PRESSURE_MS5525DSO
	bool "ms5525dso"
	default n
	---help---
		Enable support for ms5525dso
```

## src/drivers/differential_pressure/sdp6x/Kconfig
```kconfig
menuconfig DRIVERS_DIFFERENTIAL_PRESSURE_SDP6X
	bool "sdp6x"
	default n
	---help---
		Enable support for sdp6x
```

## src/drivers/distance_sensor/Kconfig
```kconfig
menu "Distance sensors"
    menuconfig COMMON_DISTANCE_SENSOR
        bool "Common distance sensor's"
        default n
        select DRIVERS_DISTANCE_SENSOR_CM8JL65
        select DRIVERS_DISTANCE_SENSOR_LEDDAR_ONE
        select DRIVERS_DISTANCE_SENSOR_LL40LS
        select DRIVERS_DISTANCE_SENSOR_LL40LS_PWM
        select DRIVERS_DISTANCE_SENSOR_MAPPYDOT
        select DRIVERS_DISTANCE_SENSOR_MB12XX
        select DRIVERS_DISTANCE_SENSOR_PGA460
        select DRIVERS_DISTANCE_SENSOR_LIGHTWARE_LASER_I2C
        select DRIVERS_DISTANCE_SENSOR_LIGHTWARE_LASER_SERIAL
        select DRIVERS_DISTANCE_SENSOR_SRF02
        select DRIVERS_DISTANCE_SENSOR_TERARANGER
        select DRIVERS_DISTANCE_SENSOR_TFMINI
        select DRIVERS_DISTANCE_SENSOR_ULANDING_RADAR
        select DRIVERS_DISTANCE_SENSOR_VL53L0X
        select DRIVERS_DISTANCE_SENSOR_VL53L1X
        select DRIVERS_DISTANCE_SENSOR_GY_US42
        ---help---
            Enable default set of distance sensor drivers

    rsource "*/Kconfig"
endmenu
```

## src/drivers/distance_sensor/broadcom/afbrs50/Kconfig
```kconfig
menuconfig DRIVERS_DISTANCE_SENSOR_BROADCOM_AFBRS50
	bool "AFBRS50"
	default n
	---help---
		Enable support for AFBRS50
```

## src/drivers/distance_sensor/gy_us42/Kconfig
```kconfig
menuconfig DRIVERS_DISTANCE_SENSOR_GY_US42
	bool "GY_US42"
	default n
	---help---
		Enable support for GY_US42
```

## src/drivers/distance_sensor/hps167/Kconfig
```kconfig
menuconfig DRIVERS_DISTANCE_SENSOR_HPS167
	bool "hps167"
	default n
	---help---
		Enable support for hps167
```

## src/drivers/distance_sensor/jre30/Kconfig
```kconfig
menuconfig DRIVERS_DISTANCE_SENSOR_JRE30
	bool "jre30"
	default n
	---help---
		Enable support for JAE JRE-30
```

## src/drivers/distance_sensor/lightware_grf_i2c/Kconfig
```kconfig
menuconfig DRIVERS_DISTANCE_SENSOR_LIGHTWARE_GRF_I2C
	bool "lightware_grf_i2c"
	default n
	---help---
		Enable support for lightware_grf_i2c
```

## src/drivers/distance_sensor/lightware_grf_serial/Kconfig
```kconfig
menuconfig DRIVERS_DISTANCE_SENSOR_LIGHTWARE_GRF_SERIAL
	bool "lightware_grf_serial"
	default n
	---help---
		Enable support for lightware_grf_serial
```

## src/drivers/distance_sensor/lightware_sf45_serial/Kconfig
```kconfig
menuconfig DRIVERS_DISTANCE_SENSOR_LIGHTWARE_SF45_SERIAL
	bool "lightware_sf45_serial"
	default n
	---help---
		Enable support for lightware_sf45_serial
```

## src/drivers/distance_sensor/nanoradar_can/Kconfig
```kconfig
menuconfig DRIVERS_DISTANCE_SENSOR_NANORADAR_CAN
	bool "nanoradar can"
	depends on DRIVERS_UAVCAN
	default n
	---help---
		Enable support for nanoradar can interface
```

## src/drivers/distance_sensor/rds02uf/Kconfig
```kconfig
menuconfig DRIVERS_DISTANCE_SENSOR_RDS02UF
	bool "rds02uf"
	default n
	---help---
		Enable support for rds02uf
```

## src/drivers/distance_sensor/sony/Kconfig
```kconfig
menuconfig DRIVERS_DISTANCE_SENSOR_SONY_ASDT1
	bool "sony_asdt1"
	default n
	---help---
		Enable support for sony_asdt1
```

## src/drivers/distance_sensor/tf02pro/Kconfig
```kconfig
menuconfig DRIVERS_DISTANCE_SENSOR_TF02PRO
	bool "tf02pro"
	default n
	---help---
		Enable support for tf02pro
```

## src/drivers/distance_sensor/tf_laser_i2c/Kconfig
```kconfig
menuconfig DRIVERS_DISTANCE_SENSOR_TF_LASER_I2C
	bool "tf_laser_i2c"
	default n
	---help---
		Enable support for tf_laser_i2c
```
