## src/drivers/temperature_sensor/tmp102/Kconfig
```kconfig
menuconfig DRIVERS_TEMPERATURE_SENSOR_TMP102
	bool "TMP102 temperature sensor"
	default n
	---help---
		Enable support TMP102 temperature sensor
```

## src/drivers/teseo_fw_proxy/Kconfig
```kconfig
menuconfig DRIVERS_TESEO_FW_PROXY
	bool "teseo_fw_proxy"
	default n
	depends on DRIVERS_UAVCANNODE
	---help---
		Mock DroneCAN file.Read -> Teseo X-Loader firmware update proxy.
		Demonstrates streaming a firmware image from the FC's file server
		to a Teseo GNSS module without local storage.
```

## src/drivers/tmotor_alpha_esc/Kconfig
```kconfig
menuconfig DRIVERS_TMOTOR_ALPHA_ESC
	bool "tmotor_alpha_esc"
	default n
	---help---
		Enable support for TMotor Alpha ESC
```

## src/drivers/transponder/Kconfig
```kconfig
menu "Transponder"
    menuconfig TRANSPONDER
        bool "Transponder"
        default n
        select DRIVERS_TRANSPONDER_SAGETECH_MXS
        ---help---
            Enable default set of transponder drivers

    rsource "*/Kconfig"
endmenu #transponder
```

## src/drivers/transponder/sagetech/mxs/Kconfig
```kconfig
menuconfig DRIVERS_TRANSPONDER_SAGETECH_MXS
	bool "mxs"
	default n
	---help---
		Enable support for mxs
```

## src/drivers/transponder/sagetech_mxs/Kconfig
```kconfig
menuconfig DRIVERS_TRANSPONDER_SAGETECH_MXS
	bool "sagetech_mxs"
	default n
	---help---
		Enable support for my_work_item
```

## src/drivers/tvs/Kconfig
```kconfig
menuconfig DRIVERS_TVS
	bool "tvs"
	default n
	---help---
		Enable support for Temperature and Voltage Sensor
```

## src/drivers/uavcan/Kconfig
```kconfig
menuconfig DRIVERS_UAVCAN
	bool "uavcan"
	default n
	---help---
		Enable support for uavcan

if DRIVERS_UAVCAN
    config UAVCAN_ARMING_CONTROLLER
        bool "Include arming status controller"
        default y

    config UAVCAN_BEEP_CONTROLLER
        bool "Include beep controller"
        default y

    config UAVCAN_OUTPUTS_CONTROLLER
        bool "Include servo & ESC controller"
        default y

    config UAVCAN_HARDPOINT_CONTROLLER
        bool "Include hardpoint controller"
        default y

    config UAVCAN_SAFETY_STATE_CONTROLLER
        bool "Include safety state controller"
        default y

    config UAVCAN_RGB_CONTROLLER
        bool "Include rgb controller"
        default y

    config UAVCAN_SENSOR_ACCEL
        bool "Subscribe to IMU:                         uavcan::equipment::ahrs::RawIMU"
        default y

    config UAVCAN_SENSOR_AIRSPEED
        bool "Subscribe to Airspeed:                    uavcan::equipment::air_data::IndicatedAirspeed | uavcan::equipment::air_data::TrueAirspeed | uavcan::equipment::air_data::StaticTemperature"
        default y

    config UAVCAN_SENSOR_BARO
        bool "Subscribe to Barometer:                   uavcan::equipment::air_data::StaticPressure | uavcan::equipment::air_data::StaticTemperature"
        default y

    config UAVCAN_SENSOR_BATTERY
        bool "Subscribe to Battery:                     uavcan::equipment::power::BatteryInfo | ardupilot::equipment::power::BatteryInfoAux"
        default y

    config UAVCAN_SENSOR_DIFFERENTIAL_PRESSURE
        bool "Subscribe to Differential Pressure:       uavcan::equipment::air_data::RawAirData"
        default y

    config UAVCAN_SENSOR_FLOW
        bool "Subscribe to Flow:                        com::hex::equipment::flow::Measurement"
        default y

    config UAVCAN_SENSOR_GNSS
        bool "Subscribe to GPS:                         uavcan::equipment::gnss::Auxiliary | uavcan::equipment::gnss::Fix | uavcan::equipment::gnss::Fix2"
        default y

    config UAVCAN_SENSOR_GNSS_RELATIVE
        bool "Subscribe to GPS Relative:                ardupilot::equipment::gnss::RelPosHeading"
        default y

    config UAVCAN_SENSOR_HYGROMETER
        bool "Subscribe to Hygrometer:                  dronecan::sensors::hygrometer::Hygrometer"
        default y

    config UAVCAN_SENSOR_ICE_STATUS
        bool "Subscribe to Internal Combustion Engine:  uavcan::equipment::ice::reciprocating::Status"
        default y

    config UAVCAN_SENSOR_MAG
        bool "Subscribe to Magnetometer:                uavcan::equipment::ahrs::MagneticFieldStrength | uavcan::equipment::ahrs::MagneticFieldStrength2"
        default y

    config UAVCAN_SENSOR_RANGEFINDER
        bool "Subscribe to Rangefinder:                 uavcan::equipment::range_sensor::Measurement"
        default y

    config UAVCAN_SENSOR_SAFETY_BUTTON
        bool "Subscribe to Safety Button:               ardupilot::indication::Button"
        default y

endif #DRIVERS_UAVCAN


menuconfig BOARD_UAVCAN_INTERFACES
depends on DRIVERS_UAVCAN || DRIVERS_UAVCANNODE
    int "UAVCANv0 interface count"
    default 2
    ---help---
        Interface count for UAVCANv0

menuconfig BOARD_UAVCAN_PERIPHERALS
depends on DRIVERS_UAVCAN
    string "UAVCAN peripheral firmware"
    help
        list of UAVCAN peripheral firmware to build and embed

menuconfig BOARD_UAVCAN_TIMER_OVERRIDE
depends on DRIVERS_UAVCAN
    int "UAVCAN timer override"
    default 0
```

## src/drivers/uavcan_v1/Kconfig
```kconfig
#
# For a description of the syntax of this configuration file,
# see the file kconfig-language.txt in the NuttX tools repository.
#
menuconfig DRIVERS_UAVCAN_V1
	bool "UAVCANv1"
	default n
	---help---
		Enable support for UAVCANv1

if DRIVERS_UAVCAN_V1
    choice
        prompt "UAVCANv1 Mode"

    config UAVCAN_V1_FMU
        bool "Server (FMU)"

    config UAVCAN_V1_CLIENT
        bool "Client (Peripheral)"

    endchoice

    config UAVCAN_V1_NODE_MANAGER
        bool "Node manager"
        default y
        depends on UAVCAN_V1_FMU
        help
            Implement UAVCAN v1 PNP server functionality and manages discovered nodes

    config UAVCAN_V1_NODE_CLIENT
        bool "Node client"
        default y
        depends on UAVCAN_V1_CLIENT
        help
            Implement UAVCAN v1 PNP client functionality

    config UAVCAN_V1_APP_DESCRIPTOR
        bool "UAVCAN v0 bootloader app descriptor"
        default n
        depends on UAVCAN_V1_CLIENT && DRIVERS_BOOTLOADERS
        help
            When the board uses the UAVCANv0 bootloader functionality you need a AppImageDescriptor defined


    menu "Publisher support"

        config UAVCAN_V1_GNSS_PUBLISHER
            bool "GNSS Publisher"
            default n

        config UAVCAN_V1_ESC_CONTROLLER
            bool "ESC Controller"
            default n

        config UAVCAN_V1_READINESS_PUBLISHER
            bool "Readiness Publisher"
            default n

        config UAVCAN_V1_UORB_ACTUATOR_OUTPUTS_PUBLISHER
            bool "uORB actuator_outputs publisher"
            default n

        config UAVCAN_V1_UORB_SENSOR_GPS_PUBLISHER
            bool "uORB sensor_gps publisher"
            default n

    endmenu

    menu "Subscriber support"

        config UAVCAN_V1_ESC_SUBSCRIBER
            bool "ESC Subscriber"
            default n

        config UAVCAN_V1_GNSS_SUBSCRIBER_0
            bool "GNSS Subscriber 0"
            default n

        config UAVCAN_V1_GNSS_SUBSCRIBER_1
            bool "GNSS Subscriber 1"
            default n

        config UAVCAN_V1_BMS_SUBSCRIBER
            bool "BMS Subscriber"
            default n

        config UAVCAN_V1_UORB_SENSOR_GPS_SUBSCRIBER
            bool "uORB sensor_gps Subscriber"
            default n
    endmenu

    menu "Advertised Services"
        config UAVCAN_V1_GETINFO_RESPONDER
            bool "GetInfo1.0 responder"
            default y
            help
                Responds to uavcan.node.GetInfo.1.0 request sending over node information
                See https://github.com/UAVCAN/public_regulated_data_types/blob/master/uavcan/node/430.GetInfo.1.0.uavcan for full response

        config UAVCAN_V1_EXECUTECOMMAND_RESPONDER
            bool "ExecuteCommand1.0 responder"
            default n
            help
                To be implemented
    endmenu

    menu "Service invokers"
    endmenu

endif #DRIVERS_UAVCAN_V1
```

## src/drivers/uavcannode/Kconfig
```kconfig
menuconfig DRIVERS_UAVCANNODE
	bool "uavcannode"
	default n
	---help---
		Enable support for uavcannode

if DRIVERS_UAVCANNODE
    config UAVCANNODE_ARMING_STATUS
        bool "Include arming status"
        default n

    config UAVCANNODE_BATTERY_INFO
        bool "Include battery info"
        default n

    config UAVCANNODE_BEEP_COMMAND
        bool "Include beep command"
        default n

    config UAVCANNODE_ESC_RAW_COMMAND
        bool "Include ESC raw command"
        default n

    config UAVCANNODE_ESC_STATUS
        bool "Include ESC status"
        default n

    config UAVCANNODE_FLOW_MEASUREMENT
        bool "Include flow measurement"
        default n

    config UAVCANNODE_GNSS_FIX
        bool "Include GNSS fix"
        default n

    config UAVCANNODE_HYGROMETER_MEASUREMENT
        bool "Include hygrometer measurement"
        default n

    config UAVCANNODE_LIGHTS_COMMAND
        bool "Include lights command"
        default n

    config UAVCANNODE_MAGNETIC_FIELD_STRENGTH
        bool "Include magnetic field strength"
        default n

    config UAVCANNODE_RANGE_SENSOR_MEASUREMENT
        bool "Include range sensor measurement"
        default n

    config UAVCANNODE_RAW_AIR_DATA
        bool "Include raw air data"
        default n

    config UAVCANNODE_RTK_DATA
        bool "Include RTK data"
        default n

    config UAVCANNODE_SAFETY_BUTTON
        bool "Include safety button"
        default n

    config UAVCANNODE_SERVO_ARRAY_COMMAND
        bool "Include servo array command"
        default n

    config UAVCANNODE_STATIC_PRESSURE
        bool "Include static pressure"
        default n

    config UAVCANNODE_STATIC_TEMPERATURE
        bool "Include static temperature"
        default n

endif #DRIVERS_UAVCANNODE
```

## src/drivers/uwb/Kconfig
```kconfig
menu "UWB"
    menuconfig COMMON_UWB
        bool "common UWB Drivers"
        default n
        select DRIVERS_UWB_UWB_SR150
        ---help---
            Enable support for uwb drivers
    rsource "*/Kconfig"
endmenu
```

## src/drivers/uwb/uwb_sr150/Kconfig
```kconfig
menuconfig DRIVERS_UWB_UWB_SR150
	bool "uwb_sr150"
	default n
	---help---
		Enable support for uwb sr150
```

## src/drivers/voxl2_io/Kconfig
```kconfig
menuconfig DRIVERS_VOXL2_IO
	bool "voxl2_io"
	default n
	---help---
		Enable support for voxl2_io
```

## src/drivers/vtx/Kconfig
```kconfig
menuconfig DRIVERS_VTX
	bool "VTX Driver"
	default n
	select DRIVERS_VTXTABLE
	select VTXTABLE_AUX_MAP
	---help---
		Control VTX devices via serial interface.

if DRIVERS_VTX

	config VTX_CRSF_MSP_SUPPORT
		bool "Support using CRSF MSP commands to configure VTX"
		depends on DRIVERS_RC_CRSF_RC
		default n
		---help---
			Set VTX frequency and power via CRSF MSP messages.

endif # DRIVERS_VTX
```

## src/drivers/vtxtable/Kconfig
```kconfig
menuconfig DRIVERS_VTXTABLE
	bool "VTX Table"
	default n
	---help---
		Manages the configuration of VTX frequencies and power levels.

if DRIVERS_VTXTABLE

	config VTXTABLE_CONFIG_FILE
		string "VTX Configuration File Path"
		default "/fs/microsd/vtx_config"
		---help---
			Allows saving/loading the VTX table and aux config
			from a file system.

	config VTXTABLE_USE_STORAGE
		bool
		default y if VTXTABLE_CONFIG_FILE != ""
		default n if !(VTXTABLE_CONFIG_FILE != "")

	config VTXTABLE_AUX_MAP
		string "VTX Auxiliary Map"
		default n
		---help---
			Enable the AUX map for mapping AUX channel ranges to VTX
			table settings.

endif # DRIVERS_VTXTABLE
```

## src/drivers/winch_eayload/Kconfig
```kconfig
menuconfig DRIVERS_WINCH_EAYLOAD
    bool "winch_eayload"
    default n
    ---help---
        Enable support for EayLoad-50/80 Winch Driver
```

## src/drivers/wind_sensor/Kconfig
```kconfig
menu "Wind Sensors"
    menuconfig COMMON_WIND_SENSOR
        bool "Common wind sensor's"
        default n
        select DRIVERS_WIND_SENSOR_FT_TECHNOLOGIES
        ---help---
            Enable default set of wind sensor drivers

    rsource "*/Kconfig"
endmenu
```

## src/drivers/wind_sensor/ft_technologies/Kconfig
```kconfig
menuconfig DRIVERS_WIND_SENSOR_FT_TECHNOLOGIES
	bool "ft7_technologies"
	default n
	---help---
		Enable support for ft7_technologies
```

## src/examples/actuator_controls_driver/Kconfig
```kconfig
menuconfig EXAMPLES_ACTUATOR_CONTROLS_DRIVER
	bool "actuator_controls_driver"
	default n
	---help---
		Enable support for actuator_controls_driver
```

## src/examples/cam_device_read/Kconfig
```kconfig
menuconfig EXAMPLES_CAM_DEVICE_READ
	bool "cam_device_read"
	default n
	---help---
		Enable support for cam_device_read
```

## src/examples/elm_lighting_module/Kconfig
```kconfig
menuconfig EXAMPLES_ELM_LIGHTING_MODULE
	bool "elm_lighting_module"
	default n
	---help---
		Enable support for elm_lighting_module
```

## src/examples/ext_update_checker/Kconfig
```kconfig
menuconfig EXAMPLES_EXT_UPDATE_CHECKER
	bool "ext_update_checker"
	default n
	---help---
		Enable support for ext_update_checker
```

## src/examples/fake_imu/Kconfig
```kconfig
menuconfig EXAMPLES_FAKE_IMU
	bool "fake_imu"
	default n
	---help---
		Enable support for fake_imu
```

## src/examples/pca_pwm_test/Kconfig
```kconfig
menuconfig EXAMPLES_PCA_PWM_TEST
	bool "pca_pwm_test"
	default n
	---help---
		Enable support for pca_pwm_test
```
