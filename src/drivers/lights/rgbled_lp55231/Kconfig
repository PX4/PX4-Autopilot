## src/drivers/lights/rgbled_lp55231/Kconfig
```kconfig
menuconfig DRIVERS_LIGHTS_RGBLED_LP55231
	bool "rgbled_lp55231"
	default n
	---help---
		Enable support for rgbled_lp55231
```

## src/drivers/lights/rgbled_lp5562/Kconfig
```kconfig
menuconfig DRIVERS_LIGHTS_RGBLED_LP5562
	bool "rgbled lp5562"
	default n
	---help---
		Enable support for RGBLED LP5562 driver
```

## src/drivers/linux_pwm_out/Kconfig
```kconfig
menuconfig DRIVERS_LINUX_PWM_OUT
	bool "linux_pwm_out"
	default n
	depends on PLATFORM_POSIX && !BOARD_TESTING
	---help---
		Enable support for linux_pwm_out
```

## src/drivers/magnetometer/Kconfig
```kconfig
menu "Magnetometer"
    menuconfig COMMON_MAGNETOMETER
        bool "Common Magnetometer's"
        default n
        select DRIVERS_MAGNETOMETER_AKM_AK8963
        select DRIVERS_MAGNETOMETER_AKM_AK09916
        select DRIVERS_MAGNETOMETER_BOSCH_BMM150
        select DRIVERS_MAGNETOMETER_HMC5883
        select DRIVERS_MAGNETOMETER_QMC5883L
        select DRIVERS_MAGNETOMETER_ISENTEK_IST8308
        select DRIVERS_MAGNETOMETER_ISENTEK_IST8310
        select DRIVERS_MAGNETOMETER_LIS2MDL
        select DRIVERS_MAGNETOMETER_LIS3MDL
        select DRIVERS_MAGNETOMETER_LSM303AGR
        select DRIVERS_MAGNETOMETER_RM3100
        select DRIVERS_MAGNETOMETER_VTRANTECH_VCM1193L
        ---help---
            Enable default set of magnetometer drivers
    rsource "*/Kconfig"
endmenu
```

## src/drivers/magnetometer/akm/ak09916/Kconfig
```kconfig
menuconfig DRIVERS_MAGNETOMETER_AKM_AK09916
	bool "ak09916"
	default n
	---help---
		Enable support for ak09916
```

## src/drivers/magnetometer/akm/ak09940a/Kconfig
```kconfig
menuconfig DRIVERS_MAGNETOMETER_AKM_AK09940A
	bool "ak09940a"
	default n
	---help---
		Enable support for ak09940a
```

## src/drivers/magnetometer/akm/ak8963/Kconfig
```kconfig
menuconfig DRIVERS_MAGNETOMETER_AKM_AK8963
	bool "ak8963"
	default n
	---help---
		Enable support for ak8963
```

## src/drivers/magnetometer/bosch/bmm150/Kconfig
```kconfig
menuconfig DRIVERS_MAGNETOMETER_BOSCH_BMM150
	bool "bmm150"
	default n
	---help---
		Enable support for bosch bmm150
```

## src/drivers/magnetometer/bosch/bmm350/Kconfig
```kconfig
menuconfig DRIVERS_MAGNETOMETER_BOSCH_BMM350
	bool "bmm350"
	default n
	---help---
		Enable support for bosch bmm350
```

## src/drivers/magnetometer/isentek/ist8308/Kconfig
```kconfig
menuconfig DRIVERS_MAGNETOMETER_ISENTEK_IST8308
	bool "IST8308"
	default n
	---help---
		Enable support for isentek IST8308
```

## src/drivers/magnetometer/isentek/ist8310/Kconfig
```kconfig
menuconfig DRIVERS_MAGNETOMETER_ISENTEK_IST8310
	bool "IST8310"
	default n
	---help---
		Enable support for isentek IST8310
```

## src/drivers/magnetometer/isentek/ist8310j/Kconfig
```kconfig
menuconfig DRIVERS_MAGNETOMETER_ISENTEK_IST8310J
	bool "IST8310J"
	default n
	---help---
		Enable support for isentek IST8310J
```

## src/drivers/magnetometer/memsic/mmc5616/Kconfig
```kconfig
menuconfig DRIVERS_MAGNETOMETER_MEMSIC_MMC5616
	bool "mmc5616"
	default n
	---help---
		Enable support for Memsic MMC5616
```

## src/drivers/magnetometer/memsic/mmc5983ma/Kconfig
```kconfig
menuconfig DRIVERS_MAGNETOMETER_MEMSIC_MMC5983MA
	bool "mmc5983ma"
	default n
	---help---
		Enable support for mmc5983ma
```

## src/drivers/magnetometer/qmc5883p/Kconfig
```kconfig
menuconfig DRIVERS_MAGNETOMETER_QMC5883P
	bool "qmc5883p"
	default n
	---help---
		Enable support for qmc5883p
```

## src/drivers/magnetometer/st/iis2mdc/Kconfig
```kconfig
menuconfig DRIVERS_MAGNETOMETER_ST_IIS2MDC
	bool "iis2mdc"
	default n
	---help---
		Enable support for iis2mdc
```

## src/drivers/magnetometer/voltafield/af9838/Kconfig
```kconfig
menuconfig DRIVERS_MAGNETOMETER_VOLTAFIELD_AF9838
    bool "Voltafield AF9838 magnetometer (I2C)"
    default n
    ---help---
        Enable support for Voltafield AF9838
```

## src/drivers/magnetometer/vtrantech/vcm1193l/Kconfig
```kconfig
menuconfig DRIVERS_MAGNETOMETER_VTRANTECH_VCM1193L
	bool "VCM1193L"
	default n
	---help---
		Enable support for Vtrantech VCM1193L
```
