## src/drivers/rc/crsf/Kconfig
```kconfig
menuconfig DRIVERS_RC_CRSF
	bool "crsf"
	default n
	---help---
		Enable support for crsf rc
```

## src/drivers/rc/crsf_rc/Kconfig
```kconfig
menuconfig DRIVERS_RC_CRSF_RC
	bool "crsf_rc"
	default n
	---help---
		Enable support for crsf rc

if DRIVERS_RC_CRSF_RC

config RC_CRSF_INJECT
	bool "Inject CRSF RC"
	default n
	---help---
		Enable this to inject CRSF RC commands.

endif # DRIVERS_RC_CRSF_RC
```

## src/drivers/rc/dsm_rc/Kconfig
```kconfig
menuconfig DRIVERS_RC_DSM_RC
	bool "dsm_rc"
	default n
	---help---
		Enable support for dsm_rc
```

## src/drivers/rc/ghst_rc/Kconfig
```kconfig
menuconfig DRIVERS_RC_GHST_RC
	bool "ghst_rc"
	default n
	---help---
		Enable support for ghst_rc
```

## src/drivers/rc/ppm_in/Kconfig
```kconfig
menuconfig DRIVERS_RC_PPM_IN
	bool "ppm_in"
	default n
	---help---
		Enable support for ppm_in
```

## src/drivers/rc/sbus/Kconfig
```kconfig
menuconfig DRIVERS_RC_SBUS
	bool "sbus"
	default n
	---help---
		Enable support for sbus
```

## src/drivers/rc/sbus_rc/Kconfig
```kconfig
menuconfig DRIVERS_RC_SBUS_RC
	bool "sbus_rc"
	default n
	---help---
		Enable support for sbus_rc
```

## src/drivers/rc/spektrum_dsm/Kconfig
```kconfig
menuconfig DRIVERS_RC_SPEKTRUM_DSM
	bool "spektrum_dsm"
	default n
	---help---
		Enable support for spektrum_dsm
```

## src/drivers/rc_input/Kconfig
```kconfig
menuconfig DRIVERS_RC_INPUT
	bool "rc_input"
	default n
	select MODULES_RC_UPDATE
	---help---
		Enable support for rc_input
```

## src/drivers/roboclaw/Kconfig
```kconfig
menuconfig DRIVERS_ROBOCLAW
	bool "crsf_rc"
	default n
	---help---
		Enable support for roboclaw
```

## src/drivers/rover_interface/Kconfig
```kconfig
menuconfig DRIVERS_ROVER_INTERFACE
        bool "rover_interface"
        default n
        ---help---
                Enable support for rover_interface
```

## src/drivers/rpm/Kconfig
```kconfig
menu "RPM"
    menuconfig COMMON_RPM
        bool "Common RPM drivers"
        default n
        select DRIVERS_RPM_PCF8583
        select DRIVERS_RPM_RPM_SIMULATOR
        ---help---
            Enable default set of RPM drivers
    rsource "*/Kconfig"
endmenu
```

## src/drivers/rpm_capture/Kconfig
```kconfig
menuconfig DRIVERS_RPM_CAPTURE
	bool "rpm_capture"
	default n
	---help---
		Enable support for rpm_capture
```

## src/drivers/smart_battery/Kconfig
```kconfig
menu "Smart battery"
    menuconfig COMMON_SMART_BATTERIES
        bool "Common Smart battery drivers"
        default n
        select DRIVERS_SMART_BATTERY_BATMON
        select DRIVERS_SMART_BATTERY_BQ40Z80
        select DRIVERS_SMART_BATTERY_SBS_GENERIC
        ---help---
            Enable smart battery drivers
    rsource "*/Kconfig"
endmenu
```

## src/drivers/smart_battery/bq40z80/Kconfig
```kconfig
menuconfig DRIVERS_SMART_BATTERY_BQ40Z80
	bool "BQ40Z80"
	default n
	---help---
		Enable support for TI BQ40Z80 based smart batteries
```

## src/drivers/smart_battery/sbs_generic/Kconfig
```kconfig
menuconfig DRIVERS_SMART_BATTERY_SBS_GENERIC
	bool "SBS Generic"
	default n
	---help---
		Enable generic Smart Battery System battery support
```

## src/drivers/spi_led/Kconfig
```kconfig
menuconfig DRIVERS_SPI_LED
	bool "spi_led"
	default n
	---help---
		Enable support for spi_led
```

## src/drivers/stub_keystore/Kconfig
```kconfig
menu "stub_keystore configuration"
	menuconfig DRIVERS_STUB_KEYSTORE
	bool "stub_keystore"
	default n
	---help---
		Enable support for stub_keystore

	menuconfig PUBLIC_KEY0
	string "Path to public key 0"
	depends on DRIVERS_STUB_KEYSTORE

	menuconfig PUBLIC_KEY1
	string "Path to public key 1"
	depends on DRIVERS_STUB_KEYSTORE

	menuconfig PUBLIC_KEY2
	string "Path to public key 2"
	depends on DRIVERS_STUB_KEYSTORE

	menuconfig PUBLIC_KEY3
	string "Path to public key 3"
	depends on DRIVERS_STUB_KEYSTORE
endmenu
```

## src/drivers/sw_crypto/Kconfig
```kconfig
menuconfig DRIVERS_SW_CRYPTO
	bool "sw_crypto"
	depends on BOARD_CRYPTO
	default n
	---help---
		Enable support for sw_crypto
```

## src/drivers/tap_esc/Kconfig
```kconfig
menuconfig DRIVERS_TAP_ESC
	bool "tap_esc"
	default n
	---help---
		Enable support for tap_esc
```

## src/drivers/tattu_can/Kconfig
```kconfig
menuconfig DRIVERS_TATTU_CAN
	bool "tattu_can"
	default n
	---help---
		Enable support for tattu_can
```

## src/drivers/telemetry/Kconfig
```kconfig
menu "Telemetry"
    menuconfig COMMON_TELEMETRY
        bool "Common telemetry module's"
        default n
        select DRIVERS_TELEMETRY_BST
        select DRIVERS_TELEMETRY_FRSKY_TELEMETRY
        select DRIVERS_TELEMETRY_HOTT
        ---help---
            Enable default set of telemetry drivers
    rsource "*/Kconfig"
endmenu
```

## src/drivers/temperature_sensor/mcp9808/Kconfig
```kconfig
menuconfig DRIVERS_TEMPERATURE_SENSOR_MCP9808
	bool "MCP9808 temperature sensor"
	default n
	---help---
		Enable support MCP9808 temperature sensor
```

## src/drivers/temperature_sensor/pct2075tp/Kconfig
```kconfig
menuconfig DRIVERS_TEMPERATURE_SENSOR_PCT2075TP
	bool "PCT2075TP temperature sensor"
	default n
	---help---
		Enable support for PCT2075TP temperature sensor
```
