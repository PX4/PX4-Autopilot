## src/examples/px4_my_hello/Kconfig
```kconfig
menuconfig EXAMPLES_PX4_MY_HELLO
	bool "PX4 myhello"
	default n
	---help---
		Enable PX4 simple app PDJ
```

## src/examples/px4_queue/Kconfig
```kconfig
menuconfig EXAMPLES_PX4_QUEUE
	bool "px4_item"
	default n
	---help---
		Enable support for px4_item
```

## src/examples/px4_simple_app/Kconfig
```kconfig
 menuconfig EXAMPLES_PX4_SIMPLE_APP
	bool "PX4 Simple app"
 	default n
 	---help---
 		Enable PX4 simple app
```

## src/examples/sr_thruster_controller/Kconfig
```kconfig
menuconfig EXAMPLES_SR_THRUSTER_CONTROLLER
	bool "sr_thruster_controller"
	default n
	---help---
		Enable support for SR Thruster Controller
```

## src/examples/tilt_controller/Kconfig
```kconfig
menuconfig EXAMPLES_TILT_CONTROLLER
	bool "tilt_controller"
	default n
	---help---
		Enable support for tilt_controller

menuconfig USER_TILT_CONTROLLER
	bool "tilt_controller running as userspace module"
	default y
	depends on BOARD_PROTECTED && EXAMPLES_TILT_CONTROLLER
	---help---
		Put tilt_controller in userspace memory
```

## src/lib/cdrstream/Kconfig
```kconfig
config LIB_CDRSTREAM
	bool
	default n
	---help---
		Enable CDR stream serializer library
```

## src/lib/landing_target_estimator/Kconfig
```kconfig
menuconfig MODULES_LANDING_TARGET_ESTIMATOR
	bool "landing_target_estimator"
	default n
	---help---
		Enable support for landing_target_estimator

menuconfig USER_LANDING_TARGET_ESTIMATOR
	bool "landing_target_estimator running as userspace module"
	default y
	depends on BOARD_PROTECTED && MODULES_LANDING_TARGET_ESTIMATOR
	---help---
		Put landing_target_estimator in userspace memory
```

## src/lib/parameters/Kconfig
```kconfig
menuconfig PARAM_PRIMARY
	bool "parameter primary"
	default n
	---help---
		Enable support for the parameter primary in distributed board architectures

menuconfig PARAM_REMOTE
	bool "parameter remote"
	default n
	---help---
		Enable support for the parameter remote in distributed board architectures
```

## src/lib/rid_identity_record/Kconfig
```kconfig
menuconfig BOARD_ODID_RID_IDENTITY
	bool "Open Drone ID RID identity verification"
	default n
	---help---
		Enable RID Basic ID identity verification for Open Drone ID.
		The storage backend and verification policy are implementation-defined.
```

## src/lib/rl_tools/Kconfig
```kconfig
config LIB_RL_TOOLS
	bool "RLtools"
	default n
	---help---
		RLtools is a header-only library for reinforcement learning and neural networks.
		It enables running trained RL policies on embedded devices.
		This library is used for running RL-based controllers on the PX4 autopilot.
```

## src/lib/tensorflow_lite_micro/Kconfig
```kconfig
config LIB_TFLM
	bool "TensorFlow Lite Micro"
	default n
	---help---
		TensorFlow Lite Micro is a lightweight version of TensorFlow Lite designed for microcontrollers and other resource-constrained devices.
		It enables running machine learning models on devices with limited computational power and memory.
		This library is used for running neural networks on the PX4 autopilot.
```

## src/modules/Kconfig
```kconfig
menuconfig AIRSHIP_ATT_CONTROL
	bool "airship att control Support"
	default n
	---help---
		Enable support for airship att control
		
menuconfig AIRSPEED_SELECTOR
	bool "airspeed selector Support"
	default n
	---help---
		Enable support for airspeed selector
		
menuconfig ANGULAR_VELOCITY_CONTROLLER
	bool "angular velocity controller Support"
	default n
	---help---
		Enable support for angular velocity controller
		
menuconfig ATTITUDE_ESTIMATOR_Q
	bool "attitude estimator q Support"
	default n
	---help---
		Enable support for attitude estimator q
		
menuconfig BATTERY_STATUS
	bool "battery status Support"
	default n
	---help---
		Enable support for battery status
		
menuconfig CAMERA_FEEDBACK
	bool "camera feedback Support"
	default n
	---help---
		Enable support for camera feedback
		
menuconfig COMMANDER
	bool "commander Support"
	default n
	---help---
		Enable support for commander
		
menuconfig CONTROL_ALLOCATOR
	bool "control allocator Support"
	default n
	---help---
		Enable support for control allocator
		
menuconfig DATAMAN
	bool "dataman Support"
	default n
	---help---
		Enable support for dataman
		
menuconfig EKF2
	bool "ekf2 Support"
	default n
	---help---
		Enable support for ekf2
		
menuconfig ESC_BATTERY
	bool "esc battery Support"
	default n
	---help---
		Enable support for esc battery
		
menuconfig EVENTS
	bool "events Support"
	default n
	---help---
		Enable support for events
		
menuconfig FLIGHT_MODE_MANAGER
	bool "flight mode manager Support"
	default n
	---help---
		Enable support for flight mode manager
		
menuconfig FW_ATT_CONTROL
	bool "fw att control Support"
	default n
	---help---
		Enable support for fw att control
		
menuconfig FW_POS_CONTROL_L1
	bool "fw pos control l1 Support"
	default n
	---help---
		Enable support for fw pos control l1
		
menuconfig GYRO_FFT
	bool "gyro fft Support"
	default n
	---help---
		Enable support for gyro fft
		
menuconfig LAND_DETECTOR
	bool "land detector Support"
	default n
	---help---
		Enable support for land detector
		
menuconfig LANDING_TARGET_ESTIMATOR
	bool "landing target estimator Support"
	default n
	---help---
		Enable support for landing target estimator
		
menuconfig LOAD_MON
	bool "load mon Support"
	default n
	---help---
		Enable support for load mon
		
menuconfig LOCAL_POSITION_ESTIMATOR
	bool "local position estimator Support"
	default n
	---help---
		Enable support for local position estimator
		
menuconfig LOGGER
	bool "logger Support"
	default n
	---help---
		Enable support for logger
		
menuconfig MAVLINK
	bool "mavlink Support"
	default n
	---help---
		Enable support for mavlink
		
menuconfig MC_ATT_CONTROL
	bool "mc att control Support"
	default n
	---help---
		Enable support for mc att control
		
menuconfig MC_HOVER_THRUST_ESTIMATOR
	bool "mc hover thrust estimator Support"
	default n
	---help---
		Enable support for mc hover thrust estimator
		
menuconfig MC_POS_CONTROL
	bool "mc pos control Support"
	default n
	---help---
		Enable support for mc pos control
		
menuconfig MC_RATE_CONTROL
	bool "mc rate control Support"
	default n
	---help---
		Enable support for mc rate control
		
menuconfig MICRORTPS_BRIDGE
	bool "micrortps bridge Support"
	default n
	---help---
		Enable support for micrortps bridge
		
menuconfig MUORB
	bool "muorb Support"
	default n
	---help---
		Enable support for muorb
		
menuconfig NAVIGATOR
	bool "navigator Support"
	default n
	---help---
		Enable support for navigator
		
menuconfig PX4IOFIRMWARE
	bool "px4iofirmware Support"
	default n
	---help---
		Enable support for px4iofirmware
		
menuconfig RC_UPDATE
	bool "rc update Support"
	default n
	---help---
		Enable support for rc update
		
menuconfig REPLAY
	bool "replay Support"
	default n
	---help---
		Enable support for replay
		
menuconfig ROVER_POS_CONTROL
	bool "rover pos control Support"
	default n
	---help---
		Enable support for rover pos control
		
menuconfig SENSORS
	bool "sensors Support"
	default n
	---help---
		Enable support for sensors
		
menuconfig SIH
	bool "sih Support"
	default n
	---help---
		Enable support for sih
		
menuconfig SIMULATOR
	bool "simulator Support"
	default n
	---help---
		Enable support for simulator
		
menuconfig TEMPERATURE_COMPENSATION
	bool "temperature compensation Support"
	default n
	---help---
		Enable support for temperature compensation
		
menuconfig UUV_ATT_CONTROL
	bool "uuv att control Support"
	default n
	---help---
		Enable support for uuv att control
		
menuconfig UUV_POS_CONTROL
	bool "uuv pos control Support"
	default n
	---help---
		Enable support for uuv pos control
		
menuconfig VMOUNT
	bool "vmount Support"
	default n
	---help---
		Enable support for vmount
		
menuconfig VTOL_ATT_CONTROL
	bool "vtol att control Support"
	default n
	---help---
		Enable support for vtol att control
```

## src/modules/accel_custom_module/Kconfig
```kconfig
menuconfig MODULES_ACCEL_CUSTOM_MODULE
	bool "accel_custom_module"
	default n
	---help---
		Enable support for accel_custom_module
```

## src/modules/airship_att_control/Kconfig
```kconfig
menuconfig MODULES_AIRSHIP_ATT_CONTROL
	bool "airship_att_control"
	default n
	---help---
		Enable support for airship_att_control

menuconfig USER_AIRSHIP_ATT_CONTROL
	bool "airship_att_control running as userspace module"
	default y
	depends on BOARD_PROTECTED && MODULES_AIRSHIP_ATT_CONTROL
	---help---
		Put airship_att_control in userspace memory
```

## src/modules/airspeed_selector/Kconfig
```kconfig
menuconfig MODULES_AIRSPEED_SELECTOR
	bool "airspeed_selector"
	default n
	---help---
		Enable support for airspeed_selector

menuconfig USER_AIRSPEED_SELECTOR
	bool "airspeed_selector running as userspace module"
	default y
	depends on BOARD_PROTECTED && MODULES_AIRSPEED_SELECTOR
	---help---
		Put airspeed_selector in userspace memory
```

## src/modules/android/Kconfig
```kconfig
menu "Android"
    menuconfig COMMON_ANDROID
        bool "Common android modules"
        default n
        select MODULES_ANDROID_SENSOR_ACCEL_NDK
        select MODULES_ANDROID_SENSOR_GYRO_NDK
        select MODULES_ANDROID_SENSOR_MAG_NDK
        ---help---
            Enable default set of android modules
    rsource "*/Kconfig"
endmenu
```

## src/modules/android/sensor_accel_ndk/Kconfig
```kconfig
menuconfig MODULES_ANDROID_SENSOR_ACCEL_NDK
	bool "sensor_accel_ndk"
	default n
	---help---
		Enable support for sensor_accel_ndk
```

## src/modules/android/sensor_gyro_ndk/Kconfig
```kconfig
menuconfig MODULES_ANDROID_SENSOR_GYRO_NDK
	bool "sensor_gyro_ndk"
	default n
	---help---
		Enable support for sensor_gyro_ndk
```

## src/modules/android/sensor_mag_ndk/Kconfig
```kconfig
menuconfig MODULES_ANDROID_SENSOR_MAG_NDK
	bool "sensor_mag_ndk"
	default n
	---help---
		Enable support for sensor_mag_ndk
```

## src/modules/angular_velocity_controller/Kconfig
```kconfig
menuconfig MODULES_ANGULAR_VELOCITY_CONTROLLER
	bool "angular_velocity_controller"
	default n
	---help---
		Enable support for angular_velocity_controller

menuconfig USER_ANGULAR_VELOCITY_CONTROLLER
	bool "angular_velocity_controller running as userspace module"
	default y
	depends on BOARD_PROTECTED && MODULES_ANGULAR_VELOCITY_CONTROLLER
	---help---
		Put angular_velocity_controller in userspace memory
```

## src/modules/attitude_estimator_q/Kconfig
```kconfig
menuconfig MODULES_ATTITUDE_ESTIMATOR_Q
	bool "attitude_estimator_q"
	default n
	---help---
		Enable support for attitude_estimator_q

menuconfig USER_ATTITUDE_ESTIMATOR_Q
	bool "attitude_estimator_q running as userspace module"
	default n
	depends on BOARD_PROTECTED && MODULES_ATTITUDE_ESTIMATOR_Q
	---help---
		Put attitude_estimator_q in userspace memory
```

## src/modules/auxiliary_actuators_controller/Kconfig
```kconfig
menuconfig MODULES_AUXILIARY_ACTUATORS_CONTROLLER
	bool "auxiliary_actuators_controller"
	default n
	---help---
		Enable support for auxiliary_actuators_controller
```

## src/modules/baro_thrust_estimator/Kconfig
```kconfig
menuconfig MODULES_BARO_THRUST_ESTIMATOR
	bool "baro_thrust_estimator"
	default y
	depends on SENSORS_VEHICLE_AIR_DATA
	---help---
		Enable support for baro_thrust_estimator

menuconfig USER_BARO_THRUST_ESTIMATOR
	bool "baro_thrust_estimator running as userspace module"
	default y
	depends on BOARD_PROTECTED && MODULES_BARO_THRUST_ESTIMATOR
	---help---
		Put baro_thrust_estimator in userspace memory
```

## src/modules/battery_status/Kconfig
```kconfig
menuconfig MODULES_BATTERY_STATUS
	bool "battery_status"
	default n
	---help---
		Enable support for battery_status

menuconfig USER_BATTERY_STATUS
	bool "battery_status running as userspace module"
	default n
	depends on BOARD_PROTECTED && MODULES_BATTERY_STATUS
	---help---
		Put battery_status in userspace memory
```
