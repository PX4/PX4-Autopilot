## src/systemcmds/mft_cfg/Kconfig
```kconfig
menuconfig SYSTEMCMDS_MFT_CFG
	bool "mft_cfg"
	default n
	---help---
		Enable support for mft_cfg
```

## src/systemcmds/microbench/Kconfig
```kconfig
menuconfig SYSTEMCMDS_MICROBENCH
	bool "microbench"
	default n
	---help---
		Enable support for microbench
```

## src/systemcmds/mixer/Kconfig
```kconfig
menuconfig SYSTEMCMDS_MIXER
	bool "mixer"
	default n
	---help---
		Enable support for mixer

menuconfig USER_MIXER
	bool "mixer running as userspace module"
	default y
	depends on BOARD_PROTECTED && SYSTEMCMDS_MIXER
	---help---
		Put mixer in userspace memory
```

## src/systemcmds/mklittlefs/Kconfig
```kconfig
menuconfig SYSTEMCMDS_MKLITTLEFS
	bool "mklittlefs"
	default n
	---help---
		Enable support for mklittlefs

menuconfig USER_MKLITTLEFS
	bool "mklittlefs running as userspace module"
	default y
	depends on BOARD_PROTECTED && SYSTEMCMDS_MKLITTLEFS
	---help---
		Put mklittlefs in userspace memory
```

## src/systemcmds/motor_ramp/Kconfig
```kconfig
menuconfig SYSTEMCMDS_MOTOR_RAMP
	bool "motor_ramp"
	default n
	---help---
		Enable support for motor_ramp

menuconfig USER_MOTOR_RAMP
	bool "motor_ramp running as userspace module"
	default y
	depends on BOARD_PROTECTED && SYSTEMCMDS_MOTOR_RAMP
	---help---
		Put motor_ramp in userspace memory
```

## src/systemcmds/motor_test/Kconfig
```kconfig
menuconfig SYSTEMCMDS_MOTOR_TEST
	bool "motor_test"
	default n
	---help---
		Enable support for motor_test

menuconfig USER_MOTOR_TEST
	bool "motor_test running as userspace module"
	default y
	depends on BOARD_PROTECTED && SYSTEMCMDS_MOTOR_TEST
	---help---
		Put motor_test in userspace memory
```

## src/systemcmds/mtd/Kconfig
```kconfig
menuconfig SYSTEMCMDS_MTD
	bool "mtd"
	default n
	depends on PLATFORM_NUTTX
	---help---
		Enable support for mtd

menuconfig USER_MTD
	bool "mtd running as userspace module"
	default y
	depends on BOARD_PROTECTED && SYSTEMCMDS_MTD
	---help---
		Put mtd in userspace memory
```

## src/systemcmds/netconfig/Kconfig
```kconfig
menuconfig SYSTEMCMDS_NETCONFIG
	bool "netconfig"
	default n
	---help---
		Enable support for netconfig

menuconfig USER_NETCONFIG
	bool "netconfig running as userspace module"
	default y
	depends on BOARD_PROTECTED && SYSTEMCMDS_NETCONFIG
	---help---
		Put netconfig in userspace memory

if SYSTEMCMDS_NETCONFIG

comment "IPv4 Addresses"

config NETCONFIG_IFNAME
	string "Target net interface"
	default "eth0"
	---help---
		Set the network interface name for the PX4. Default "eth0"

config NETCONFIG_IPSUBNET
	hex "Target IP subnet"
	default 0x00c9a8c0
	---help---
		Set the subnet for the PX4. The actual IP is generated from this mask and MAV_SYS_ID. Default 192.168.201.0

config NETCONFIG_DRIPADDR
	hex "Router IPv4 address"
	default 0x01c9a8c0
	---help---
		Set the subnet mask for the PX4. Default 192.168.201.1

config NETCONFIG_NETMASK
	hex "Target IP subnet mask"
	default 0x00ffffff
	---help---
		Set the subnet mask for the PX4

endif # SYSTEMCMDS_NETCONFIG
```

## src/systemcmds/netman/Kconfig
```kconfig
menuconfig SYSTEMCMDS_NETMAN
	bool "netman"
	default n
	---help---
		Enable support for netman

menuconfig USER_NETMAN
	bool "netman running as userspace module"
	default y
	depends on BOARD_PROTECTED && SYSTEMCMDS_NETMAN
	---help---
		Put netman in userspace memory

config NETMAN_FALLBACK_IPADDR
	hex "Fallback IPv4 address"
	default 0XC0A80003
	depends on SYSTEMCMDS_NETMAN
	---help---
		If NETINIT_DHCPC is set, getting an IP from DHCP server is first attempted.
		If this fails, this IP address is used as a static fallback.
```

## src/systemcmds/nshterm/Kconfig
```kconfig
menuconfig SYSTEMCMDS_NSHTERM
	bool "nshterm"
	default n
	depends on PLATFORM_NUTTX
	---help---
		Enable support for nshterm

menuconfig USER_NSHTERM
	bool "nshterm running as userspace module"
	default y
	depends on BOARD_PROTECTED && SYSTEMCMDS_NSHTERM
	---help---
		Put nshterm in userspace memory
```

## src/systemcmds/pairing_button_sim/Kconfig
```kconfig
menuconfig SYSTEMCMDS_PAIRING_BUTTON_SIM
	bool "pairing_button_sim"
	default n
	---help---
		Enable support for pairing_button_sim
```

## src/systemcmds/param/Kconfig
```kconfig
menuconfig SYSTEMCMDS_PARAM
	bool "param"
	default n
	---help---
		Enable support for param

config USER_PARAM
	bool
	default y
	depends on BOARD_PROTECTED && SYSTEMCMDS_PARAM
```

## src/systemcmds/perf/Kconfig
```kconfig
menuconfig SYSTEMCMDS_PERF
	bool "perf"
	default n
	---help---
		Enable support for perf

config USER_PERF
	bool
	default y
	depends on BOARD_PROTECTED && SYSTEMCMDS_PERF
	---help---
		Put perf in userspace memory
```

## src/systemcmds/pwm/Kconfig
```kconfig
menuconfig SYSTEMCMDS_PWM
	bool "pwm"
	default n
	---help---
		Enable support for pwm

menuconfig USER_PWM
	bool "pwm running as userspace module"
	default n
	depends on BOARD_PROTECTED && SYSTEMCMDS_PWM
	---help---
		Put pwm in userspace memory
```

## src/systemcmds/px4log/Kconfig
```kconfig
menuconfig SYSTEMCMDS_PX4LOG
	bool "px4log"
	default n
	---help---
		Enable support for px4log

menuconfig USER_PX4LOG
	bool "px4log running as userspace module"
	default n
	depends on BOARD_PROTECTED && SYSTEMCMDS_PX4LOG
	---help---
		Put px4log in userspace memory
```

## src/systemcmds/px4log_tail/Kconfig
```kconfig
menuconfig SYSTEMCMDS_PX4LOG_TAIL
	bool "px4log_tail"
	default n
	---help---
		Enable support for px4log_tail

menuconfig USER_PX4LOG_TAIL
	bool "px4log_tail running as userspace module"
	default n
	depends on BOARD_PROTECTED && SYSTEMCMDS_PX4LOG_TAIL
	---help---
		Put px4log_tail in userspace memory
```

## src/systemcmds/rdfeat/Kconfig
```kconfig
menuconfig SYSTEMCMDS_RDFEAT
	bool "rdfeat"
	default y
	---help---
		Enable support for rdfeat
```

## src/systemcmds/reboot/Kconfig
```kconfig
menuconfig SYSTEMCMDS_REBOOT
	bool "reboot"
	default n
	---help---
		Enable support for reboot

menuconfig USER_REBOOT
	bool "reboot running as userspace module"
	default y
	depends on BOARD_PROTECTED && SYSTEMCMDS_REBOOT
	---help---
		Put reboot in userspace memory
```

## src/systemcmds/reflect/Kconfig
```kconfig
menuconfig SYSTEMCMDS_REFLECT
	bool "reflect"
	default n
	---help---
		Enable support for reflect

menuconfig USER_REFLECT
	bool "reflect running as userspace module"
	default y
	depends on BOARD_PROTECTED && SYSTEMCMDS_REFLECT
	---help---
		Put reflect in userspace memory
```

## src/systemcmds/reset/Kconfig
```kconfig
menuconfig SYSTEMCMDS_RESET
	bool "reset"
	default n
	---help---
		Enable support for reset

menuconfig USER_RESET
	bool "reset running as userspace module"
	default y
	depends on BOARD_PROTECTED && SYSTEMCMDS_RESET
	---help---
		Put reset in userspace memory
```

## src/systemcmds/sd_bench/Kconfig
```kconfig
menuconfig SYSTEMCMDS_SD_BENCH
	bool "sd_bench"
	default n
	---help---
		Enable support for sd_bench

menuconfig USER_SD_BENCH
	bool "sd_bench running as userspace module"
	default y
	depends on BOARD_PROTECTED && SYSTEMCMDS_SD_BENCH
	---help---
		Put sd_bench in userspace memory
```

## src/systemcmds/sd_stress/Kconfig
```kconfig
menuconfig SYSTEMCMDS_SD_STRESS
	bool "sd_stress"
	default n
	---help---
		Enable support for sd_stress
```

## src/systemcmds/serial_passthru/Kconfig
```kconfig
menuconfig SYSTEMCMDS_SERIAL_PASSTHRU
	bool "serial_passthru"
	default n
	---help---
		Enable support for passing one sevice to another
		i.e ttyACM to ttyS5

if SYSTEMCMDS_SERIAL_PASSTHRU

config SERIAL_PASSTHRU_UBLOX
	bool "Detect and Auto Connect on U-Center messages"
	default n
	---help---
		This option will enable the cdc_acm_check to launch
		The passthru driver.

#
# GPS Passthru device selection
#

choice
	prompt "Passthru device"
	default SERIAL_PASSTHRU_GPS1 if BOARD_SERIAL_GPS1 != ""
	depends on SERIAL_PASSTHRU_UBLOX
	---help---
		This is the GPS device used as the right side of the passthru.
		the path is provided by BOARD_SERIAL_GPSn

config SERIAL_PASSTHRU_GPS1
	bool "GPS1"
	depends on BOARD_SERIAL_GPS1 !=""

config SERIAL_PASSTHRU_GPS2
	bool "GPS2"
	depends on BOARD_SERIAL_GPS2 !=""

config SERIAL_PASSTHRU_GPS3
	bool "GPS3"
	depends on BOARD_SERIAL_GPS3 !=""

config SERIAL_PASSTHRU_GPS4
	bool "GPS4"
	depends on BOARD_SERIAL_GPS4 !=""

config SERIAL_PASSTHRU_GPS5
	bool "GPS5"
	depends on BOARD_SERIAL_GPS5 !=""
endchoice

config SERIAL_PASSTHRU_UBLOX_BAUDRATE
	string "baudrate"
	depends on SERIAL_PASSTHRU_UBLOX
	default "115200"
	---help---
		This option sets the baudrate for the passthru.

endif #SYSTEMCMDS_SERIAL_PASSTHRU
```

## src/systemcmds/serial_socat/Kconfig
```kconfig
menuconfig SYSTEMCMDS_SERIAL_SOCAT
	bool "serial_socat"
	default n
	---help---
		Enable serial_socat command for TCP to serial port bridging.
```

## src/systemcmds/serial_test/Kconfig
```kconfig
menuconfig SYSTEMCMDS_SERIAL_TEST
	bool "serial_test"
	default n
	---help---
		Enable support for serial_test

menuconfig USER_SERIAL_TEST
	bool "serial_test running as userspace module"
	default y
	depends on BOARD_PROTECTED && SYSTEMCMDS_SERIAL_TEST
	---help---
		Put serial_test in userspace memory
```
