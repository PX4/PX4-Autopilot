## src/systemcmds/serialpassthrough/Kconfig
```kconfig
menuconfig SYSTEMCMDS_SERIALPASSTHROUGH
	bool "serialpassthrough"
	default n
	---help---
		Enable the serialpassthrough module.
		Forwards data between a UART and a MAVLink via
		SERIAL_CONTROL messages.

if SYSTEMCMDS_SERIALPASSTHROUGH

config SERIALPASSTHROUGH_BITBANG
	bool "Enable bit-bang UART support (ESC channel mode)"
	default n
	depends on PLATFORM_NUTTX && (ARCH_CHIP_STM32F7 || ARCH_CHIP_STM32H7)
	---help---
		Enable bit-bang UART.

if SERIALPASSTHROUGH_BITBANG

config BITBANG_TIMER
	int "Timer instance for bit-bang UART"
	default 13
	range 1 17
	---help---
		Timer instance to use for bit-bang UART timing mode.
		Default TIM13.

endif # SERIALPASSTHROUGH_BITBANG

endif # SYSTEMCMDS_SERIALPASSTHROUGH
```

## src/systemcmds/shutdown/Kconfig
```kconfig
menuconfig SYSTEMCMDS_SHUTDOWN
	bool "shutdown"
	default n
	---help---
		Enable support for shutdown

menuconfig USER_SHUTDOWN
	bool "shutdown running as userspace module"
	default y
	depends on BOARD_PROTECTED && SYSTEMCMDS_SHUTDOWN
	---help---
		Put shutdown in userspace memory
```

## src/systemcmds/ss_io_timer_test/Kconfig
```kconfig
menuconfig SYSTEMCMDS_SS_IO_TIMER_TEST
	bool "Simple stupid IO Timer tester"
	default n
	---help---
		System command test low-level IO timer
		WARNING: No mixer, hence no safety use at your own risk

menuconfig USER_SS_IO_TIMER_TEST
	bool "ss_io_timer_test running as userspace module"
	default y
	depends on BOARD_PROTECTED && SYSTEMCMDS_SS_IO_TIMER_TEST
	---help---
		Put reflect in userspace memory
```

## src/systemcmds/system_time/Kconfig
```kconfig
menuconfig SYSTEMCMDS_SYSTEM_TIME
	bool "system_time"
	default n
	---help---
		Enable support for system_time

menuconfig USER_SYSTEM_TIME
	bool "system_time running as userspace module"
	default y
	depends on BOARD_PROTECTED && SYSTEMCMDS_SYSTEM_TIME
	---help---
		Put system_time in userspace memory
```

## src/systemcmds/telem_test/Kconfig
```kconfig
menuconfig SYSTEMCMDS_TELEM_TEST
	bool "telem_test"
	default n
	---help---
		Enable support for telemetry uart test

menuconfig USER_TELEM_TEST
	bool "telemetry uart test running as userspace module"
	default y
	depends on BOARD_PROTECTED && SYSTEMCMDS_TELEM_TEST
	---help---
		Put telemetry uart test in userspace memory
```

## src/systemcmds/tests/Kconfig
```kconfig
menuconfig SYSTEMCMDS_TESTS
	bool "tests"
	default n
	---help---
		Enable support for tests

menuconfig USER_TESTS
	bool "tests running as userspace module"
	default y
	depends on BOARD_PROTECTED && SYSTEMCMDS_TESTS
	---help---
		Put tests in userspace memory
```

## src/systemcmds/top/Kconfig
```kconfig
menuconfig SYSTEMCMDS_TOP
	bool "top"
	default n
	---help---
		Enable support for top

menuconfig USER_TOP
	bool "top running as userspace module"
	default n
	depends on BOARD_PROTECTED && SYSTEMCMDS_TOP
	---help---
		Put top in userspace memory
```

## src/systemcmds/topic_listener/Kconfig
```kconfig
menuconfig SYSTEMCMDS_TOPIC_LISTENER
	bool "topic_listener"
	default n
	---help---
		Enable support for topic_listener

menuconfig USER_TOPIC_LISTENER
	bool "topic_listener running as userspace module"
	default y
	depends on BOARD_PROTECTED && SYSTEMCMDS_TOPIC_LISTENER
	---help---
		Put topic_listener in userspace memory
```

## src/systemcmds/tune_control/Kconfig
```kconfig
menuconfig SYSTEMCMDS_TUNE_CONTROL
	bool "tune_control"
	default n
	---help---
		Enable support for tune_control

menuconfig USER_TUNE_CONTROL
	bool "tune_control running as userspace module"
	default y
	depends on BOARD_PROTECTED && SYSTEMCMDS_TUNE_CONTROL
	---help---
		Put tune_control in userspace memory
```

## src/systemcmds/uart8_test/Kconfig
```kconfig
menuconfig SYSTEMCMDS_UART8_TEST
	bool "uart8_test"
	default n
	---help---
		Enable support for uart8_test command
```

## src/systemcmds/uorb/Kconfig
```kconfig
config SYSTEMCMDS_UORB
	bool "uorb"
	default n
	---help---
		Enable support for uorb

config USER_UORB
	bool
	default y
	depends on BOARD_PROTECTED && SYSTEMCMDS_UORB
```

## src/systemcmds/usb_connected/Kconfig
```kconfig
menuconfig SYSTEMCMDS_USB_CONNECTED
	bool "usb_connected"
	default n
	---help---
		Enable support for usb_connected

menuconfig USER_USB_CONNECTED
	bool "usb_connected running as userspace module"
	default y
	depends on BOARD_PROTECTED && SYSTEMCMDS_USB_CONNECTED
	---help---
		Put usb_connected in userspace memory
```

## src/systemcmds/ver/Kconfig
```kconfig
menuconfig SYSTEMCMDS_VER
	bool "ver"
	default n
	---help---
		Enable support for ver

if SYSTEMCMDS_VER
    config VER_GIT_DIFF
        bool "Include Git diff"
        default n
        depends on SYSTEMCMDS_VER
        help
            Generate diff for config and list modified files in firmware.
endif #SYSTEMCMDS_VER

menuconfig USER_VER
	bool "ver running as userspace module"
	default n
	depends on BOARD_PROTECTED && SYSTEMCMDS_VER
	---help---
		Put ver in userspace memory
```

## src/systemcmds/work_queue/Kconfig
```kconfig
menuconfig SYSTEMCMDS_WORK_QUEUE
	bool "work_queue"
	default n
	---help---
		Enable support for work_queue

menuconfig USER_WORK_QUEUE
	bool "work_queue running as userspace module"
	default y
	depends on BOARD_PROTECTED && SYSTEMCMDS_WORK_QUEUE
	---help---
		Put work_queue in userspace memory
```

## src/templates/template_module/Kconfig
```kconfig
menuconfig TEMPLATES_TEMPLATE_MODULE
	bool "template_module"
	default n
	---help---
		Enable support for template_module
```
