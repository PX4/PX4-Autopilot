## src/platforms/nuttx/nuttx-configs/px4flow-v2/Kconfig
```kconfig
#
# For a description of the syntax of this configuration file,
# see misc/tools/kconfig-language.txt.
#

if CONFIG_ARCH_BOARD_PX4FLOW_V2

config BOARD_HAS_PROBES
	bool "Board provides GPIO or other Hardware for signaling to timing analyze."
	default y
	---help---
		This board provides ADDR[0:2] as PROBE_1-3 to provide timing signals from selected drivers.

config BOARD_USE_PROBES
	bool "Enable the use provides ADDR[0:2] as PROBE_1-3 to provide timing signals from selected drivers"
	default n
	depends on BOARD_HAS_PROBES

	---help---
		Select to use GPIO provides ADDR[0:2] as PROBE_1-3 to provide  timing signals from selected drivers.

endif
```

## src/systemcmds/Kconfig
```kconfig
menuconfig BL_UPDATE
	bool "bl update Support"
	default n
	---help---
		Enable support for bl update
		
menuconfig DMESG
	bool "dmesg Support"
	default n
	---help---
		Enable support for dmesg
		
menuconfig DUMPFILE
	bool "dumpfile Support"
	default n
	---help---
		Enable support for dumpfile
		
menuconfig DYN
	bool "dyn Support"
	default n
	---help---
		Enable support for dyn
		
menuconfig ESC_CALIB
	bool "esc calib Support"
	default n
	---help---
		Enable support for esc calib
		
menuconfig FAILURE
	bool "failure Support"
	default n
	---help---
		Enable support for failure
		
menuconfig GPIO
	bool "gpio Support"
	default n
	---help---
		Enable support for gpio
		
menuconfig HARDFAULT_LOG
	bool "hardfault log Support"
	default n
	---help---
		Enable support for hardfault log
		
menuconfig I2CDETECT
	bool "i2cdetect Support"
	default n
	---help---
		Enable support for i2cdetect
		
menuconfig LED_CONTROL
	bool "led control Support"
	default n
	---help---
		Enable support for led control
		
menuconfig MFT
	bool "mft Support"
	default n
	---help---
		Enable support for mft
		
menuconfig MIXER
	bool "mixer Support"
	default n
	---help---
		Enable support for mixer
		
menuconfig MOTOR_RAMP
	bool "motor ramp Support"
	default n
	---help---
		Enable support for motor ramp
		
menuconfig MOTOR_TEST
	bool "motor test Support"
	default n
	---help---
		Enable support for motor test
		
menuconfig MTD
	bool "mtd Support"
	default n
	---help---
		Enable support for mtd
		
menuconfig NETMAN
	bool "netman Support"
	default n
	---help---
		Enable support for netman
		
menuconfig NSHTERM
	bool "nshterm Support"
	default n
	---help---
		Enable support for nshterm
		
menuconfig PARAM
	bool "param Support"
	default n
	---help---
		Enable support for param
		
menuconfig PERF
	bool "perf Support"
	default n
	---help---
		Enable support for perf
		
menuconfig PWM
	bool "pwm Support"
	default n
	---help---
		Enable support for pwm
		
menuconfig REBOOT
	bool "reboot Support"
	default n
	---help---
		Enable support for reboot
		
menuconfig REFLECT
	bool "reflect Support"
	default n
	---help---
		Enable support for reflect
		
menuconfig SD_BENCH
	bool "sd bench Support"
	default n
	---help---
		Enable support for sd bench
		
menuconfig SERIAL_TEST
	bool "serial test Support"
	default n
	---help---
		Enable support for serial test
		
menuconfig SHUTDOWN
	bool "shutdown Support"
	default n
	---help---
		Enable support for shutdown
		
menuconfig SYSTEM_TIME
	bool "system time Support"
	default n
	---help---
		Enable support for system time
		
menuconfig TESTS
	bool "tests Support"
	default n
	---help---
		Enable support for tests
		
menuconfig TOP
	bool "top Support"
	default n
	---help---
		Enable support for top
		
menuconfig TOPIC_LISTENER
	bool "topic listener Support"
	default n
	---help---
		Enable support for topic listener
		
menuconfig TUNE_CONTROL
	bool "tune control Support"
	default n
	---help---
		Enable support for tune control
		
menuconfig UORB
	bool "uorb Support"
	default n
	---help---
		Enable support for uorb
		
menuconfig USB_CONNECTED
	bool "usb connected Support"
	default n
	---help---
		Enable support for usb connected
		
menuconfig VER
	bool "ver Support"
	default n
	---help---
		Enable support for ver
		
menuconfig WORK_QUEUE
	bool "work queue Support"
	default n
	---help---
		Enable support for work queue
```

## src/systemcmds/actuator_endurance_test/Kconfig
```kconfig
menuconfig SYSTEMCMDS_ACTUATOR_ENDURANCE_TEST
	bool "actuator_endurance_test"
	default n
	---help---
		Enable support for actuator_endurance_test
```

## src/systemcmds/actuator_test/Kconfig
```kconfig
menuconfig SYSTEMCMDS_ACTUATOR_TEST
	bool "actuator_test"
	default n
	---help---
		Enable support for actuator_test
```

## src/systemcmds/alloc_test/Kconfig
```kconfig
menuconfig SYSTEMCMDS_ALLOC_TEST
	bool "heap_allocation_test"
	default n
	---help---
		Enable support for heap allocation test
```

## src/systemcmds/bl_update/Kconfig
```kconfig
menuconfig SYSTEMCMDS_BL_UPDATE
	bool "bl_update"
	default n
	depends on PLATFORM_NUTTX
	---help---
		Enable support for bl_update

menuconfig BL_UPDATE_BL_ROMFS
	bool "include bootloader in ROMFS"
	default n
	depends on SYSTEMCMDS_BL_UPDATE
	---help---
		Include bootloader in ROMFS

menuconfig USER_BL_UPDATE
	bool "bl_update running as userspace module"
	default n
	depends on BOARD_PROTECTED && SYSTEMCMDS_BL_UPDATE
	---help---
		Put bl_update in userspace memory
```

## src/systemcmds/boardctl/Kconfig
```kconfig
menuconfig SYSTEMCMDS_BOARDCTL
	bool "boardctl"
	default n
	---help---
		Enable support for boardctl
```

## src/systemcmds/bsondump/Kconfig
```kconfig
menuconfig SYSTEMCMDS_BSONDUMP
	bool "bsondump"
	default n
	---help---
		Enable bsondump

menuconfig USER_BSONDUMP
	bool "bsondump running as userspace module"
	default n
	depends on BOARD_PROTECTED && SYSTEMCMDS_BSONDUMP
	---help---
		Put bsondump in userspace memory
```

## src/systemcmds/dmesg/Kconfig
```kconfig
menuconfig SYSTEMCMDS_DMESG
	bool "dmesg"
	default n
	---help---
		Enable support for dmesg

menuconfig USER_DMESG
	bool "dmesg running as userspace module"
	default n
	depends on BOARD_PROTECTED && SYSTEMCMDS_DMESG
	---help---
		Put dmesg in userspace memory
```

## src/systemcmds/dumpfile/Kconfig
```kconfig
menuconfig SYSTEMCMDS_DUMPFILE
	bool "dumpfile"
	default n
	---help---
		Enable support for dumpfile

menuconfig USER_DUMPFILE
	bool "dumpfile running as userspace module"
	default y
	depends on BOARD_PROTECTED && SYSTEMCMDS_DUMPFILE
	---help---
		Put dumpfile in userspace memory
```

## src/systemcmds/dyn/Kconfig
```kconfig
menuconfig SYSTEMCMDS_DYN
	bool "dyn"
	default n
	---help---
		Enable support for dyn

menuconfig USER_DYN
	bool "dyn running as userspace module"
	default y
	depends on BOARD_PROTECTED && SYSTEMCMDS_DYN
	---help---
		Put dyn in userspace memory
```

## src/systemcmds/esc_calib/Kconfig
```kconfig
menuconfig SYSTEMCMDS_ESC_CALIB
	bool "esc_calib"
	default n
	---help---
		Enable support for esc_calib

menuconfig USER_ESC_CALIB
	bool "esc_calib running as userspace module"
	default y
	depends on BOARD_PROTECTED && SYSTEMCMDS_ESC_CALIB
	---help---
		Put esc_calib in userspace memory
```

## src/systemcmds/failure/Kconfig
```kconfig
menuconfig SYSTEMCMDS_FAILURE
	bool "failure"
	default n
	depends on MODULES_FAILURE_INJECTION_MANAGER
	---help---
		Enable support for failure

menuconfig USER_FAILURE
	bool "failure running as userspace module"
	default y
	depends on BOARD_PROTECTED && SYSTEMCMDS_FAILURE
	---help---
		Put failure in userspace memory
```

## src/systemcmds/gpio/Kconfig
```kconfig
menuconfig SYSTEMCMDS_GPIO
	bool "gpio"
	default n
	---help---
		Enable support for gpio

menuconfig USER_GPIO
	bool "gpio running as userspace module"
	default y
	depends on BOARD_PROTECTED && SYSTEMCMDS_GPIO
	---help---
		Put gpio in userspace memory
```

## src/systemcmds/hardfault_log/Kconfig
```kconfig
menuconfig SYSTEMCMDS_HARDFAULT_LOG
	bool "hardfault_log"
	default n
	---help---
		Enable support for hardfault_log

menuconfig USER_HARDFAULT_LOG
	bool "hardfault_log running as userspace module"
	default n
	depends on BOARD_PROTECTED && SYSTEMCMDS_HARDFAULT_LOG
	---help---
		Put hardfault_log in userspace memory
```

## src/systemcmds/head/Kconfig
```kconfig
menuconfig SYSTEMCMDS_HEAD
	bool "head"
	default n
	---help---
		Enable support for head

menuconfig USER_HEAD
	bool "head running as userspace module"
	default y
	depends on BOARD_PROTECTED && SYSTEMCMDS_HEAD
	---help---
		Put head in userspace memory
```

## src/systemcmds/hist/Kconfig
```kconfig
menuconfig SYSTEMCMDS_HIST
	bool "hist"
	default n
	---help---
		Enable support for hist
```

## src/systemcmds/i2c_launcher/Kconfig
```kconfig
menuconfig SYSTEMCMDS_I2C_LAUNCHER
	bool "i2c_launcher"
	default n
	---help---
		Daemon that starts drivers based on found I2C devices.

menuconfig USER_I2C_LAUNCHER
	bool "i2c_launcher running as userspace module"
	default n
	depends on SYSTEMCMDS_I2C_LAUNCHER
```

## src/systemcmds/i2cdetect/Kconfig
```kconfig
menuconfig SYSTEMCMDS_I2CDETECT
	bool "i2cdetect"
	default n
	---help---
		Enable support for i2cdetect

menuconfig USER_I2CDETECT
	bool "i2cdetect running as userspace module"
	default n
	depends on BOARD_PROTECTED && SYSTEMCMDS_I2CDETECT
	---help---
		Put i2cdetect in userspace memory
```

## src/systemcmds/io_bypass_control/Kconfig
```kconfig
menuconfig SYSTEMCMDS_IO_BYPASS_CONTROL
	bool "IO Bypass control deamon"
	default n
	---help---
		Simple daemon that listens uORB actuator_outputs to control PWM output
		Useful for full offboard control using RTPS.
		WARNING: No mixer, hence no safety use at your own risk

menuconfig USER_IO_BYPASS_CONTROL
	bool "io_bypass_control running as userspace module"
	default y
	depends on BOARD_PROTECTED && SYSTEMCMDS_SS_IO_TIMER_TEST
	---help---
		Put io_bypass_control in userspace memory
```

## src/systemcmds/kparam/Kconfig
```kconfig
menuconfig SYSTEMCMDS_KPARAM
	bool "param"
	default n
	---help---
		Enable support for param

config USER_KPARAM
	bool
	default n
	depends on BOARD_PROTECTED && SYSTEMCMDS_KPARAM
```

## src/systemcmds/launch_kmod/Kconfig
```kconfig
config SYSTEMCMDS_LAUNCH_KMOD
	bool
	default y
	depends on BOARD_PROTECTED

config USER_LAUNCH_KMOD
	bool
	default y
	depends on BOARD_PROTECTED
```

## src/systemcmds/led_control/Kconfig
```kconfig
menuconfig SYSTEMCMDS_LED_CONTROL
	bool "led_control"
	default n
	---help---
		Enable support for led_control

menuconfig USER_LED_CONTROL
	bool "led_control running as userspace module"
	default y
	depends on BOARD_PROTECTED && SYSTEMCMDS_LED_CONTROL
	---help---
		Put led_control in userspace memory
```

## src/systemcmds/mft/Kconfig
```kconfig
menuconfig SYSTEMCMDS_MFT
	bool "mft"
	default n
	depends on PLATFORM_NUTTX
	---help---
		Enable support for mft
```
