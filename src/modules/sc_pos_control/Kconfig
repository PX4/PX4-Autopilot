## src/modules/sc_pos_control/Kconfig
```kconfig
menuconfig MODULES_SC_POS_CONTROL
	bool "sc_pos_control"
	default n
	---help---
		Enable support for sc_pos_control

menuconfig USER_SC_POS_CONTROL
	bool "sc_pos_control running as userspace module"
	default y
	depends on BOARD_PROTECTED && MODULES_SC_POS_CONTROL
	---help---
		Put sc_pos_control in userspace memory
```

## src/modules/sc_rate_control/Kconfig
```kconfig
menuconfig MODULES_SC_RATE_CONTROL
	bool "sc_rate_control"
	default n
	---help---
		Enable support for sc_rate_control

menuconfig USER_SC_RATE_CONTROL
	bool "sc_rate_control running as userspace module"
	default n
	depends on BOARD_PROTECTED && MODULES_SC_RATE_CONTROL
	---help---
		Put sc_rate_control in userspace memory
```

## src/modules/sc_thruster_controller/Kconfig
```kconfig
menuconfig MODULES_SC_THRUSTER_CONTROLLER
	bool "sc_thruster_controller"
	default n
	---help---
		Enable support for sc_thruster_controller
```

## src/modules/sese_omni_control/Kconfig
```kconfig
menuconfig MODULES_SESE_OMNI_CONTROL
	bool "sese_omni_control"
	default n
	depends on MODULES_CONTROL_ALLOCATOR
	---help---
		Enable support for control of omni-directional boats
```

## src/modules/sih/Kconfig
```kconfig
menuconfig MODULES_SIH
	bool "sih"
	default n
	---help---
		Enable support for sih

menuconfig USER_SIH
	bool "sih running as userspace module"
	default y
	depends on BOARD_PROTECTED && MODULES_SIH
	---help---
		Put sih in userspace memory
```

## src/modules/simulation/Kconfig
```kconfig
menu "Simulation"
    menuconfig COMMON_SIMULATION
        bool "Common simulation modules"
        default n
        depends on PLATFORM_POSIX
        select MODULES_SIMULATION_BATTERY_SIMULATOR
        select MODULES_SIMULATION_PWM_OUT_SIM
        select MODULES_SIMULATION_SENSOR_SIM_MANAGER
        select MODULES_SIMULATION_SYSTEM_POWER_SIMULATOR
        select MODULES_SIMULATION_SIMULATOR_MAVLINK
        select MODULES_SIMULATION_SIMULATOR_SIH
        ---help---
            Enable default set of simulation modules
    rsource "*/Kconfig"
endmenu
```

## src/modules/simulation/battery_simulator/Kconfig
```kconfig
menuconfig MODULES_SIMULATION_BATTERY_SIMULATOR
	bool "battery_simulator"
	default n
	---help---
		Enable support for battery_simulator
```

## src/modules/simulation/gz_bridge/Kconfig
```kconfig
menuconfig MODULES_SIMULATION_GZ_BRIDGE
	bool "gz_bridge"
	default n
	depends on PLATFORM_POSIX && MODULES_SIMULATION_GZ_MSGS
	---help---
		Enable support for gz_bridge
```

## src/modules/simulation/gz_msg/Kconfig
```kconfig
menuconfig MODULES_SIMULATION_GZ_MSG
	bool "gz_msg"
	default n
	depends on PLATFORM_POSIX
	---help---
		Enable support for gz_msg
```

## src/modules/simulation/gz_msgs/Kconfig
```kconfig
menuconfig MODULES_SIMULATION_GZ_MSGS
	bool "gz_msgs"
	default n
	depends on PLATFORM_POSIX
	---help---
		Enable proto generation for custom PX4 messages
```

## src/modules/simulation/gz_plugins/Kconfig
```kconfig
menuconfig MODULES_SIMULATION_GZ_PLUGINS
	bool "gz_plugins"
	default n
	depends on PLATFORM_POSIX && MODULES_SIMULATION_GZ_MSGS
	---help---
		Enable support for gz_plugins
```

## src/modules/simulation/rerun_logger/Kconfig
```kconfig
menuconfig MODULES_SIMULATION_RERUN_LOGGER
	bool "rerun_logger"
	default n
	---help---
		Enable Rerun logging for SITL
```

## src/modules/simulation/sensor_adsb_sim/Kconfig
```kconfig
menuconfig MODULES_SIMULATION_SENSOR_ADSB_SIM
	bool "sensor_adsb_sim"
	default n
	---help---
		Enable support for sensor_adsb_sim
```

## src/modules/simulation/sensor_agp_sim/Kconfig
```kconfig
menuconfig MODULES_SIMULATION_SENSOR_AGP_SIM
	bool "sensor_agp_sim"
	default n
	---help---
		Enable support for sensor_agp_sim
```

## src/modules/simulation/sensor_airflow_sim/Kconfig
```kconfig
menuconfig MODULES_SIMULATION_SENSOR_AIRFLOW_SIM
	bool "sensor_airflow_sim"
	default n
	---help---
		Enable support for sensor_airflow_sim
```

## src/modules/simulation/sensor_airspeed_sim/Kconfig
```kconfig
menuconfig MODULES_SIMULATION_SENSOR_AIRSPEED_SIM
	bool "sensor_airspeed_sim"
	default n
	---help---
		Enable support for sensor_airspeed_sim
```

## src/modules/simulation/sensor_baro_sim/Kconfig
```kconfig
menuconfig MODULES_SIMULATION_SENSOR_BARO_SIM
	bool "sensor_baro_sim"
	default n
	---help---
		Enable support for sensor_baro_sim
```

## src/modules/simulation/sensor_gps_sim/Kconfig
```kconfig
menuconfig MODULES_SIMULATION_SENSOR_GPS_SIM
	bool "sensor_gps_sim"
	default n
	---help---
		Enable support for sensor_gps_sim
```

## src/modules/simulation/sensor_mag_sim/Kconfig
```kconfig
menuconfig MODULES_SIMULATION_SENSOR_MAG_SIM
	bool "sensor_mag_sim"
	default n
	---help---
		Enable support for sensor_mag_sim
```

## src/modules/simulation/sensor_sim_manager/Kconfig
```kconfig
menuconfig MODULES_SIMULATION_SENSOR_SIM_MANAGER
	bool "sensor_sim_manager"
	default n
	---help---
		Enable support for sensor_sim_manager - Unified sensor simulation manager for SIH
```

## src/modules/simulation/simulator_ignition_bridge/Kconfig
```kconfig
menuconfig MODULES_SIMULATION_SIMULATOR_IGNITION_BRIDGE
	bool "simulator_ignition_bridge"
	default n
	---help---
		Enable support for simulator_ignition_bridge
```

## src/modules/simulation/simulator_mavlink/Kconfig
```kconfig
menuconfig MODULES_SIMULATION_SIMULATOR_MAVLINK
	bool "simulator_mavlink"
	default n
	select MODULES_SIMULATION_PWM_OUT_SIM
	depends on PLATFORM_POSIX
	---help---
		Enable support for mavlink simulator
```

## src/modules/simulation/simulator_sih/Kconfig
```kconfig
menuconfig MODULES_SIMULATION_SIMULATOR_SIH
	bool "simulator_sih"
	default n
	select MODULES_SIMULATION_PWM_OUT_SIM
	select MODULES_SIMULATION_SENSOR_SIM_MANAGER
	---help---
		Enable support for simulator_sih

menuconfig USER_SIH
	bool "simulator_sih running as userspace module"
	default y
	depends on BOARD_PROTECTED && MODULES_SIMULATION_SIMULATOR_SIH
	---help---
		Put sih in userspace memory
```

## src/modules/simulation/simulator_xplane/Kconfig
```kconfig
menuconfig MODULES_SIMULATION_SIMULATOR_XPLANE
	bool "simulator_xplane"
	default n
	select MODULES_SIMULATION_PWM_OUT_SIM
	depends on PLATFORM_POSIX
	---help---
		Native X-Plane UDP simulator backend (no plugin required)
```

## src/modules/simulation/system_power_simulator/Kconfig
```kconfig
menuconfig MODULES_SIMULATION_SYSTEM_POWER_SIMULATOR
	bool "system_power_simulator"
	default n
	---help---
		Enable support for system_power_simulator
```
