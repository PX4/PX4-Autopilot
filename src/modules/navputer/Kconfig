## src/modules/navputer/Kconfig
```kconfig
menuconfig MODULES_NAVPUTER
	bool "navputer"
	default n
	---help---
		Enable support for navputer
```

## src/modules/qnx_state_resmgr/Kconfig
```kconfig
menuconfig MODULES_QNX_STATE_RESMGR
	bool "qnx_state_resmgr"
	default n
	depends on PLATFORM_POSIX
	---help---
		QNX only: serve live vehicle state as text at /dev/px4/state
		through a QNX resource manager.
```

## src/modules/sensors/Kconfig
```kconfig
menuconfig MODULES_SENSORS
	bool "sensors"
	default n
	---help---
		Enable support for sensors

menuconfig USER_SENSORS
	bool "sensors running as userspace module"
	default n
	depends on BOARD_PROTECTED && MODULES_SENSORS
	---help---
		Put sensors in userspace memory

if MODULES_SENSORS
    config SENSORS_VEHICLE_AIRSPEED
        bool "Include vehicle airspeed"
        default y

    config SENSORS_VEHICLE_AIR_DATA
        bool "Include vehicle air data"
        default y

    config SENSORS_VEHICLE_ANGULAR_VELOCITY
        bool "Include vehicle angular velocity"
        default y

    config SENSORS_VEHICLE_ACCELERATION
        bool "Include vehicle acceleration"
        default y

    config SENSORS_VEHICLE_GPS_POSITION
        bool "Include vehicle gps position"
        default y

    config SENSORS_VEHICLE_MAGNETOMETER
        bool "Include vehicle magnetometer"
        default y

    config SENSORS_VEHICLE_OPTICAL_FLOW
        bool "Include vehicle optical flow"
        default y
        depends on !SENSORS_NODE_OPTICAL_FLOW

    config SENSORS_NODE_OPTICAL_FLOW
        bool "Include optical flow for a CAN sensor node"
        default n
        ---help---
            Pairs each flow frame with the node gyro and aggregates frames for the bus.
            Has no parameters: the flight controller owns the flow configuration.

    config SENSORS_NODE_OPTICAL_FLOW_RATE
        int "Node optical flow publication rate (Hz)"
        default 70
        range 1 1000
        depends on SENSORS_NODE_OPTICAL_FLOW

endif #MODULES_SENSORS
```

## src/modules/simulation/sensor_gnss_sim/Kconfig
```kconfig
menuconfig MODULES_SIMULATION_SENSOR_GNSS_SIM
	bool "sensor_gnss_sim"
	default n
	---help---
		Enable support for sensor_gnss_sim
```

## src/modules/through_control/Kconfig
```kconfig
menuconfig MODULES_THROUGH_CONTROL
	bool "through_control"
	default n
	---help---
		Enable support for the THROUGH ring-diving external flight mode

menuconfig USER_THROUGH_CONTROL
	bool "through_control running as userspace module"
	default y
	depends on BOARD_PROTECTED && MODULES_THROUGH_CONTROL
	---help---
		Put through_control in userspace memory
```

## src/modules/voliro_hover/Kconfig
```kconfig
menuconfig MODULES_VOLIRO_HOVER
	bool "voliro_hover"
	default n
	---help---
		Fully onboard Voliro hover flight mode and minimum-jerk reference generator.
```

## src/systemcmds/remote_core/Kconfig
```kconfig
menuconfig SYSTEMCMDS_REMOTE_CORE
	bool "remote_core"
	default n
	depends on BOARD_RPMSG
	---help---
		Start, stop and exercise the rptun remote core: status from the
		board, a shell-timed ping and a text hello endpoint, fault injection.
```

## src/systemcmds/serial_autostart/Kconfig
```kconfig
menuconfig SYSTEMCMDS_SERIAL_AUTOSTART
	bool "serial_autostart"
	default y
	depends on BOARD_ROMFSROOT != ""
	---help---
		Walk SER_*_PROTO / SER_*_BAUD and start the matching serial drivers.

menuconfig USER_SERIAL_AUTOSTART
	bool "serial_autostart running as userspace module"
	default y
	depends on BOARD_PROTECTED && SYSTEMCMDS_SERIAL_AUTOSTART
	---help---
		Put serial_autostart in userspace memory
```

## src/systemcmds/serial_config/Kconfig
```kconfig
menuconfig SYSTEMCMDS_SERIAL_CONFIG
	bool "serial_config"
	default n
	depends on PLATFORM_NUTTX && ARCH_CHIP_STM32H7
	---help---
		Apply SER_*_SWAP before starting an automatically configured serial service.
		Currently supported on STM32H7, where the UART driver preserves SWAP across
		close/reopen. The NuttX configuration must enable STM32H7_USART_SWAP.
		This command does not run a background task.
```
