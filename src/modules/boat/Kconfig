## src/modules/boat/Kconfig
```kconfig
menuconfig MODULES_BOAT
	bool "boat"
	default n
	depends on MODULES_CONTROL_ALLOCATOR
	---help---
		Enable support for control of boats
```

## src/modules/boat_pos_control/Kconfig
```kconfig
menuconfig MODULES_BOAT_POS_CONTROL
	bool "boat_pos_control"
	default n
	---help---
		Enable support for boat position controller
```

## src/modules/boat_rudder/Kconfig
```kconfig
menuconfig MODULES_BOAT_RUDDER
	bool "boat_rudder"
	default n
	---help---
		Enable support for rudder-steered boats
```

## src/modules/camera_feedback/Kconfig
```kconfig
menuconfig MODULES_CAMERA_FEEDBACK
	bool "camera_feedback"
	default n
	---help---
		Enable support for camera_feedback

menuconfig USER_CAMERA_FEEDBACK
	bool "camera_feedback running as userspace module"
	default y
	depends on BOARD_PROTECTED && MODULES_CAMERA_FEEDBACK
	---help---
		Put camera_feedback in userspace memory
```

## src/modules/catapult_launch/Kconfig
```kconfig
menuconfig MODULES_CATAPULT_LAUNCH
	bool "catapult_launch"
	default n
	---help---
		Enable catapult launch automation module (PoC).
		Controls tail lock servos (MAIN5/MAIN6) and motor (MAIN3)
		during Takeoff / Mission Takeoff for tube-launched fixed-wing.
```

## src/modules/cdcacm/Kconfig
```kconfig
menuconfig MODULES_CDCACM
	bool "CDC ACM monitor process"
	default n
	---help---
		Enable support for CDC ACM monitor

menuconfig USER_CDCACM
	bool "CDC ACM monitor running as userspace module"
	default y
	depends on BOARD_PROTECTED && MODULES_CDCACM
	---help---
		Put CDC ACM monitor in userspace memory
```

## src/modules/cdus_allocator/Kconfig
```kconfig
menuconfig MODULES_CDUS_ALLOCATOR
	bool "cdus_allocator"
	default n
	---help---
		Enable support for custom_pid

menuconfig USER_CDUS_ALLOCATOR
	bool "cdus_allocator running as userspace module"
	default n
	depends on BOARD_PROTECTED && CDUS_ALLOCATOR
	---help---
		Put cdus_allocator in userspace memory
```

## src/modules/cdus_allocator_duct/Kconfig
```kconfig
menuconfig MODULES_CDUS_ALLOCATOR_DUCT
	bool "cdus_allocator_duct"
	default n
	---help---
		Enable support for duct drone control allocator

menuconfig USER_CDUS_ALLOCATOR_DUCT
	bool "cdus_allocator_duct running as userspace module"
	default n
	depends on BOARD_PROTECTED && CDUS_ALLOCATOR_DUCT
	---help---
		Put cdus_allocator_duct in userspace memory
```

## src/modules/cdus_backstepping/Kconfig
```kconfig
menuconfig MODULES_CDUS_BACKSTEPPING
	bool "cdus_backstepping"
	default n
	---help---
		Enable support for cdus_backstepping

menuconfig USER_CDUS_BACKSTEPPING
	bool "cdus_backstepping running as userspace module"
	default n
	depends on BOARD_PROTECTED && CDUS_BACKSTEPPING
	---help---
		Put cdus_backstepping in userspace memory
```

## src/modules/cdus_backstepping_attitude/Kconfig
```kconfig
menuconfig MODULES_CDUS_BACKSTEPPING_ATTITUDE
	bool "cdus_backstepping_attitude"
	default n
	---help---
		Enable support for cdus_backstepping_attitude

menuconfig USER_CDUS_BACKSTEPPING_ATTITUDE
	bool "cdus_backstepping_attitude running as userspace module"
	default n
	depends on BOARD_PROTECTED && CDUS_BACKSTEPPING_ATTITUDE
	---help---
		Put cdus_backstepping_attitude in userspace memory
```

## src/modules/cdus_rate_control/Kconfig
```kconfig
menuconfig MODULES_CDUS_RATE_CONTROL
	bool "cdus_rate_control"
	default n
	---help---
		Enable support for cdus_rate_control

menuconfig USER_CDUS_RATE_CONTROL
	bool "cdus_rate_control running as userspace module"
	default n
	depends on BOARD_PROTECTED && CDUS_RATE_CONTROL
	---help---
		Put cdus_rate_control in userspace memory
```

## src/modules/control_allocator/Kconfig
```kconfig
menuconfig MODULES_CONTROL_ALLOCATOR
	bool "control_allocator"
	default n
	---help---
		Enable support for control_allocator

menuconfig USER_CONTROL_ALLOCATOR
	bool "control_allocator running as userspace module"
	default y
	depends on BOARD_PROTECTED && MODULES_CONTROL_ALLOCATOR
	---help---
		Put control_allocator in userspace memory
```

## src/modules/dataman/Kconfig
```kconfig
menuconfig MODULES_DATAMAN
	bool "dataman"
	default n
	---help---
		Enable support for dataman


menuconfig USER_DATAMAN
	bool "dataman running as userspace module"
	default y
	depends on BOARD_PROTECTED && MODULES_DATAMAN
	---help---
		Put dataman in userspace memory


menuconfig DATAMAN_PERSISTENT_STORAGE
	bool "dataman supports persistent storage"
	default y
	depends on MODULES_DATAMAN
	---help---
		Dataman supports reading/writing to persistent storage

menuconfig NUM_MISSION_ITMES_SUPPORTED
	int "Maximum number of mission items"
	default 500
	depends on MODULES_DATAMAN
	---help---
		This limit always applies if mission items are stored on the SD card or in RAM. It should be set
		adequately per boards such that if the items are stored in RAM they still fit the available memory.
		The runtime parameter to configure the storage option is `SYS_DM_BACKEND`.
```

## src/modules/differential_drive/Kconfig
```kconfig
menuconfig MODULES_DIFFERENTIAL_DRIVE
	bool "differential_drive"
	default n
	depends on MODULES_CONTROL_ALLOCATOR
	---help---
		Enable support for control of differential drive rovers
```

## src/modules/differential_drive_control/Kconfig
```kconfig
menuconfig MODULES_DIFFERENTIAL_DRIVE_CONTROL
	bool "differential_drive_control"
	default y
	---help---
		Enable support for control of differential drive rovers
```

## src/modules/dob_rate_control/Kconfig
```kconfig
menuconfig MODULES_DOB_RATE_CONTROL
	bool "dob_rate_control"
	default n
	---help---
		Enable support for dob_rate_control

menuconfig USER_FW_RATE_CONTROL
	bool "dob_rate_control running as userspace module"
	default n
	depends on BOARD_PROTECTED && MODULES_DOB_RATE_CONTROL
	---help---
		Put fw_rate_control in userspace memory
```

## src/modules/drag_estimator/Kconfig
```kconfig
menuconfig MODULES_DRAG_ESTIMATOR
	bool "drag_estimator"
	default n
	---help---
		Enable support for drag_estimator

menuconfig DRAG_ESTIMATOR
	bool "drag_estimator running as userspace module"
	default y
	depends on BOARD_PROTECTED && MODULES_DRAG_ESTIMATOR
	---help---
		Put drag_estimator in userspace memory
```

## src/modules/ekf2/Kconfig
```kconfig
menuconfig MODULES_EKF2
	bool "ekf2"
	default n
	---help---
		Enable support for ekf2

menuconfig EKF2_VERBOSE_STATUS
depends on MODULES_EKF2
	bool "verbose status output"
	default n
	depends on !BOARD_CONSTRAINED_MEMORY
	depends on !BOARD_CONSTRAINED_FLASH
	---help---
		ekf2 status verbose output.

menuconfig EKF2_MULTI_INSTANCE
depends on MODULES_EKF2
        bool "multi-EKF support"
        default y
	depends on !BOARD_CONSTRAINED_MEMORY
	depends on !BOARD_CONSTRAINED_FLASH
	---help---
		EKF2 support multiple instances and selector.

menuconfig EKF2_AIRSPEED
depends on MODULES_EKF2
        bool "airspeed fusion support"
        default y
	depends on EKF2_SIDESLIP
	depends on EKF2_WIND
	---help---
		EKF2 airspeed fusion support.

menuconfig EKF2_AUX_GLOBAL_POSITION
depends on MODULES_EKF2
	bool "aux global position fusion support"
	default y
	---help---
		EKF2 auxiliary global position fusion support.

menuconfig EKF2_AUXVEL
depends on MODULES_EKF2
        bool "aux velocity fusion support"
        default y
	---help---
		EKF2 auxiliary velocity fusion support.

menuconfig EKF2_BAROMETER
depends on MODULES_EKF2
	bool "barometer support"
	default y
	---help---
		EKF2 barometer support.

menuconfig EKF2_BARO_COMPENSATION
depends on MODULES_EKF2
        bool "barometer compensation support"
        default y
	depends on EKF2_BAROMETER
	depends on EKF2_WIND
	---help---
		EKF2 pressure compensation support.

menuconfig EKF2_DRAG_FUSION
depends on MODULES_EKF2
        bool "drag fusion support"
        default y
	depends on EKF2_WIND
	---help---
		EKF2 drag fusion support.

menuconfig EKF2_EXTERNAL_VISION
depends on MODULES_EKF2
        bool "external vision (EV) fusion support"
        default y
	---help---
		EKF2 external vision (EV) fusion support.

menuconfig EKF2_GNSS
depends on MODULES_EKF2
	bool "GNSS fusion support"
	default y
	---help---
		EKF2 GNSS fusion support.

menuconfig EKF2_GNSS_YAW
depends on MODULES_EKF2
        bool "GNSS yaw fusion support"
        default y
	depends on EKF2_GNSS
	---help---
		EKF2 GNSS yaw fusion support.

menuconfig EKF2_GRAVITY_FUSION
depends on MODULES_EKF2
	bool "gravity fusion support"
	default y
	---help---
		EKF2 gravity fusion support.

menuconfig EKF2_MAGNETOMETER
depends on MODULES_EKF2
	bool "magnetometer support"
	default y
	---help---
		EKF2 magnetometer support.

menuconfig EKF2_OPTICAL_FLOW
depends on MODULES_EKF2
        bool "optical flow fusion support"
        default y
	select EKF2_TERRAIN
	---help---
		EKF2 optical flow fusion support.

menuconfig EKF2_RANGE_FINDER
depends on MODULES_EKF2
        bool "range finder fusion support"
        default y
	---help---
		EKF2 range finder fusion support.

menuconfig EKF2_SIDESLIP
depends on MODULES_EKF2
        bool "sideslip fusion support"
        default y
	depends on EKF2_WIND
	---help---
		EKF2 sideslip fusion support.

menuconfig EKF2_TERRAIN
depends on MODULES_EKF2
	bool "terrain estimator support"
	default y
	depends on EKF2_OPTICAL_FLOW || EKF2_RANGE_FINDER
	---help---
		EKF2 terrain estimator support.

menuconfig EKF2_WIND
depends on MODULES_EKF2
	bool "wind estimation support"
	default y
	---help---
		EKF2 wind estimation support.

menuconfig USER_EKF2
	bool "ekf2 running as userspace module"
	default n
	depends on BOARD_PROTECTED && MODULES_EKF2
	---help---
		Put ekf2 in userspace memory
```

## src/modules/esc_battery/Kconfig
```kconfig
menuconfig MODULES_ESC_BATTERY
	bool "esc_battery"
	default n
	---help---
		Enable support for esc_battery

menuconfig USER_ESC_BATTERY
	bool "esc_battery running as userspace module"
	default y
	depends on BOARD_PROTECTED && MODULES_ESC_BATTERY
	---help---
		Put esc_battery in userspace memory
```

## src/modules/esc_flasher/Kconfig
```kconfig
menuconfig MODULES_ESC_FLASHER
	bool "esc_flasher"
	default n
	---help---
		Enable support for ESC Flasher module
```

## src/modules/events/Kconfig
```kconfig
menuconfig MODULES_EVENTS
	bool "events"
	default n
	---help---
		Enable support for events

menuconfig USER_EVENTS
	bool "events running as userspace module"
	default y
	depends on BOARD_PROTECTED && MODULES_EVENTS
	---help---
		Put events in userspace memory
```

## src/modules/failure_injection_manager/Kconfig
```kconfig
menuconfig MODULES_FAILURE_INJECTION_MANAGER
	bool "failure_injection_manager"
	default n
	---help---
		Enable support for the failure injection manager. The manager is the sole
		subscriber to vehicle_command for MAV_CMD_INJECT_FAILURE and publishes the
		deduplicated failure_injection topic consumed by the failure apply-sites.
```

## src/modules/fake_ev/Kconfig
```kconfig
menuconfig MODULES_FAKE_EV
	bool "fake_ev"
	default y
	---help---
		Enable fake external vision publisher

menuconfig USER_FAKE_EV
	bool "fake_ev running as userspace module"
	default y
	depends on BOARD_PROTECTED && MODULES_FAKE_EV
	---help---
		Put fake_ev in userspace memory
```

## src/modules/ff_systemload/Kconfig
```kconfig
menuconfig MODULES_FF_SYSTEMLOAD
	bool "freefly_systemload"
	default n
	---help---
		Enable support for freefly Systemload
```

## src/modules/flight_mode_manager/Kconfig
```kconfig
menuconfig MODULES_FLIGHT_MODE_MANAGER
	bool "flight_mode_manager"
	default n
	select MODULES_COMMANDER 
	select MODULES_MC_ATT_CONTROL 
	select MODULES_MC_POS_CONTROL
	---help---
		Enable support for flight_mode_manager

menuconfig USER_FLIGHT_MODE_MANAGER
	bool "flight_mode_manager running as userspace module"
	default y
	depends on BOARD_PROTECTED && MODULES_FLIGHT_MODE_MANAGER
	---help---
		Put flight_mode_manager in userspace memory
```
