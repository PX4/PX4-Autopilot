## src/modules/lighting_state_converter/Kconfig
```kconfig
menuconfig MODULES_LIGHTING_STATE_CONVERTER
	bool "lighting_state_converter"
	default n
	---help---
		Enable support for lighting_state_converter
```

## src/modules/load_mon/Kconfig
```kconfig
menuconfig MODULES_LOAD_MON
	bool "load_mon"
	default n
	---help---
		Enable support for load_mon

menuconfig USER_LOAD_MON
	bool "load_mon running as userspace module"
	default n
	depends on BOARD_PROTECTED && MODULES_LOAD_MON
	---help---
		Put load_mon in userspace memory
```

## src/modules/local_position_estimator/Kconfig
```kconfig
menuconfig MODULES_LOCAL_POSITION_ESTIMATOR
	bool "local_position_estimator"
	default n
	---help---
		Enable support for local_position_estimator

menuconfig USER_LOCAL_POSITION_ESTIMATOR
	bool "local_position_estimator running as userspace module"
	default y
	depends on BOARD_PROTECTED && MODULES_LOCAL_POSITION_ESTIMATOR
	---help---
		Put local_position_estimator in userspace memory
```

## src/modules/mag_bias_estimator/Kconfig
```kconfig
menuconfig MODULES_MAG_BIAS_ESTIMATOR
	bool "mag_bias_estimator"
	default n
	---help---
		Enable support for mag_bias_estimator
```

## src/modules/manual_control/Kconfig
```kconfig
menuconfig MODULES_MANUAL_CONTROL
	bool "manual_control"
	default n
	select MODULES_COMMANDER
	---help---
		Enable support for manual_control
```

## src/modules/mc_att_control/Kconfig
```kconfig
menuconfig MODULES_MC_ATT_CONTROL
	bool "mc_att_control"
	default n
	---help---
		Enable support for mc_att_control

menuconfig USER_MC_ATT_CONTROL
	bool "mc_att_control running as userspace module"
	default n
	depends on BOARD_PROTECTED && MODULES_MC_ATT_CONTROL
	---help---
		Put mc_att_control in userspace memory
```

## src/modules/mc_data_analysis/Kconfig
```kconfig
menuconfig MODULES_MC_DATA_ANALYSIS
	bool "mc_data_analysis"
	default n
	---help---
		Enable csv logging of controller data

menuconfig USER_MC_DATA_ANALYSIS
	bool "mc_data_analysis running as userspace module"
	default n
	depends on BOARD_PROTECTED && MODULES_MC_DATA_ANALYSIS
	---help---
		Put mc_data_analysis in userspace memory
```

## src/modules/mc_hover_thrust_estimator/Kconfig
```kconfig
menuconfig MODULES_MC_HOVER_THRUST_ESTIMATOR
	bool "mc_hover_thrust_estimator"
	default n
	---help---
		Enable support for mc_hover_thrust_estimator

menuconfig USER_MC_HOVER_THRUST_ESTIMATOR
	bool "mc_hover_thrust_estimator running as userspace module"
	default y
	depends on BOARD_PROTECTED && MODULES_MC_HOVER_THRUST_ESTIMATOR
	---help---
		Put mc_hover_thrust_estimator in userspace memory
```

## src/modules/mc_indi_rate_control/Kconfig
```kconfig
menuconfig MODULES_MC_INDI_RATE_CONTROL
	bool "mc_indi_rate_control"
	default n
	---help---
		Enable support for mc_indi_rate_control

menuconfig USER_MC_INDI_RATE_CONTROL
	bool "mc_indi_rate_control running as userspace module"
	default n
	depends on BOARD_PROTECTED && MODULES_MC_INDI_RATE_CONTROL
	---help---
		Put mc_indi_rate_control in userspace memory
```

## src/modules/mc_lqr_control/Kconfig
```kconfig
menuconfig MODULES_MC_LQR_CONTROL
	bool "mc_lqr_control"
	default n
	---help---
		Enable support for mc_lqr_control
```

## src/modules/mc_nn_control/Kconfig
```kconfig
menuconfig MODULES_MC_NN_CONTROL
	bool "mc_nn_control"
	default n
	---help---
		Enable support for mc_nn_control"

menuconfig USER_MC_NN_CONTROL
	bool "mc_nn_control running as userspace module"
	default y
	depends on BOARD_PROTECTED && MODULES_MC_NN_CONTROL
	---help---
		Put mc_nn_control in userspace memory
```

## src/modules/mc_pos_control/Kconfig
```kconfig
menuconfig MODULES_MC_POS_CONTROL
	bool "mc_pos_control"
	default n
	---help---
		Enable support for mc_pos_control

menuconfig USER_MC_POS_CONTROL
	bool "mc_pos_control running as userspace module"
	default y
	depends on BOARD_PROTECTED && MODULES_MC_POS_CONTROL
	---help---
		Put mc_pos_control in userspace memory
```

## src/modules/mc_raptor/Kconfig
```kconfig
menuconfig MODULES_MC_RAPTOR
	bool "mc_raptor"
	default n
	---help---
		Enable support for mc_raptor

menuconfig USER_MC_RAPTOR
	bool "mc_raptor running as userspace module"
	default n
	depends on BOARD_PROTECTED && MODULES_MC_RAPTOR
	---help---
		Put mc_raptor in userspace memory
```

## src/modules/mc_rate_control/Kconfig
```kconfig
menuconfig MODULES_MC_RATE_CONTROL
	bool "mc_rate_control"
	default n
	---help---
		Enable support for mc_rate_control

menuconfig USER_MC_RATE_CONTROL
	bool "mc_rate_control running as userspace module"
	default n
	depends on BOARD_PROTECTED && MODULES_MC_RATE_CONTROL
	---help---
		Put mc_rate_control in userspace memory
```

## src/modules/mecanum_drive/Kconfig
```kconfig
menuconfig MODULES_MECANUM_DRIVE
	bool "mecanum_drive"
	default n
	depends on MODULES_CONTROL_ALLOCATOR
	---help---
		Enable support for control of mecanum drive rovers
```

## src/modules/metric_allocator/Kconfig
```kconfig
menuconfig MODULES_METRIC_ALLOCATOR
	bool "metric_allocator"
	default n
	---help---
		Enable support for metric_allocator

menuconfig USER_METRIC_ALLOCATOR
	bool "metric_allocator running as userspace module"
	default y
	depends on BOARD_PROTECTED && MODULES_METRIC_ALLOCATOR
	---help---
		Put metric_allocator in userspace memory
```

## src/modules/microdds_client/Kconfig
```kconfig
menuconfig MODULES_MICRODDS_CLIENT
	bool "microdds_client"
	default n
	---help---
		Enable support for the MicroDDS Client

menuconfig USER_MICRODDS_CLIENT
	bool "microdds_client running as userspace module"
	default y
	depends on BOARD_PROTECTED && MODULES_MICRODDS_CLIENT
	---help---
		Put microdds_client in userspace memory

menuconfig MICRODDS_TOPICS_YAML
	string "dds topics .yaml file name"
	default "dds_topics.yaml"
	depends on MODULES_MICRODDS_CLIENT
	---help---
		Filename for yaml file for generating topics sources
```

## src/modules/micrortps_bridge/Kconfig
```kconfig
menuconfig MODULES_MICRORTPS_BRIDGE
	bool "micrortps_bridge"
	default n
	---help---
		Enable support for micrortps_bridge

menuconfig USER_MICRORTPS_BRIDGE
	bool "micrortps_bridge running as userspace module"
	default y
	depends on BOARD_PROTECTED && MODULES_MICRORTPS_BRIDGE
	---help---
		Put micrortps_bridge in userspace memory
```

## src/modules/mode_register/Kconfig
```kconfig
menuconfig MODULES_MODE_REGISTER
	bool "mode_register"
	default n
	---help---
		Enable support for internal mode reigstration
```

## src/modules/msp_osd/Kconfig
```kconfig
menuconfig MODULES_MSP_OSD
	bool "msp_osd"
	default n
	---help---
		Enable support for msp_osd

menuconfig USER_MSP_OSD
	bool "msp_osd running as userspace module"
	default y
	depends on BOARD_PROTECTED && MODULES_MSP_OSD
	---help---
		Put msp_osd in userspace memory
```

## src/modules/muorb/Kconfig
```kconfig
menu "MUORB"
depends on PLATFORM_QURT || PLATFORM_POSIX
rsource "*/Kconfig"
endmenu #MUORB
```

## src/modules/muorb/apps/Kconfig
```kconfig
menuconfig MODULES_MUORB_APPS
	bool "apps"
	default n
	depends on PLATFORM_POSIX
	---help---
		Enable support for muorb apps


    config MUORB_APPS_SYNC_TIMESTAMP
        bool "Sync timestamp with external processor"
        depends on MODULES_MUORB_APPS
        default y
        help
            causes HRT timestamp to use an externally calculated offset for synchronization
```

## src/modules/muorb/slpi/Kconfig
```kconfig
menuconfig MODULES_MUORB_SLPI
	bool "muorb_slpi"
	default n
	depends on PLATFORM_QURT
	---help---
		Enable support for muorb slpi
```

## src/modules/nfs_mount/Kconfig
```kconfig
menuconfig MODULES_NFS_MOUNT
	bool "nfs_mount"
	default n
	---help---
		Enable support for NFS client mounting
```

## src/modules/offboard_switch/Kconfig
```kconfig
menuconfig MODULES_OFFBOARD_SWITCH
	bool "offboard_switch"
	default n
	---help---
		Enable support for fw_att_control

menuconfig USER_MODULES_OFFBOARD_SWITCH
	bool "fw_rate_control running as userspace module"
	default n
	depends on BOARD_PROTECTED
	---help---
		Put offboard_switch in userspace memory
```
