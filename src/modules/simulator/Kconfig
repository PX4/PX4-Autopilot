## src/modules/simulator/Kconfig
```kconfig
menuconfig MODULES_SIMULATOR
	bool "simulator"
	default n
	---help---
		Enable support for simulator

menuconfig USER_SIMULATOR
	bool "simulator running as userspace module"
	default y
	depends on BOARD_PROTECTED && MODULES_SIMULATOR
	---help---
		Put simulator in userspace memory
```

## src/modules/spacecraft/Kconfig
```kconfig
menuconfig MODULES_SPACECRAFT
	bool "SPACECRAFT"
	default y if TARGET_CLASS_SPACECRAFT
	default n
	---help---
		Enable support for spacecraft

menuconfig USER_SPACECRAFT
	bool "spacecraft running as userspace module"
	default y
	depends on BOARD_PROTECTED && MODULES_SPACECRAFT
	---help---
		Put SPACECRAFT in userspace memory
```

## src/modules/sr_thruster_controller/Kconfig
```kconfig
menuconfig MODULES_SR_THRUSTER_CONTROLLER
	bool "sr_thruster_controller"
	default n
	---help---
		Enable support for sr_thruster_controller
```

## src/modules/ss_rate_control/Kconfig
```kconfig
menuconfig MODULES_SS_RATE_CONTROL
	bool "ss_rate_control"
	default n
	---help---
		Enable support for ss_rate_control

menuconfig USER_SS_RATE_CONTROL
	bool "ss_rate_control running as userspace module"
	default n
	depends on BOARD_PROTECTED && MODULES_SS_RATE_CONTROL
	---help---
		Put ss_rate_control in userspace memory
```

## src/modules/state_sharing/Kconfig
```kconfig
menuconfig MODULES_STATE_SHARING
	bool "state_sharing"
	default n
	---help---
		Enable support for state_sharing
```

## src/modules/task_watchdog/Kconfig
```kconfig
menuconfig MODULES_TASK_WATCHDOG
	bool "task_watchdog"
	default n
	depends on PLATFORM_NUTTX
	---help---
		Detect tasks running too long and dump their register/stack state and cpuload

if MODULES_TASK_WATCHDOG
config TASK_WATCHDOG_MAX_DUMP_TASKS
	int "Max number of tasks captured in a starvation dump"
	default -1
	---help---
		On boards with minimal RAM, configure how many tasks will be logged on task starvation.
		If TASK_WATCHDOG_MAX_DUMP_TASKS == -1, the config_variable CONFIG_FS_PROCFS_MAX_TASKS is used instead.
endif
```

## src/modules/temperature_compensation/Kconfig
```kconfig
menuconfig MODULES_TEMPERATURE_COMPENSATION
	bool "temperature_compensation"
	default n
	---help---
		Enable support for temperature_compensation

menuconfig USER_TEMPERATURE_COMPENSATION
	bool "temperature_compensation running as userspace module"
	default y
	depends on BOARD_PROTECTED && MODULES_TEMPERATURE_COMPENSATION
	---help---
		Put temperature_compensation in userspace memory
```

## src/modules/time_persistor/Kconfig
```kconfig
menuconfig MODULES_TIME_PERSISTOR
	bool "time_persistor"
	default n
	---help---
		Enable support for time_persistor
```

## src/modules/uorb_explained/Kconfig
```kconfig
menuconfig MODULES_UORB_EXPLAINED
	bool "uorb_explained module"
	default y
	---help---
		uORB Explained Module
```

## src/modules/usv_att_control/Kconfig
```kconfig
menuconfig MODULES_USV_ATT_CONTROL
	bool "usv_att_control"
	default n
	---help---
		Enable support for usv_att_control

menuconfig USER_USV_ATT_CONTROL
	bool "usv_att_control running as userspace module"
	default y
	depends on BOARD_PROTECTED && MODULES_USV_ATT_CONTROL
	---help---
		Put usv_att_control in userspace memory
```

## src/modules/usv_omni_control/Kconfig
```kconfig
menuconfig MODULES_USV_OMNI_CONTROL
	bool "usv_omni_control"
	default n
	---help---
		Enable support for usv_omni_control

menuconfig USER_USV_OMNI_CONTROL
	bool "usv_omni_control running as userspace module"
	default y
	depends on BOARD_PROTECTED && MODULES_USV_OMNI_CONTROL
	---help---
		Put usv_omni_control in userspace memory
```

## src/modules/usv_pos_control/Kconfig
```kconfig
menuconfig MODULES_USV_POS_CONTROL
	bool "usv_pos_control"
	default n
	---help---
		Enable support for usv_pos_control

menuconfig USER_USV_POS_CONTROL
	bool "usv_pos_control running as userspace module"
	default y
	depends on BOARD_PROTECTED && MODULES_USV_POS_CONTROL
	---help---
		Put usv_pos_control in userspace memory
```

## src/modules/uuv_att_control/Kconfig
```kconfig
menuconfig MODULES_UUV_ATT_CONTROL
	bool "uuv_att_control"
	default y if TARGET_CLASS_UUV || TARGET_CLASS_LINUX
	default n
	---help---
		Enable support for uuv_att_control

menuconfig USER_UUV_ATT_CONTROL
	bool "uuv_att_control running as userspace module"
	default y
	depends on BOARD_PROTECTED && MODULES_UUV_ATT_CONTROL
	---help---
		Put uuv_att_control in userspace memory
```

## src/modules/uuv_pos_control/Kconfig
```kconfig
menuconfig MODULES_UUV_POS_CONTROL
	bool "uuv_pos_control"
	default n
	---help---
		Enable support for uuv_pos_control

menuconfig USER_UUV_POS_CONTROL
	bool "uuv_pos_control running as userspace module"
	default y
	depends on BOARD_PROTECTED && MODULES_UUV_POS_CONTROL
	---help---
		Put uuv_pos_control in userspace memory
```

## src/modules/uxrce_dds_client/Kconfig
```kconfig
menuconfig MODULES_UXRCE_DDS_CLIENT
	bool "uxrce_dds_client"
	default n
	---help---
		Enable support for the UXRCE-DDS Client

menuconfig UXRCE_DDS_CLIENT_USE_DDS_V3
depends on MODULES_UXRCE_DDS_CLIENT
	bool "use DDS v3"
	default n
	---help---
		Enabel support for Micro-XRCE-DDS-Client version 3.
```

## src/modules/virtual_imu/Kconfig
```kconfig
menuconfig MODULES_VIRTUAL_IMU
	bool "virtual_imu"
	default n
	---help---
		Enable support for virtual_imu

menuconfig USER_VIRTUAL_IMU
	bool "virtual_imu running as userspace module"
	default n
	depends on BOARD_PROTECTED && MODULES_VIRTUAL_IMU
	---help---
		Put virtual_imu in userspace memory
```

## src/modules/vision_target_estimator/Kconfig
```kconfig
menuconfig MODULES_VISION_TARGET_ESTIMATOR
	bool "vision_target_estimator"
	default n
	depends on !BOARD_CONSTRAINED_MEMORY
	depends on !BOARD_CONSTRAINED_FLASH
	---help---
		Enable support for vision_target_estimator

menuconfig USER_VISION_TARGET_ESTIMATOR
	bool "vision_target_estimator running as userspace module"
	default y
	depends on BOARD_PROTECTED && MODULES_VISION_TARGET_ESTIMATOR
	---help---
		Put vision_target_estimator in userspace memory

menuconfig VTEST_MOVING
	depends on MODULES_VISION_TARGET_ESTIMATOR
        bool "vtest with moving target"
        default n
	depends on !BOARD_CONSTRAINED_MEMORY
	depends on !BOARD_CONSTRAINED_FLASH
	---help---
		Enable support for estimation of moving targets.
		WARNING: Experimental beta version
```

## src/modules/vmount/Kconfig
```kconfig
menuconfig MODULES_VMOUNT
	bool "vmount"
	default n
	---help---
		Enable support for vmount

menuconfig USER_VMOUNT
	bool "vmount running as userspace module"
	default y
	depends on BOARD_PROTECTED && MODULES_VMOUNT
	---help---
		Put vmount in userspace memory
```

## src/modules/voliro_allocator/Kconfig
```kconfig
menuconfig MODULES_VOLIRO_ALLOCATOR
	bool "voliro_allocator"
	default n
	---help---
		Dedicated six-rotor, six-independent-tilt Voliro control allocator.
```

## src/modules/voliro_control/Kconfig
```kconfig
menuconfig MODULES_VOLIRO_CONTROL
	bool "voliro_control"
	default n
	---help---
		Fully actuated Voliro position-and-attitude controller.
```

## src/modules/vtol_att_control/Kconfig
```kconfig
menuconfig MODULES_VTOL_ATT_CONTROL
	bool "vtol_att_control"
	default n
	---help---
		Enable support for vtol_att_control

menuconfig USER_VTOL_ATT_CONTROL
	bool "vtol_att_control running as userspace module"
	default n
	depends on BOARD_PROTECTED && MODULES_VTOL_ATT_CONTROL
	---help---
		Put vtol_att_control in userspace memory
```

## src/modules/wind_estimator_3d/Kconfig
```kconfig
menuconfig MODULES_WIND_ESTIMATOR_3D
	bool "wind_estimator_3d"
	default n
	---help---
		Enable support for wind_estimator_3d

menuconfig USER_WIND_ESTIMATOR_3D
	bool "wind_estimator_3d running as userspace module"
	default n
	depends on BOARD_PROTECTED && MODULES_WIND_ESTIMATOR_3D
	---help---
		Put wind_estimator_3d in userspace memory
```

## src/modules/zenoh/Kconfig
```kconfig
menuconfig MODULES_ZENOH
	bool "Zenoh"
	default n
	select LIB_CDRSTREAM
	---help---
		Enable support for Zenoh

if MODULES_ZENOH
    config ZENOH_DEBUG
        int "Zenoh debug level"
        default 0
        help
            Set Zenoh debug level
            0: NONE
            1: ERROR
            2: INFO + ERROR
            3: DEBUG + INFO + ERROR

    config ZENOH_DEFAULT_LOCATOR
        string "Zenoh default mode"
        default "tcp/127.0.0.1:7447" if PLATFORM_POSIX
        default "tcp/10.41.10.1:7447#iface=eth0" if !PLATFORM_POSIX

    config ZENOH_RMW_LIVELINESS
        bool "[EXPERIMENTAL] rmw_zenoh liveliness implemenation"
        default y
        ---help---
                Declares liveliness tokens with key expressions in the way rmw_zenoh expects them
                Allowing to construct ROS2 graphs

    config ZENOH_PUB_ON_MATCHING
        bool "[EXPERIMENTAL] Only publish data when having matching subscribers"
        default n
        ---help---
                Uses the Zenoh matching feature to check whether a publisher has subscribers.
                If so, only then publish the data. This is still experimental


    # Choose exactly one item
    choice ZENOH_PUBSUB_SELECTION
            prompt "Publishers/Subscribers selection"
            default ZENOH_PUBSUB_ALL

    config ZENOH_PUBSUB_MINIMAL
            bool "Minimal"
            select ZENOH_PUBSUB_COLLISION_CONSTRAINTS
            select ZENOH_PUBSUB_FAILSAFE_FLAGS
            select ZENOH_PUBSUB_POSITION_SETPOINT_TRIPLET
            select ZENOH_PUBSUB_SENSOR_COMBINED
            select ZENOH_PUBSUB_TIMESYNC_STATUS
            select ZENOH_PUBSUB_VEHICLE_ATTITUDE
            select ZENOH_PUBSUB_VEHICLE_CONTROL_MODE
            select ZENOH_PUBSUB_VEHICLE_GLOBAL_POSITION
            select ZENOH_PUBSUB_SENSOR_GPS
            select ZENOH_PUBSUB_VEHICLE_LOCAL_POSITION
            select ZENOH_PUBSUB_VEHICLE_ODOMETRY
            select ZENOH_PUBSUB_VEHICLE_STATUS
            select ZENOH_PUBSUB_TRAJECTORY_WAYPOINT
            select ZENOH_PUBSUB_OFFBOARD_CONTROL_MODE
            select ZENOH_PUBSUB_ONBOARD_COMPUTER_STATUS
            select ZENOH_PUBSUB_OBSTACLE_DISTANCE
            select ZENOH_PUBSUB_SENSOR_OPTICAL_FLOW
            select ZENOH_PUBSUB_TELEMETRY_STATUS
            select ZENOH_PUBSUB_TRAJECTORY_SETPOINT
            select ZENOH_PUBSUB_VEHICLE_ATTITUDE_SETPOINT
            select ZENOH_PUBSUB_VEHICLE_ODOMETRY
            select ZENOH_PUBSUB_VEHICLE_RATES_SETPOINT
            select ZENOH_PUBSUB_VEHICLE_COMMAND
    config ZENOH_PUBSUB_ALL
            bool "All"

    config ZENOH_PUBSUB_CUSTOM
            bool "Custom"
    endchoice

endif

rsource "Kconfig.topics"
```
