## src/modules/flow_gyro/Kconfig
```kconfig
menuconfig MODULES_FLOW_GYRO
	bool "flow_gyro"
	default n
	---help---
		Enable support for work_item
```

## src/modules/fw_att_control/Kconfig
```kconfig
menuconfig MODULES_FW_ATT_CONTROL
	bool "fw_att_control"
	default n
	---help---
		Enable support for fw_att_control

menuconfig USER_FW_ATT_CONTROL
	bool "fw_att_control running as userspace module"
	default n
	depends on BOARD_PROTECTED && MODULES_FW_ATT_CONTROL
	---help---
		Put fw_att_control in userspace memory
```

## src/modules/fw_autotune_attitude_control/Kconfig
```kconfig
menuconfig MODULES_FW_AUTOTUNE_ATTITUDE_CONTROL
	bool "fw_autotune_attitude_control"
	default y if TARGET_CLASS_PLANE || TARGET_CLASS_VTOL || TARGET_CLASS_LINUX
	default n
	---help---
		Enable support for fw_autotune_attitude_control
```

## src/modules/fw_dyn_soar_control/Kconfig
```kconfig
menuconfig MODULES_FW_DYN_SOAR_CONTROL
	bool "fw_dyn_soar_control"
	default n
	---help---
		Enable support for fw_dyn_soar_control

menuconfig USER_FW_DYN_SOAR_CONTROL
	bool "fw_dyn_soar_control running as userspace module"
	default n
	depends on BOARD_PROTECTED && MODULES_FW_DYN_SOAR_CONTROL
	---help---
		Put fw_dyn_soar_control in userspace memory
```

## src/modules/fw_guidance_control/Kconfig
```kconfig
menuconfig MODULES_FW_GUIDANCE_CONTROL
	bool "fw_guidance_control"
	default n
	---help---
		Enable support for fw_guidance_control

menuconfig USER_FW_MODE_MANAGER
	bool "fw_guidance_control running as userspace module"
	default n
	depends on BOARD_PROTECTED && MODULES_FW_MODE_MANAGER
	---help---
		Put fw_guidance_control in userspace memory
```

## src/modules/fw_indi_pos_control/Kconfig
```kconfig
menuconfig MODULES_FW_INDI_POS_CONTROL
	bool "fw_indi_pos_control"
	default n
	---help---
		Enable support for fw_att_control

menuconfig USER_FW_INDI_POS_CONTROL
	bool "fw_indi_pos_control running as userspace module"
	default n
	depends on BOARD_PROTECTED && MODULES_FW_INDI_POS_CONTROL
	---help---
		Put fw_indi_pos_control in userspace memory
```

## src/modules/fw_lateral_longitudinal_control/Kconfig
```kconfig
menuconfig MODULES_FW_LATERAL_LONGITUDINAL_CONTROL
	bool "fw_lateral_longitudinal_control"
	default y if TARGET_CLASS_PLANE || TARGET_CLASS_VTOL || TARGET_CLASS_LINUX
	default n
	---help---
		Enable support for fw_lat_lon_control
```

## src/modules/fw_mode_manager/Kconfig
```kconfig
menuconfig MODULES_FW_MODE_MANAGER
	bool "fw_mode_manager"
	default y if TARGET_CLASS_PLANE || TARGET_CLASS_VTOL || TARGET_CLASS_LINUX
	default n
	---help---
		Enable support for fw_mode_manager

menuconfig USER_FW_MODE_MANAGER
	bool "fw_mode_manager running as userspace module"
	default n
	depends on BOARD_PROTECTED && MODULES_FW_MODE_MANAGER
	---help---
		Put fw_mode_manager in userspace memory

menuconfig FIGURE_OF_EIGHT
	bool "fw_mode_manager figure of eight loiter support"
	default n
	depends on MODULES_FW_MODE_MANAGER
	---help---
		Enable support for the figure of eight loitering pattern in fixed wing.
		NOTE: Enable Mavlink development support to get feedback message.
```

## src/modules/fw_mpc_avoidance/Kconfig
```kconfig
menuconfig MODULES_FW_MPC_AVOIDANCE
	bool "fw_mpc_avoidance"
	default n
	---help---
		Enable fixed-wing MPC avoidance prototype module.

if MODULES_FW_MPC_AVOIDANCE

config PX4_MAIN
	string
	default "fw_mpc_avoidance"

endif
```

## src/modules/fw_path_navigation/Kconfig
```kconfig
menuconfig MODULES_FW_PATH_NAVIGATION
	bool "fw_path_navigation"
	default n
	---help---
		Enable support for fw_path_navigation

menuconfig USER_FW_PATH_NAVIGATION
	bool "fw_path_navigation running as userspace module"
	default n
	depends on BOARD_PROTECTED && MODULES_FW_PATH_NAVIGATION
	---help---
		Put fw_path_navigation in userspace memory
```

## src/modules/fw_pos_control/Kconfig
```kconfig
menuconfig MODULES_FW_POS_CONTROL
	bool "fw_pos_control"
	default n
	---help---
		Enable support for fw_pos_control

menuconfig USER_FW_POS_CONTROL
	bool "fw_pos_control running as userspace module"
	default n
	depends on BOARD_PROTECTED && MODULES_FW_POS_CONTROL
	---help---
		Put fw_pos_control in userspace memory

menuconfig FIGURE_OF_EIGHT
	bool "fw_pos_control figure of eight loiter support"
	default n
	depends on MODULES_FW_POS_CONTROL
	---help---
		Enable support for the figure of eight loitering pattern in fixed wing.
		NOTE: Enable Mavlink development support to get feedback message.
```

## src/modules/fw_pos_control_l1/Kconfig
```kconfig
menuconfig MODULES_FW_POS_CONTROL_L1
	bool "fw_pos_control_l1"
	default n
	---help---
		Enable support for fw_pos_control_l1

menuconfig USER_FW_POS_CONTROL_L1
	bool "fw_pos_control_l1 running as userspace module"
	default n
	depends on BOARD_PROTECTED && MODULES_FW_POS_CONTROL_L1
	---help---
		Put fw_pos_control_l1 in userspace memory
```

## src/modules/fw_rate_control/Kconfig
```kconfig
menuconfig MODULES_FW_RATE_CONTROL
	bool "fw_rate_control"
	default n
	---help---
		Enable support for fw_att_control

menuconfig USER_FW_RATE_CONTROL
	bool "fw_rate_control running as userspace module"
	default n
	depends on BOARD_PROTECTED && MODULES_FW_RATE_CONTROL
	---help---
		Put fw_rate_control in userspace memory
```

## src/modules/fw_wind_estimator/Kconfig
```kconfig
menuconfig MODULES_FW_WIND_ESTIMATOR
	bool "fw_wind_estimator"
	default n
	---help---
		Enable support for fw_wind_estimator

menuconfig USER_FW_RATE_CONTROL
	bool "fw_wind_estimator running as userspace module"
	default n
	depends on BOARD_PROTECTED && MODULES_FW_WIND_ESTIMATOR
	---help---
		Put fw_wind_estimator in userspace memory
```

## src/modules/gimbal/Kconfig
```kconfig
menuconfig MODULES_GIMBAL
	bool "gimbal"
	default n
	---help---
		Enable support for GIMBAL

menuconfig USER_GIMBAL
	bool "gimbal running as userspace module"
	default y
	depends on BOARD_PROTECTED && MODULES_GIMBAL
	---help---
		Put gimbal in userspace memory
```

## src/modules/gps_base_station/Kconfig
```kconfig
menuconfig MODULES_GPS_BASE_STATION
	bool "gps_base_station"
	default n
	---help---
		Enable support for gps_base_station
```

## src/modules/gyro_calibration/Kconfig
```kconfig
menuconfig MODULES_GYRO_CALIBRATION
	bool "gyro_calibration"
	default n
	---help---
		Enable support for gyro_calibration

menuconfig USER_GYRO_CALIBRATION
	bool "gyro_calibration running as userspace module"
	default y
	depends on BOARD_PROTECTED && MODULES_GYRO_CALIBRATION
	---help---
		Put gyro_calibration in userspace memory
```

## src/modules/gyro_fft/Kconfig
```kconfig
menuconfig MODULES_GYRO_FFT
	bool "gyro_fft"
	default n
	---help---
		Enable support for gyro_fft

menuconfig USER_GYRO_FFT
	bool "gyro_fft running as userspace module"
	default n
	depends on BOARD_PROTECTED && MODULES_GYRO_FFT
	---help---
		Put gyro_fft in userspace memory
```

## src/modules/hardfault_stream/Kconfig
```kconfig
menuconfig MODULES_HARDFAULT_STREAM
	bool "hardfault_stream"
	default n
	depends on PLATFORM_NUTTX
	---help---
		Enable support for hardfault_stream
```

## src/modules/ignition_simulator/Kconfig
```kconfig
menuconfig MODULES_IGNITION_SIMULATOR
	bool "ignition_simulator"
	default n
	---help---
		Enable support for ignition_simulator
```

## src/modules/indi_att_control/Kconfig
```kconfig
#
#  Kconfig for indi_att_control module
#

menu "INDI Attitude Control Module"

#
# Top‐level switch: include or exclude indi_att_control entirely
#
config MODULES_INDI_ATT_CONTROL
    bool "indi_att_control"
    default n
    help
      Enable compilation of the INDI‐based attitude‐control module
      (indi_att_control).  When set to 'y', the build system will compile
      and link in the files under src/modules/indi_att_control/ so that
      you can run an INDI‐based inner‐loop in place of the stock PID loop.

#
# If you want indi_att_control to run in userspace (protected memory),
# you must enable BOARD_PROTECTED and also have MODULES_INDI_ATT_CONTROL=y.
#
config USER_INDI_ATT_CONTROL
    bool "indi_att_control running as a userspace module"
    default n
    depends on BOARD_PROTECTED && MODULES_INDI_ATT_CONTROL
    help
      Run indi_att_control in userspace (rather than in the NuttX kernel).
      This requires that your chosen board is built with BOARD_PROTECTED=y
      (i.e. a protected‐mode/NX configuration).  If you do not need/isolate
      the module into userspace, simply leave this off.


endmenu
```

## src/modules/internal_combustion_engine_control/Kconfig
```kconfig
menuconfig MODULES_INTERNAL_COMBUSTION_ENGINE_CONTROL
	bool "internal_combustion_engine_control"
	default n
	---help---
		Enable support for internal_combustion_engine_control
```

## src/modules/knr/PreflightCalibration/Kconfig
```kconfig
menuconfig MODULES_PREFLIGHT_CALIBRATION
	bool "preflight_calibration"
	default y
	---help---
		Enable support for preflight_calibration

menuconfig USER_PREFLIGHT_CALIBRATION
	bool "preflight_calibration running as userspace module"
	default y
	depends on BOARD_PROTECTED && MODULES_PREFLIGHT_CALIBRATION
	---help---
		Put preflight_calibration in userspace memory
```

## src/modules/land_detector/Kconfig
```kconfig
menuconfig MODULES_LAND_DETECTOR
	bool "land_detector"
	default n
	---help---
		Enable support for land_detector

menuconfig USER_LAND_DETECTOR
	bool "land_detector running as userspace module"
	default y
	depends on BOARD_PROTECTED && MODULES_LAND_DETECTOR
	---help---
		Put land_detector in userspace memory
```

## src/modules/lifetime_health_monitor/Kconfig
```kconfig
menuconfig MODULES_LIFETIME_HEALTH_MONITOR
	bool "lifetime_health_monitor"
	default n
	---help---
		Enable support for lifetime_health_monitor
```
