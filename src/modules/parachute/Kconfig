## src/modules/parachute/Kconfig
```kconfig
menuconfig MODULES_PARACHUTE
	bool "parachute"
	default n
	---help---
		Enable parachute module to release the parachute output function
		via the DO_PARACHUTE vehicle command
```

## src/modules/param_set_selector/Kconfig
```kconfig
menuconfig MODULES_PARAM_SET_SELECTOR
	bool "param_set_selector"
	default n
	---help---
		Enable parameter set selector moudle

menuconfig USER_PARAM_SET_SELECTOR
	bool "param_set_selector running as userspace module"
	default n
	depends on BOARD_PROTECTED && MODULES_PARAM_SET_SELECTOR
	---help---
		Put param_set_selector in userspace memory
```

## src/modules/parameter_manager/Kconfig
```kconfig
menuconfig MODULES_PARAMETER_MANAGER
	bool "parameter_manager"
	default n
	---help---
		Enable support for the Parameter Manager module.

		This module provides a uORB-based parameter microservice that enables
		external systems (such as ROS2 via DDS) to look up parameters by name
		and enumerate available parameters.
```

## src/modules/payload_deliverer/Kconfig
```kconfig
menuconfig MODULES_PAYLOAD_DELIVERER
	bool "payload_deliverer"
	default n
	---help---
		Enable payload_deliverer module
```

## src/modules/pwm_voltage_control/Kconfig
```kconfig
menuconfig MODULES_PWM_VOLTAGE_CONTROL
	bool "pwm_voltage_control"
	default n
	---help---
		Enable support for pwm_voltage_control
```

## src/modules/quadruped/Kconfig
```kconfig
menuconfig MODULES_QUADRUPED
        bool "quadruped"
        default n
        ---help---
                Enable support for quadruped control
```

## src/modules/rc_update/Kconfig
```kconfig
menuconfig MODULES_RC_UPDATE
	bool "rc_update"
	default n
	---help---
		Enable support for rc_update

menuconfig USER_RC_UPDATE
	bool "rc_update running as userspace module"
	default y
	depends on BOARD_PROTECTED && MODULES_RC_UPDATE
	---help---
		Put rc_update in userspace memory
```

## src/modules/robosub/rs_arm_control/Kconfig
```kconfig
menuconfig MODULES_ROBOSUB_RS_ARM_CONTROL
	bool "robosub_arm_control"
	default n
	---help---
		Enable support for robosub_arm_control

menuconfig USER_ROBOSUB_RS_ARM_CONTROL
	bool "robosub_arm_control running as userspace module"
	default y
	depends on BOARD_PROTECTED && MODULES_ROBOSUB_RS_ARM_CONTROL
	---help---
		Put robosub_arm_control in userspace memory
```

## src/modules/robosub/rs_canfd_sender/Kconfig
```kconfig
menuconfig MODULES_ROBOSUB_RS_CANFD_SENDER
	bool "robosub_canfd_sender"
	default n
	---help---
		Enable support for robosub_canfd_sender

menuconfig USER_ROBOSUB_RS_CANFD_SENDER
	bool "robosub_canfd_sender running as userspace module"
	default y
	depends on BOARD_PROTECTED && MODULES_ROBOSUB_RS_CANFD_SENDER
	---help---
		Put robosub_canfd_sender in userspace memory
```

## src/modules/robosub/rs_canfd_socket/Kconfig
```kconfig
menuconfig MODULES_ROBOSUB_RS_CANFD_SOCKET
	bool "robosub_canfd_socket"
	default n
	---help---
		Enable support for robosub_canfd_socket

menuconfig USER_ROBOSUB_RS_CANFD_SOCKET
	bool "robosub_canfd_socket running as userspace module"
	default y
	depends on BOARD_PROTECTED && MODULES_ROBOSUB_RS_CANFD_SOCKET
	---help---
		Put robosub_canfd_sender in userspace memory
```

## src/modules/robosub/rs_motor_control/Kconfig
```kconfig
menuconfig MODULES_ROBOSUB_RS_MOTOR_CONTROL
	bool "robosub_motor_control"
	default n
	---help---
		Enable support for robosub_motor_control

menuconfig USER_ROBOSUB_RS_MOTOR_CONTROL
	bool "robosub_motor_control running as userspace module"
	default y
	depends on BOARD_PROTECTED && MODULES_ROBOSUB_RS_MOTOR_CONTROL
	---help---
		Put robosub_motor_control in userspace memory
```

## src/modules/robosub/rs_navigator/Kconfig
```kconfig
menuconfig MODULES_ROBOSUB_RS_NAVIGATOR
	bool "robosub_navigator"
	default n
	---help---
		Enable support for robosub_navigator

menuconfig USER_ROBOSUB_RS_NAVIGATOR
	bool "robosub_navigator running as userspace module"
	default y
	depends on BOARD_PROTECTED && MODULES_ROBOSUB_RS_NAVIGATOR
	---help---
		Put robosub_navigator in userspace memory
```

## src/modules/robosub/rs_object_detection/Kconfig
```kconfig
menuconfig MODULES_ROBOSUB_RS_OBJECT_DETECTION
	bool "robosub_object_detection"
	default n
	---help---
		Enable support for robosub_object_detection

menuconfig USER_ROBOSUB_RS_OBJECT_DETECTION
	bool "robosub_object_detection running as userspace module"
	default y
	depends on BOARD_PROTECTED && MODULES_ROBOSUB_RS_OBJECT_DETECTION
	---help---
		Put robosub_object_detection in userspace memory
```

## src/modules/robosub/rs_pos_control/Kconfig
```kconfig
menuconfig MODULES_ROBOSUB_RS_POS_CONTROL
	bool "robosub_pos_control"
	default n
	---help---
		Enable support for robosub_pos_control

menuconfig USER_ROBOSUB_RS_MOTOR_CONTROL
	bool "robosub_pos_control running as userspace module"
	default y
	depends on BOARD_PROTECTED && MODULES_ROBOSUB_RS_POS_CONTROL
	---help---
		Put robosub_pos_control in userspace memory
```

## src/modules/robosub/rs_pwm_led/Kconfig
```kconfig
menuconfig MODULES_ROBOSUB_RS_PWM_LED
	bool "robosub_pwm_led"
	default n
	---help---
		Enable support for robosub_pwm_led

menuconfig USER_ROBOSUB_RS_PWM_LED
	bool "robosub_pwm_led running as userspace module"
	default y
	depends on BOARD_PROTECTED && MODULES_ROBOSUB_RS_MOTOR_CONTROL
	---help---
		Put robosub_pwm_led in userspace memory
```

## src/modules/robosub/rs_remote_control/Kconfig
```kconfig
menuconfig MODULES_ROBOSUB_RS_REMOTE_CONTROL
	bool "robosub_remote_control"
	default n
	---help---
		Enable support for robosub_remote_control

menuconfig USER_ROBOSUB_RS_REMOTE_CONTROL
	bool "robosub_remote_control running as userspace module"
	default y
	depends on BOARD_PROTECTED && MODULES_ROBOSUB_RS_REMOTE_CONTROL
	---help---
		Put robosub_remote_control in userspace memory
```

## src/modules/rocket_mode_manager/Kconfig
```kconfig
menuconfig MODULES_ROCKET_MODE_MANAGER
	bool "rocket_mode_manager"
	default n
	---help---
		Enable support for rocket mode manager

config MODULES_ROCKET_MODE_MANAGER_ALWAYS_ENABLED
	bool
	default y if MODULES_ROCKET_MODE_MANAGER && BOARD_PROTECTED && BOARD_KERNEL_SIDE
	---help---
		rocket_mode_manager is always enabled on the kernel side
```

## src/modules/rover_ackermann/Kconfig
```kconfig
menuconfig MODULES_ROVER_ACKERMANN
	bool "rover_ackermann"
	default y if TARGET_CLASS_ROVER
	default n
	---help---
		Enable support for ackermann rovers
```

## src/modules/rover_control/Kconfig
```kconfig
menuconfig MODULES_ROVER_CONTROL
	bool "ROVER_CONTROL"
	default n
	depends on MODULES_CONTROL_ALLOCATOR
	---help---
		Enable support for control of differential drive rovers
```

## src/modules/rover_differential/Kconfig
```kconfig
menuconfig MODULES_ROVER_DIFFERENTIAL
	bool "rover_differential"
	default y if TARGET_CLASS_ROVER
	default n
	---help---
		Enable support for differential rovers
```

## src/modules/rover_mecanum/Kconfig
```kconfig
menuconfig MODULES_ROVER_MECANUM
	bool "rover_mecanum"
	default y if TARGET_CLASS_ROVER
	default n
	---help---
		Enable support for mecanum rovers
```

## src/modules/rover_pos_control/Kconfig
```kconfig
menuconfig MODULES_ROVER_POS_CONTROL
	bool "rover_pos_control"
	default n
	---help---
		Enable support for rover_pos_control

menuconfig USER_ROVER_POS_CONTROL
	bool "rover_pos_control running as userspace module"
	default y
	depends on BOARD_PROTECTED && MODULES_ROVER_POS_CONTROL
	---help---
		Put rover_pos_control in userspace memory
```

## src/modules/sc_att_control/Kconfig
```kconfig
menuconfig MODULES_SC_ATT_CONTROL
	bool "sc_att_control"
	default n
	---help---
		Enable support for sc_att_control

menuconfig USER_SC_ATT_CONTROL
	bool "sc_att_control running as userspace module"
	default n
	depends on BOARD_PROTECTED && MODULES_SC_ATT_CONTROL
	---help---
		Put sc_att_control in userspace memory
```

## src/modules/sc_control_allocator/Kconfig
```kconfig
menuconfig MODULES_SC_CONTROL_ALLOCATOR
	bool "sc_control_allocator"
	default n
	---help---
		Enable support for control_allocator

menuconfig USER_SC_CONTROL_ALLOCATOR
	bool "control_allocator running as userspace module"
	default y
	depends on BOARD_PROTECTED && MODULES_SC_CONTROL_ALLOCATOR
	---help---
		Put sc_control_allocator in userspace memory
```
