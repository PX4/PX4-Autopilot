## src/modules/vtol_att_control/Kconfig
```kconfig
config PACKAGE_VTOL
	bool "VTOL package"
	select PACKAGE_MULTICOPTER
	select PACKAGE_FIXEDWING
	imply MODULES_VTOL_ATT_CONTROL
	---help---
		Modules rc.vtol_apps starts unconditionally: the multicopter and
		fixed-wing packages plus the VTOL attitude controller.

		Modules are implied: each one defaults to enabled and can
		still be disabled individually with CONFIG_MODULES_<NAME>=n.

menuconfig MODULES_VTOL_ATT_CONTROL
	bool "vtol_att_control"
	default n
	---help---
		Enable support for vtol_att_control

menuconfig USER_VTOL_ATT_CONTROL
	bool "vtol_att_control running as userspace module"
	default n
	depends on BOARD_PROTECTED && MODULES_VTOL_ATT_CONTROL
	---help---
		Put vtol_att_control in userspace memory
```

## src/systemcmds/Kconfig
```kconfig
menuconfig COMMON_DIAGNOSTICS
	bool "Common diagnostic commands"
	default n
	imply SYSTEMCMDS_DMESG
	imply SYSTEMCMDS_PERF
	imply SYSTEMCMDS_TOP
	imply SYSTEMCMDS_TOPIC_LISTENER
	imply SYSTEMCMDS_UORB
	imply SYSTEMCMDS_WORK_QUEUE
	---help---
		Shell commands to inspect a running system.

		Commands are implied: each one defaults to enabled and can
		still be disabled individually with CONFIG_SYSTEMCMDS_<NAME>=n.

rsource "*/Kconfig"
```
