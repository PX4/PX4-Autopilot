## boards/thiemar/s2740vc-v1/nuttx-config/nsh/defconfig
```kconfig
# CONFIG_ARCH_FPU is not set
# CONFIG_DEV_NULL is not set
# CONFIG_DISABLE_OS_API is not set
# CONFIG_DISABLE_PSEUDOFS_OPERATIONS is not set
CONFIG_ARCH="arm"
CONFIG_ARCH_BOARD_CUSTOM_DIR="../nuttx-config"
CONFIG_ARCH_BOARD_CUSTOM_NAME="px4"
CONFIG_ARCH_CHIP_STM32=y
CONFIG_ARCH_CHIP_STM32F302K8=y
CONFIG_ARCH_INTERRUPTSTACK=1024
CONFIG_ARCH_MATH_H=y
CONFIG_ARCH_STACKDUMP=y
CONFIG_ARMV7M_MEMCPY=y
CONFIG_ARMV7M_USEBASEPRI=y
CONFIG_BOARDCTL_RESET=y
CONFIG_BOARD_INITIALIZE=y
CONFIG_BOARD_LOOPSPERMSEC=5483
CONFIG_BUILTIN=y
CONFIG_BUILTIN_PROXY_STACKSIZE=392
CONFIG_C99_BOOL8=y
CONFIG_CLOCK_MONOTONIC=y
CONFIG_DEBUG_CUSTOMOPT=y
CONFIG_DEBUG_HARDFAULT_ALERT=y
CONFIG_DEBUG_OPTLEVEL="-Os"
CONFIG_DEBUG_SYMBOLS=y
CONFIG_DEFAULT_SMALL=y
CONFIG_EXAMPLES_NULL=y
CONFIG_FDCLONE_STDIO=y
CONFIG_GRAN=y
CONFIG_GRAN_INTR=y
CONFIG_HAVE_CXX=y
CONFIG_HAVE_CXXINITIALIZE=y
CONFIG_LIBC_LONG_LONG=y
CONFIG_LIBC_STRERROR=y
CONFIG_LIB_BOARDCTL=y
CONFIG_LIB_SENDFILE_BUFSIZE=0
CONFIG_MAX_TASKS=4
CONFIG_MAX_WDOGPARMS=2
CONFIG_MEMSET_64BIT=y
CONFIG_MEMSET_OPTSPEED=y
CONFIG_MM_REGIONS=2
CONFIG_MQ_MAXMSGSIZE=8
CONFIG_NAME_MAX=8
CONFIG_NFILE_DESCRIPTORS=5
CONFIG_NFILE_STREAMS=1
CONFIG_NPTHREAD_KEYS=0
CONFIG_NXFONTS_DISABLE_16BPP=y
CONFIG_NXFONTS_DISABLE_1BPP=y
CONFIG_NXFONTS_DISABLE_24BPP=y
CONFIG_NXFONTS_DISABLE_2BPP=y
CONFIG_NXFONTS_DISABLE_32BPP=y
CONFIG_NXFONTS_DISABLE_4BPP=y
CONFIG_NXFONTS_DISABLE_8BPP=y
CONFIG_POSIX_SPAWN_PROXY_STACKSIZE=768
CONFIG_PREALLOC_MQ_MSGS=4
CONFIG_PREALLOC_TIMERS=2
CONFIG_PREALLOC_WDOGS=4
CONFIG_PRIORITY_INHERITANCE=y
CONFIG_PTHREAD_MUTEX_ROBUST=y
CONFIG_PTHREAD_STACK_DEFAULT=768
CONFIG_RAM_SIZE=16384
CONFIG_RAM_START=0x20000000
CONFIG_RAW_BINARY=y
CONFIG_SCHED_ATEXIT=y
CONFIG_SCHED_INSTRUMENTATION=y
CONFIG_SCHED_WAITPID=y
CONFIG_SDCLONE_DISABLE=y
CONFIG_SEM_NNESTPRIO=4
CONFIG_SEM_PREALLOCHOLDERS=4
CONFIG_SIG_DEFAULT=y
CONFIG_SIG_SIGALRM_ACTION=y
CONFIG_SIG_SIGUSR1_ACTION=y
CONFIG_SIG_SIGUSR2_ACTION=y
CONFIG_STACK_COLORATION=y
CONFIG_START_DAY=30
CONFIG_START_MONTH=11
CONFIG_STM32_DISABLE_IDLE_SLEEP_DURING_DEBUG=y
CONFIG_STM32_DMA1=y
CONFIG_STM32_DMA2=y
CONFIG_STM32_FLOWCONTROL_BROKEN=y
CONFIG_STM32_FORCEPOWER=y
CONFIG_STM32_JTAG_FULL_ENABLE=y
CONFIG_STM32_PWR=y
CONFIG_STM32_SERIALBRK_BSDCOMPAT=y
CONFIG_STM32_SERIAL_DISABLE_REORDERING=y
CONFIG_STM32_TIM3=y
CONFIG_STM32_USART1=y
CONFIG_STM32_USART_BREAKS=y
CONFIG_STM32_USART_SINGLEWIRE=y
CONFIG_SYSTEM_READLINE=y
CONFIG_TASK_NAME_SIZE=12
CONFIG_TASK_SPAWN_DEFAULT_STACKSIZE=768
CONFIG_USART1_RXBUFSIZE=32
CONFIG_USART1_RXDMA=y
CONFIG_USART1_SERIAL_CONSOLE=y
CONFIG_USART1_TXBUFSIZE=32
CONFIG_USER_ENTRYPOINT="null_main"
CONFIG_WDOG_INTRESERVE=2
```

## docs/scripts/fc_doc_generator/tests/fixtures/imxrt_all_dshot/nuttx-config/nsh/defconfig
```kconfig
CONFIG_ARCH_CHIP_IMXRT=y
CONFIG_ARCH_CHIP_MIMXRT1064DVL6A=y
CONFIG_IMXRT_LPUART2=y
CONFIG_IMXRT_LPUART3=y
CONFIG_IMXRT_LPUART4=y
CONFIG_IMXRT_LPUART5=y
CONFIG_IMXRT_LPUART6=y
CONFIG_IMXRT_LPUART7=y
CONFIG_IMXRT_LPUART8=y
CONFIG_LPUART2_SERIAL_CONSOLE=y
CONFIG_MMCSD=y
CONFIG_MMCSD_SDIO=y
```

## docs/scripts/fc_doc_generator/tests/fixtures/stm32f4_no_dshot/nuttx-config/nsh/defconfig
```kconfig
CONFIG_ARCH_CHIP_STM32F4=y
CONFIG_STM32_USART1=y
CONFIG_STM32_USART2=y
CONFIG_STM32_USART3=y
CONFIG_USART1_SERIAL_CONSOLE=y
CONFIG_STM32_UART4=y
CONFIG_STM32_UART5=y
CONFIG_STM32_USART6=y
```

## docs/scripts/fc_doc_generator/tests/fixtures/stm32f7_no_dshot/nuttx-config/nsh/defconfig
```kconfig
CONFIG_ARCH_CHIP_STM32F7=y
CONFIG_STM32_USART1=y
CONFIG_STM32_USART2=y
CONFIG_USART1_SERIAL_CONSOLE=y
```

## docs/scripts/fc_doc_generator/tests/fixtures/stm32h7_all_dshot/nuttx-config/nsh/defconfig
```kconfig
CONFIG_ARCH_CHIP_STM32H7=y
CONFIG_STM32H7_USART1=y
CONFIG_STM32H7_USART2=y
CONFIG_STM32H7_USART3=y
CONFIG_USART3_SERIAL_CONSOLE=y
CONFIG_STM32H7_UART4=y
CONFIG_STM32H7_USART6=y
CONFIG_STM32H7_UART7=y
CONFIG_MMCSD=y
CONFIG_MMCSD_SDIO=y
```

## docs/scripts/fc_doc_generator/tests/fixtures/stm32h7_ppm_shared/nuttx-config/nsh/defconfig
```kconfig
CONFIG_ARCH_CHIP_STM32H7=y
CONFIG_STM32H7_USART1=y
CONFIG_STM32H7_USART2=y
CONFIG_USART1_SERIAL_CONSOLE=y
CONFIG_STM32H7_UART4=y
CONFIG_STM32H7_USART6=y
```

## misc/buildroot/Config.in
```kconfig
#

mainmenu "Buildroot2 Configuration"

config BR2_HAVE_DOT_CONFIG
	bool
	default y

choice
	prompt "Target Architecture"
	default BR2_i386
	help
	  Select the target architecture family to build for.

config BR2_alpha
	bool "alpha"
config BR2_arm
	bool "arm"
config BR2_armeb
	bool "armeb"
config BR2_avr
	bool "avr"
config BR2_avr32
	bool "avr32"
config BR2_bfin
	bool "blackfin"
config BR2_cris
	bool "cris"
config BR2_i386
	bool "i386"
config BR2_m32c
	bool "r8c/m16c/m32c"
config BR2_m68k
	bool "m68k"
config BR2_m68hc11
	bool "m68hc11"
config BR2_m68hc12
	bool "m68hc12"
config BR2_m9s12x
	bool "m9s12x"
config BR2_mips
	bool "mips"
config BR2_mipsel
	bool "mipsel"
config BR2_nios2
	bool "nios2"
config BR2_powerpc
	bool "powerpc"
config BR2_sh
	bool "superh"
config BR2_sh64
	bool "superh64"
config BR2_h8300
	bool "H8/300"
config BR2_sparc
	bool "sparc"
config BR2_x86_64
	bool "x86_64"
endchoice

#
# Keep the variants separate, there's no need to clutter everything else.
# sh is fairly "special" in this regard, as virtually everyone else has
# things kept down to a _sensible_ number of target variants. No such
# luck for sh..
#
choice
	prompt "Target Architecture Variant"
	depends BR2_arm || BR2_armeb
	default BR2_generic_arm
	help
	  Specific CPU variant to use

config BR2_generic_arm
	bool "generic ARM"
config BR2_arm610
	bool "ARM610"
config BR2_arm7tdmi
	bool "ARM7TDMI"
config BR2_arm710
	bool "ARM710"
config BR2_arm720t
	bool "ARM720T"
config BR2_arm740t
	bool "ARM740T"
config BR2_arm920t
	bool "ARM920T"
config BR2_arm922t
	bool "ARM922T"
config BR2_arm926t
	bool "ARM926T"
config BR2_arm1136jf_s
	bool "ARM1136JF-S"
config BR2_cortex_m3
	bool "Cortex-M3"
config BR2_sa110
	bool "SA110"
config BR2_sa1100
	bool "SA1100"
config BR2_xscale
	bool "X-Scale"
config BR2_iwmmxt
	bool "iwmmxt"
endchoice

choice
	prompt "Target ABI"
	depends BR2_arm || BR2_armeb
	default BR2_ARM_OABI
	help
	  Application Binary Interface to use

config BR2_ARM_OABI
	bool "OABI"
config BR2_ARM_EABI
	bool "EABI"
endchoice

choice
	prompt "Target Architecture Variant"
	depends BR2_avr32
config BR2_ap7000
	bool "AP7000"
config BR2_ap7010
	bool "AP7010"
config BR2_ap7020
	bool "AP7020"
endchoice

choice
	prompt "Target Architecture Variant"
	depends BR2_sh
	default BR2_sh4
	help
	  Specific CPU variant to use

config BR2_sh1
	bool "sh1"
config BR2_sh2a_nofpueb
	bool "sh2a_nofpueb"
config BR2_sh2eb
	bool "sh2eb"
config BR2_sh3
	bool "sh3"
config BR2_sh3eb
	bool "sh3eb"
config BR2_sh4
	bool "sh4"
config BR2_sh4eb
	bool "sh4eb"
endchoice

#
# gcc builds libstdc++ differently depending on the
# host tuplet given to it, so let people choose
#
choice
	prompt "Target Architecture Variant"
	depends BR2_i386
	default BR2_x86_i686
	help
	  Specific CPU variant to use

config BR2_x86_i386
	bool "i386"
config BR2_x86_i486
	bool "i486"
config BR2_x86_i586
	bool "i586"
config BR2_x86_i686
	bool "i686"
endchoice

config BR2_ARCH
	string
	default "alpha"		if BR2_alpha
	default "arm"		if BR2_arm
	default "armeb"		if BR2_armeb
	default "avr"		if BR2_avr
	default "avr32"		if BR2_avr32
	default "bfin"		if BR2_bfin
	default "cris"		if BR2_cris
	default "i386"		if BR2_x86_i386
	default "i486"		if BR2_x86_i486
	default "i586"		if BR2_x86_i586
	default "i686"		if BR2_x86_i686
	default "m32c"		if BR2_m32c
	default "m68k"		if BR2_m68k
	default "m68hc11"	if BR2_m68hc11
	default "m68hc12"	if BR2_m68hc12
	default "m9s12x"	if BR2_m9s12x
	default "mips"		if BR2_mips
	default "mipsel"	if BR2_mipsel
	default "nios2"		if BR2_nios2
	default "powerpc"	if BR2_powerpc
	default "sh"		if BR2_sh1
	default "sh2a_nofpueb"	if BR2_sh2a_nofpueb
	default "sh2eb"		if BR2_sh2eb
	default "sh3"		if BR2_sh3
	default "sh3eb"		if BR2_sh3eb
	default "sh4"		if BR2_sh4
	default "sh4eb"		if BR2_sh4eb
	default "sh64"		if BR2_sh64
	default "h8300"		if BR2_h8300
	default "sparc"		if BR2_sparc

config BR2_GCC_TARGET_TUNE
	string
	default i386		if BR2_x86_i386
	default i486		if BR2_x86_i486
	default i586		if BR2_x86_i586
	default i686		if BR2_x86_i686
	default arm610		if BR2_arm610
	default arm7tdmi	if BR2_arm7tdmi || BR2_arm720t || BR2_arm740t
	default arm920t		if BR2_arm920t
	default arm922t		if BR2_arm922t
	default arm9tdmi	if BR2_arm926t
	default arm1136jf-s	if BR2_arm1136jf_s
	default cortex-m3	if BR2_cortex_m3
	default strongarm110	if BR2_sa110
	default strongarm1100	if BR2_sa1100
	default xscale		if BR2_xscale
	default iwmmxt		if BR2_iwmmxt

config BR2_GCC_TARGET_ARCH
	string
	default i386		if BR2_x86_i386
	default i486		if BR2_x86_i486
	default i586		if BR2_x86_i586
	default i686		if BR2_x86_i686
	default armv3		if BR2_arm610 || BR2_arm710
	default armv4		if BR2_sa110 || BR2_sa1100
	default armv4t		if BR2_arm7tdmi
	default armv4t		if BR2_arm720t || BR2_arm920t || BR2_arm922t
	default armv5te		if BR2_arm926t || BR2_arm10t || BR2_xscale
	default armv6j		if BR2_arm1136jf_s
	default armv7-m		if BR2_cortex_m3
	default iwmmxt		if BR2_iwmmxt

config BR2_GCC_TARGET_ABI
	string
	default apcs-gnu	if BR2_ARM_OABI
	default aapcs-linux	if BR2_ARM_EABI

config BR2_ENDIAN
	string
	default "LITTLE" if BR2_arm || BR2_avr || BR2_bfin || BR2_cris || BR2_i386 || BR2_m32c || \
	                    BR2_mipsel || BR2_sh3 || BR2_sh4 || BR2_x86_64 || \
			    BR2_nios2 || BR2_sh64 || BR2_h8300
	default "BIG"    if BR2_alpha || BR2_armeb || BR2_avr32 || BR2_m68k || \
			    BR2_m68hc11 || BR2_m68hc12 || BR2_m9s12x || BR2_mips || \
	                    BR2_powerpc || BR2_sh1 || BR2_sh2a_nofpueb || BR2_sh2eb || \
	                    BR2_sh3eb || BR2_sh4eb || BR2_sparc

menu "Build options"

config BR2_WGET
	string "Wget command"
	default "wget --passive-ftp -nd"

config BR2_SVN
	string "Subversion (svn) checkout command"
	default "svn co"

config BR2_ZCAT
	string "zcat command"
	default "zcat"
	help
	  Command to be used to extract a gzip'ed file to stdout.
	  zcat is identical to gunzip -c except that the former may
	  not be available on your system.
	  Default is "zcat"
	  Other possible values include "gunzip -c" or "gzip -d -c".

config BR2_BZCAT
	string "bzcat command"
	default "bzcat"
	help
	  Command to be used to extract a bzip2'ed file to stdout.
	  bzcat is identical to bunzip2 -c except that the former may
	  not be available on your system.
	  Default is "bzcat"
	  Other possible values include "bunzip2 -c" or "bzip2 -d -c".

config BR2_TAR_OPTIONS
	string "Tar options"
	default ""
	help
	  Options to pass to tar when extracting the sources.
	  E.g. " -v --exclude='*.svn*'" to exclude all .svn internal files
	  and to be verbose.

config BR2_DL_DIR
	string "Download dir"
	default "$(BASE_DIR)/dl"
	help
	  Directory to store all the source files that we need to fetch.

config BR2_STAGING_DIR
	string "Toolchain and header file location?"
	default "$(BUILD_DIR)/staging_dir"
	help
	  This is the location where the toolchain will be installed.  The
	  toolchain will not work if it is moved from this location.
	  Therefore, if you wish to package up a uClibc toolchain, it is
	  important that is is set to the final location where the toolchain
	  will be used.

	  Most people will leave this set to the default value of
	  "$(BUILD_DIR)/staging_dir".

config BR2_NUTTX_DIR
	string "Path to the NuttX root directory"
	default "$(TOPDIR)/../../nuttx"
	help
	  This is the location where the NuttX source tree is located.

config BR2_TOPDIR_PREFIX
	string "Custom build dir prefix"
	default ""
	help
	  Add a custom string to the beginning of the build directories.

	  build_ARCH -> [PREFIX]_build_ARCH
	  toolchain_build_ARCH -> [PREFIX]_toolchain_build_ARCH

config BR2_TOPDIR_SUFFIX
	string "Custom build dir suffix"
	default ""
	help
	  Add a custom string to the end of the build directories.

	  build_ARCH -> build_ARCH_[SUFFIX]
	  toolchain_build_ARCH -> toolchain_build_ARCH_[SUFFIX] 

config BR2_GNU_BUILD_SUFFIX
	string "GNU build hostname suffix"
	default "pc-elf"
	help
	  The string used to pass to configure scripts via the
	  --build= option.  Just specify the suffix here, the leading
	  arch will be filled in automatically.

config BR2_GNU_TARGET_SUFFIX
	string "GNU target suffix"
	default "elf"
	help
	  The string used to pass to configure scripts via the
	  --target= option.  Just specify the suffix here, the leading
	  arch will be filled in automatically.

	  Most users will want to stick with the default setting, though
	  other users (most notably ARM EABI) like to add on to this in
	  order to stay in line with gcc conventions.

config BR2_PREFER_IMA
	bool "prefer IMA compiles"
	default n
	help
	  Where possible, compile package with Inter Module Analysis.
	  This potentially uses alot of system resources on your compile
	  host with the benefit of creating smaller binaries for the target.

	  If unsure, say No.

	  WARNING: This is highly experimental at the moment.


endmenu

source "toolchain/Config.in"
```

## misc/buildroot/toolchain/Config.in
```kconfig
#

menu "Toolchain Options"

source "toolchain/binutils/Config.in"
source "toolchain/gcc/Config.in"
source "toolchain/gdb/Config.in"
source "toolchain/nxflat/Config.in"
source "toolchain/genromfs/Config.in"

comment "Common Toolchain Options"

source "toolchain/sstrip/Config.in"

config BR2_ENABLE_MULTILIB
	bool "Enable multilib support?"
	default n
	help
	    If you want multilib enabled, enable this...

config BR2_LARGEFILE
	bool "Enable large file (files > 2 GB) support?"
	depends on !BR2_cris
	default y
	help
	    Enable large file (files > 2 GB) support

config BR2_SOFT_FLOAT
	bool "Use software floating point by default"
	default n
	depends on BR2_arm || BR2_armeb || BR2_mips || BR2_mipsel || BR2_powerpc
	help
	  If your target CPU does not have a Floating Point Unit (FPU) or a
	  kernel FPU emulator, but you still wish to support floating point
	  functions, then everything will need to be compiled with soft
	  floating point support (-msoft-float).

	  Most people will answer N.

config BR2_TARGET_OPTIMIZATION
	string "Target Optimizations"
	default "-Os -pipe"
	help
	  Optimizations to use when building for the target host.

endmenu
```

## misc/buildroot/toolchain/binutils/Config.in
```kconfig
# Choose binutils version.

comment "Binutils Options"

choice
	prompt "Binutils Version"
	default BR2_BINUTILS_VERSION_2_19_1 if BR2_cortex_m3
	default BR2_BINUTILS_VERSION_2_19 if !BR2_avr32 && !BR2_cortex_m3 && !BR2_m9s12x
	default BR2_BINUTILS_VERSION_2_18 if BR2_m9s12x
	default BR2_BINUTILS_VERSION_2_17 if !BR2_cortex_m3 && !BR2_m9s12x
	help
	  Select the version of binutils you wish to use.

	config BR2_BINUTILS_VERSION_2_17
		depends !BR2_nios2 && !BR2_cortex_m3 && !BR2_m9s12x
		bool "binutils 2.17"

	config BR2_BINUTILS_VERSION_2_18
		depends !BR2_avr32 && !BR2_nios2 && !BR2_cortex_m3
		bool "binutils 2.18"

	config BR2_BINUTILS_VERSION_2_19
		depends !BR2_avr32 && !BR2_nios2 && !BR2_cortex_m3 && !BR2_m9s12x
		bool "binutils 2.19"

	config BR2_BINUTILS_VERSION_2_19_1
		depends !BR2_avr32 && !BR2_nios2 && !BR2_m9s12x
		bool "binutils 2.19.1"

	config BR2_BINUTILS_VERSION_2_21_1
		depends !BR2_avr32 && !BR2_nios2 && !BR2_m9s12x
		bool "binutils 2.21.1"
endchoice

config BR2_BINUTILS_VERSION
	string
	default "2.17"            if BR2_BINUTILS_VERSION_2_17
	default "2.18"            if BR2_BINUTILS_VERSION_2_18
	default "2.19"            if BR2_BINUTILS_VERSION_2_19
	default "2.19.1"          if BR2_BINUTILS_VERSION_2_19_1
	default "2.21.1"          if BR2_BINUTILS_VERSION_2_21_1

config BR2_EXTRA_BINUTILS_CONFIG_OPTIONS
	string "Additional binutils options"
	default ""
	help
	  Any additional binutils options you may want to include ...
```
