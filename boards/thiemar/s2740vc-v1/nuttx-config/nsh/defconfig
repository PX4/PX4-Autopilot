## nuttx-configs/px4esc-v1/Kconfig
```kconfig
#
# For a description of the syntax of this configuration file,
# see misc/tools/kconfig-language.txt.
#

if CONFIG_ARCH_BOARD_PX4ESC_V1

config BOARD_HAS_PROBES
	bool "Board provides GPIO or other Hardware for signaling to timing analyze."
	default y
	---help---
		This board provides GPIO TEST1(PD2), TEST2(PB3), TEST3(PB4), TEST4(PC12) as PROBE_1-4 to provide timing
		signals from selected drivers.

config BOARD_USE_PROBES
	bool "Enable the use provides GPIO TEST1(PD2), TEST2(PB3), TEST3(PB4), TEST4(PC12) as PROBE_1-4 to provide
	      timing signals from selected drivers"
	default n
	depends on BOARD_HAS_PROBES

	---help---
		Select to use GPIO TEST1(PD2), TEST2(PB3), TEST3(PB4), TEST4(PC12) as PROBE_1-4 to provide timing signals
		from selected drivers.

endif
```

## nuttx-configs/px4fmu-v1/Kconfig
```kconfig
#
# For a description of the syntax of this configuration file,
# see misc/tools/kconfig-language.txt.
#

if ARCH_BOARD_PX4FMU_V1

config HRT_TIMER
	bool "High resolution timer support"
	default y
	---help---
		Enable high resolution timer for PPM capture and system clocks.

config HRT_PPM
	bool "PPM input capture"
	default y
	depends on HRT_TIMER
	---help---
		Enable PPM input capture via HRT (for CPPM / PPM sum RC inputs)

endif
```
