## misc/buildroot/toolchain/gcc/Config.in
```kconfig
# Choose gcc version.

comment "GCC Options"

config BR2_PACKAGE_GCC
        bool "Build GCC cross-compiler"
        default n
        help
            Build the GCC cross-compiler for the target architecture.

choice
	prompt "GCC compiler Version"
	default BR2_GCC_VERSION_4_3_3 if BR2_cortex_m3
	default BR2_GCC_VERSION_4_2_4 if !BR2_avr32 && !BR2_cortex_m3 && !BR2_m9s12x
	default BR2_GCC_VERSION_3_4_6 if BR2_avr32
	default BR2_GCC_VERSION_3_3_6 if BR2_m9s12x
	depends on BR2_PACKAGE_GCC
	help
	  Select the version of gcc you wish to use.

	config BR2_GCC_VERSION_3_3_6
		depends on BR2_m9s12x
		bool "gcc 3.3.6"

    config BR2_GCC_VERSION_3_4_6
		depends on !BR2_m32c && !BR2_cortex_m3 && !BR2_m9s12x
		bool "gcc 3.4.6"

	config BR2_GCC_VERSION_4_2_4
		depends on !BR2_avr32 && !BR2_nios2 && !BR2_cortex_m3 && !BR2_m9s12x
		select BR2_GCC_SUPPORTS_SYSROOT
		bool "gcc 4.2.4"

	config BR2_GCC_VERSION_4_3_3
		depends on !BR2_avr32 && !BR2_nios2 && !BR2_m9s12x
		select BR2_GCC_SUPPORTS_SYSROOT
		bool "gcc 4.3.3"

	config BR2_GCC_VERSION_4_5_2
		depends on !BR2_avr32 && !BR2_nios2 && !BR2_m9s12x
		select BR2_GCC_SUPPORTS_SYSROOT
		bool "gcc 4.5.2"

endchoice

config BR2_GCC_SUPPORTS_SYSROOT
	bool
	default n

config BR2_GCC_VERSION
	string
	default "3.3.6"     if BR2_GCC_VERSION_3_3_6
	default "3.4.6"     if BR2_GCC_VERSION_3_4_6
	default "4.2.4"     if BR2_GCC_VERSION_4_2_4
	default "4.3.3"     if BR2_GCC_VERSION_4_3_3
	default "4.5.2"     if BR2_GCC_VERSION_4_5_2

config BR2_GCC_USE_SJLJ_EXCEPTIONS
	bool "Enable setjmp/longjmp exceptions?"
	default n
	depends on BR2_PACKAGE_GCC
	help
	  For some platforms, proper stack unwinding works perfectly,
	  while other platforms must use setjmp/longjmp exceptions for
	  proper stack unwinding during exception handling.  Most people
	  can leave this set to n.

config BR2_EXTRA_GCC_CONFIG_OPTIONS
	string "Additional gcc options"
	depends on BR2_PACKAGE_GCC
	default ""
	help
	  Any additional gcc configure options you may want to include....

config BR2_INSTALL_LIBSTDCPP
	bool "Build C++ compiler?"
	depends on BR2_PACKAGE_GCC
	default n
	# >= 4.2.0 work fine without LARGEFILE
	select BR2_LARGEFILE if !BR2_GCC_SUPPORTS_SYSROOT
	help
	  Build/install c++ compiler?  NOTE: libstdc++ is not built for NuttX?

config BR2_INSTALL_LIBGCJ
	bool "Build/install java compiler and libgcj?"
	default n
	depends on BR2_PACKAGE_GCC &&  !BR2_avr32 && BR2_INSTALL_LIBSTDCPP
	help
	  Build/install java compiler and libgcj?

config BR2_INSTALL_OBJC
	bool "Build/install Objective-C compiler and runtime?"
	default n
	depends on BR2_PACKAGE_GCC && !BR2_avr32
	help
	  Build/install Objective-C compiler and runtime?

config BR2_INSTALL_FORTRAN
	bool "Build/install Fortran compiler and runtime?"
	default n
	depends on BR2_PACKAGE_GCC && !BR2_avr32
	help
	  Build/install Fortran compiler and runtime?
	  Note that it is highly recommended NOT to use gfortran
	  from gcc older than 4.2.0
```

## misc/buildroot/toolchain/gdb/Config.in
```kconfig
comment "Gdb Options"

config BR2_PACKAGE_GDB
	bool "Build gdb debugger for the Target"
	default n
	help
	    Build the full gdb debugger to run on the target.

config BR2_PACKAGE_GDB_SERVER
	bool "Build gdb server for the Target"
	default n
	help
	    Build the gdbserver stub to run on the target.
	    A full gdb is needed to debug the progam.

config BR2_PACKAGE_GDB_HOST
	bool "Build gdb for the Host"
	default n
	help
	    Build gdb to run on the host to debug programs run on the target.

choice
	prompt "GDB debugger Version"
	default BR2_GDB_VERSION_6_8 if !BR2_avr32 && !BR2_m9s12x
	default BR2_GDB_VERSION_6_4 if BR2_m9s12x
	default BR2_GDB_VERSION_6_3 if BR2_avr32
	depends on BR2_PACKAGE_GDB || BR2_PACKAGE_GDB_SERVER || BR2_PACKAGE_GDB_HOST
	help
	  Select the version of gdb you wish to use.

	config BR2_GDB_VERSION_6_3
		bool "gdb 6.3"
		depends on !BR2_avr32 && !BR2_nios2

	config BR2_GDB_VERSION_6_4
		bool "gdb 6.3"
		depends on BR2_m9s12x

	config BR2_GDB_VERSION_6_8
		bool "gdb 6.8"
		depends on !BR2_avr32

	config BR2_GDB_VERSION_7_4
		bool "gdb 7.4"
		depends on !BR2_bfin

endchoice

config BR2_GDB_VERSION
	string
	default "6.3"      if BR2_GDB_VERSION_6_3
	default "6.8"      if BR2_GDB_VERSION_6_8
	default "7.4.1"    if BR2_GDB_VERSION_7_4
```

## misc/buildroot/toolchain/genromfs/Config.in
```kconfig
config BR2_PACKAGE_GENROMFS
	bool "Build genromfs"
	default n if !BR2_PACKAGE_NXFLAT
	default y if BR2_PACKAGE_NXFLAT
	help
	  genromfs is a tools that will convert a directory on the host
	  machine to a FLASH-able ROMFS image file.  genromfs support
	  is normally required with NXFLAT.
```

## misc/buildroot/toolchain/nxflat/Config.in
```kconfig
comment "NuttX Binary Support"

config BR2_PACKAGE_NXFLAT
	bool "Build NXFLAT tools"
	default n
	depends on BR2_arm
	help
	  Build tools need to build NuttX NXFLAT load-able binary
```

## misc/buildroot/toolchain/sstrip/Config.in
```kconfig
config BR2_PACKAGE_SSTRIP_TARGET
	bool "Install sstrip for the target system"
	default n
	help
	  Maximal 'strip'ing utility.

config BR2_PACKAGE_SSTRIP_HOST
	bool "Install sstrip for the host/build system"
	default n
	help
	  Maximal 'strip'ing utility.
```

## nuttx-configs/esc35-v1/Kconfig
```kconfig
#
# For a description of the syntax of this configuration file,
# see misc/tools/kconfig-language.txt.
#

if ARCH_BOARD_ESC35_V1

config BOARD_HAS_PROBES
	bool "Board provides GPIO or other Hardware for signaling to timing analyze."
	default y
	---help---
		This board provides GPIO PC13-PC15 as PROBE_1-3 to provide timing signals from selected drivers.

config BOARD_USE_PROBES
	bool "Enable the use the board provided GPIO PC13-PC15 as PROBE_1-3 to provide timing signals from selected drivers"
	default n
	depends on BOARD_HAS_PROBES

	---help---
		Select to use GPIO PC13-PC15 as PROBE_1-3 to provide timing signals from selected drivers.

endif
```
