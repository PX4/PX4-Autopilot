## boards/thiemar/s2740vc-v1/nuttx-config/Kconfig
```kconfig
#
# For a description of the syntax of this configuration file,
# see misc/tools/kconfig-language.txt.
#

if CONFIG_ARCH_BOARD_THIEMAR_S2740VC_V1

endif

# Hack to ensure ARCH_MATH_H is kept
config BOARD_HAVE_MATH_H
	bool "Provide ARCH math.h (selects ARCH_HAVE_MATH_H)"
	default y
	select ARCH_HAVE_MATH_H
```
