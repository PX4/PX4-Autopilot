## boards/nxp/mr-navq95/Kconfig
```kconfig
menu "MR-NavQ95 board options"

choice
	prompt "GPIO_IO23 (PWM header J9 pin 9)"
	default BOARD_NAVQ95_IO23_PWM
	---help---
		The pad is TPM6 channel 1. As PWM output 8 it is the fourth output
		group, PWM or DShot like the other seven. As the buzzer it drives the
		GPS connector buzzer line (J8 pin 9) through the tone alarm driver;
		switch S1 must be closed for the buzzer to sound. Both need the
		System Manager configuration that assigns LPTPM6 to the M7, which
		the NavQ95 BSP provides. Unused leaves the pad and TPM6 untouched,
		for a System Manager configuration without that assignment.

config BOARD_NAVQ95_IO23_PWM
	bool "PWM output 8"

config BOARD_NAVQ95_IO23_BUZZER
	bool "Buzzer"
	select DRIVERS_TONE_ALARM

config BOARD_NAVQ95_IO23_NONE
	bool "Unused"
endchoice

choice
	prompt "LPUART2 (/dev/ttyS1, M7 console port)"
	default BOARD_NAVQ95_LPUART2_RC
	---help---
		LPUART2 is the M7 console port of the board: it reaches the CP2105
		USB serial bridge on the IO board (J1 CONSOLE, second port, ttyUSB1
		on a Linux host) and the main board J2 CONSOLE header (pins 4 and 5).
		As RC input it carries the RC protocol (CRSF, SBUS, ...) instead,
		with the receiver on J2 pins 4 and 5; do not connect a PC to ttyUSB1
		then, as its transmitter shares the line with the receiver. As NSH
		console it runs an NSH shell started after boot on that port, a
		plain USB serial console that does not need the Linux side; the
		NuttX system console itself stays on the RPMsg tty. UART2 TX is also
		the BT_MODE1 boot strap, so nothing may drive that line while the
		board resets.

config BOARD_NAVQ95_LPUART2_RC
	bool "RC input"

config BOARD_NAVQ95_LPUART2_CONSOLE
	bool "NSH console"
endchoice

config BOARD_SERIAL_RC
	default "/dev/ttyS1" if BOARD_NAVQ95_LPUART2_RC

config BOARD_ADDITIONAL_INIT
	default "rc.lpuart2_console" if BOARD_NAVQ95_LPUART2_CONSOLE

endmenu
```

## platforms/common/uORB/Kconfig
```kconfig
menuconfig ORB_COMMUNICATOR
	bool "orb communicator"
	default n
	depends on PLATFORM_QURT || PLATFORM_POSIX
	---help---
		Enable support for the uorb communicator for distributed platforms

config UORB_POSIX_SHM
	bool "Use POSIX shared memory for uORB"
	default n if PLATFORM_QURT
	default y if PLATFORM_POSIX
	default y if BOARD_PROTECTED
	default n
	---help---
		Back uORB topics with real POSIX shared memory (shm_open/mmap),
		which exposes each topic as a file under /obj and lets the
		filesystem track uORB nodes.

		Real shared memory is required whenever publishers and
		subscribers can live in separate address spaces: posix/SITL
		builds, and NuttX protected/kernel builds. On NuttX FLAT
		builds there is only one address space, so the shm/mmap
		indirection is unnecessary overhead; disabling it there (the
		default) saves flash. It is always disabled for qurt.

		This can still be turned on for a FLAT build if the SHM
		filesystem tracking (uORB topics visible under /obj) is
		wanted for debugging.
```

## platforms/nuttx/Kconfig
```kconfig
choice
	prompt "NuttX platform"
	---help---
		This automatically gets set by the NuttX defconfig
	config ARCH_CHIP_UNSET
		bool "Unset"
	config ARCH_CHIP_STM32H7
		bool "STM32H7"
	config ARCH_CHIP_STM32F7
		bool "STM32F7"
	config ARCH_CHIP_STM32F4
		bool "STM32F4"
	config ARCH_CHIP_IMXRT
		bool "IMXRT"
	config ARCH_CHIP_S32K3XX
		bool "S32K3XX"
	config ARCH_CHIP_RP2040
		bool "RP2040"
endchoice

config BOARD_PWM_FREQ
	int "Board default PWM frequency"
	default 160000000 if ARCH_CHIP_S32K3XX
	default 1000000 if !ARCH_CHIP_S32K3XX
	---help---
		Board default PWM frequency

config UART_BITBANG
	bool
	---help---
		Half-duplex UART on the ESC signal pins (drv_bitbang_uart.h).
		Selected by the drivers that use it.

config UART_BITBANG_TIMER
	int "Timer instance for bit-bang UART"
	depends on UART_BITBANG
	default 13
	range 1 17
	---help---
		Timer instance to use for bit-bang UART timing mode.
		Default TIM13.
```

## platforms/zephyr/tests/platform/testcase.yaml
```yaml
common:
  tags:
    - px4
  platform_allow:
    - mps2/an386
  integration_platforms:
    - mps2/an386
tests:
  px4.platform: {}
```

## platforms/zephyr/west.yml
```yaml
manifest:
  remotes:
    - name: zephyrproject-rtos
      url-base: https://github.com/zephyrproject-rtos

  projects:
    - name: zephyr
      remote: zephyrproject-rtos
      revision: v4.5.0
      import:
        name-allowlist:
          - cmsis
          - cmsis_6
          - hal_nxp
          - picolibc
```

## src/drivers/distance_sensor/ptgl100/Kconfig
```kconfig
menuconfig DRIVERS_DISTANCE_SENSOR_PTGL100
	bool "ptgl100"
	default n
	---help---
		Enable the JRT PTGL-100 UART laser rangefinder driver.
```

## src/drivers/esc_4way/Kconfig
```kconfig
menuconfig DRIVERS_ESC_4WAY
	bool "esc_4way (MSP and 4way ESC configuration server over USB or a serial port)"
	default n
	depends on SERIALPASSTHROUGH_BITBANG
	---help---
		Serves the BLHeli/AM32 4way interface protocol to ESC configurators
		(am32.ca, esc-configurator.com) through the flight controller: MSP on
		the host side, the ESC bootloader protocol on the ESC signal pins via
		the bit-bang UART backend. Started by cdcacm_autostart when
		PASSTHRU_EN=2 or by "esc_4way start -d <device>". The outputs are
		stopped for the session and the board reboots afterwards.
```

## src/drivers/gl40ii/Kconfig
```kconfig
menuconfig DRIVERS_GL40II
	bool "gl40ii"
	default n
	---help---
		Enable the native dual-CAN CubeMars GL40II tilt actuator driver.
```

## src/drivers/gpio_out/Kconfig
```kconfig
menuconfig DRIVERS_GPIO_OUT
	bool "gpio_out"
	default n
	---help---
		Enable support for gpio_out
```

## src/drivers/imu/adi/adi_burst/Kconfig
```kconfig
menuconfig DRIVERS_IMU_ADI_ADI_BURST
	bool "ADI single-sample SPI burst family"
	default n
	help
	  Shared acquisition for ADIS1647x, ADIS16497, ADIS1650x and ADIS1657x.
	  Exact -T selection is required for all commands. Original drivers are retained.
	  Select at least one model below. ADIS16448 and ADIS16607 are not migrated.

if DRIVERS_IMU_ADI_ADI_BURST

config ADI_BURST_ADIS16470
	bool "ADIS16470"
	default n

config ADI_BURST_ADIS16477
	bool "ADIS16477"
	default n

config ADI_BURST_ADIS16497
	bool "ADIS16497"
	default n

config ADI_BURST_ADIS16500
	bool "ADIS16500"
	default n

config ADI_BURST_ADIS16501
	bool "ADIS16501"
	default n

config ADI_BURST_ADIS16505
	bool "ADIS16505"
	default n

config ADI_BURST_ADIS16507
	bool "ADIS16507"
	default n

config ADI_BURST_ADIS16507_16
	bool "ADIS16507 16-bit compatibility"
	default n

config ADI_BURST_ADIS16575
	bool "ADIS16575"
	default n

config ADI_BURST_ADIS16576
	bool "ADIS16576"
	default n

config ADI_BURST_ADIS16577
	bool "ADIS16577"
	default n

endif # DRIVERS_IMU_ADI_ADI_BURST
```

## src/drivers/imu/bosch/bosch_direct/Kconfig
```kconfig
menuconfig DRIVERS_IMU_BOSCH_BOSCH_DIRECT
	bool "Bosch BMI055/BMI085/BMI088/BMI270 SPI family"
	default n
	help
	  Fixed and tagged FIFO acquisition. Split devices retain independent
	  accel/gyro registrations; BMI270 uses one integrated IMU registration.

if DRIVERS_IMU_BOSCH_BOSCH_DIRECT

config BOSCH_DIRECT_BMI055
	bool "BMI055"
	default y

config BOSCH_DIRECT_BMI085
	bool "BMI085"
	default y

config BOSCH_DIRECT_BMI088
	bool "BMI088 (including existing BMI090L identity compatibility)"
	default y

config BOSCH_DIRECT_BMI270
	bool "BMI270"
	default y

if BOSCH_DIRECT_BMI085 || BOSCH_DIRECT_BMI088

choice
	prompt "BMI085/BMI088 accelerometer interrupt pin"
	default BOSCH_DIRECT_ACCELEROMETER_INT1

config BOSCH_DIRECT_ACCELEROMETER_INT_NONE
	bool "No interrupts"

config BOSCH_DIRECT_ACCELEROMETER_INT1
	bool "INT1"

config BOSCH_DIRECT_ACCELEROMETER_INT2
	bool "INT2"

endchoice

choice
	prompt "BMI085/BMI088 gyroscope interrupt pin"
	default BOSCH_DIRECT_GYROSCOPE_INT3

config BOSCH_DIRECT_GYROSCOPE_INT_NONE
	bool "No interrupts"

config BOSCH_DIRECT_GYROSCOPE_INT3
	bool "INT3"

config BOSCH_DIRECT_GYROSCOPE_INT4
	bool "INT4"

endchoice

endif # BOSCH_DIRECT_BMI085 || BOSCH_DIRECT_BMI088

endif # DRIVERS_IMU_BOSCH_BOSCH_DIRECT
```

## src/drivers/imu/iio_imu/Kconfig
```kconfig
menuconfig DRIVERS_IMU_IIO_IMU
	bool "Generic Linux IIO IMU"
	default n
	depends on PLATFORM_POSIX && BOARD_LINUX_TARGET
	---help---
		Enable the generic userspace adapter for Linux buffered IIO IMUs.
		See src/drivers/imu/iio_imu/README.md for the kernel ABI contract.
```

## src/drivers/imu/invensense/icm56686/Kconfig
```kconfig
menuconfig DRIVERS_IMU_INVENSENSE_ICM56686
	bool "icm56686"
	default n
	---help---
		Enable support for icm56686
```

## src/drivers/imu/st/asm330lhh/Kconfig
```kconfig
menuconfig DRIVERS_IMU_ST_ASM330LHH
	bool "asm330lhh"
	default n
	---help---
		Enable support for asm330lhh
```

## src/drivers/imu/st/lsm6dso/Kconfig
```kconfig
menuconfig DRIVERS_IMU_ST_LSM6DSO
	bool "lsm6dso"
	default n
	---help---
		Enable support for lsm6dso
```

## src/drivers/imu/st/lsm6dsr/Kconfig
```kconfig
menuconfig DRIVERS_IMU_ST_LSM6DSR
	bool "lsm6dsr"
	default n
	---help---
		Enable support for lsm6dsr
```

## src/drivers/imu/tdk/icm20602/Kconfig
```kconfig
menuconfig DRIVERS_IMU_TDK_ICM20602
	bool "TDK ICM20602 SPI driver"
	depends on !DRIVERS_IMU_INVENSENSE_ICM20602
	default n
	help
	  Independent ICM20602 SPI accelerometer and gyroscope acquisition.
	  The original product driver remains available.
```

## src/drivers/imu/tdk/icm42670p/Kconfig
```kconfig
menuconfig DRIVERS_IMU_TDK_ICM42670P
	bool "TDK ICM42670P SPI driver"
	depends on !DRIVERS_IMU_INVENSENSE_ICM42670P
	default n
	help
	  Independent ICM42670P SPI accelerometer and gyroscope acquisition.
	  Disable the original same-named product driver before selecting this driver.
```

## src/drivers/imu/tdk/icm45686/Kconfig
```kconfig
menuconfig DRIVERS_IMU_TDK_ICM45686
	bool "TDK ICM45686 SPI driver"
	depends on !DRIVERS_IMU_INVENSENSE_ICM45686
	default n
	help
	  Independent ICM45686 SPI accelerometer and gyroscope acquisition.
	  Disable the original same-named product driver before selecting this driver.
```

## src/drivers/imu/tdk/mpu6000/Kconfig
```kconfig
menuconfig DRIVERS_IMU_TDK_MPU6000
	bool "TDK MPU6000 SPI driver"
	depends on !DRIVERS_IMU_INVENSENSE_MPU6000
	default n
	help
	  Independent MPU6000 SPI accelerometer and gyroscope acquisition.
	  The original product driver remains available.
```
