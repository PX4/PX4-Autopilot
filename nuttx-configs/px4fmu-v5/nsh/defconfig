## nuttx/arch/Kconfig
```kconfig
#
# For a description of the syntax of this configuration file,
# see misc/tools/kconfig-language.txt.
#

choice
	prompt "CPU Architecture"
	default ARCH_ARM

config ARCH_8051
	bool "8051"
	---help---
		Intel 8051 architectures and derivaties

config ARCH_ARM
	bool "ARM"
	select ARCH_HAVE_INTERRUPTSTACK
	---help---
		The ARM architectures

config ARCH_AVR
	bool "AVR"
	select ARCH_NOINTC
	select ARCH_HAVE_INTERRUPTSTACK
	---help---
		Atmel 8-bit bit AVR and 32-bit AVR32 architectures

config ARCH_HC
	bool "Freescale HC"
	select ARCH_NOINTC
	select ARCH_HAVE_INTERRUPTSTACK
	---help---
		Freescale HC architectures (M9S12)

config ARCH_MIPS
	bool "MIPS"
	select ARCH_HAVE_INTERRUPTSTACK
	---help---
		MIPS architectures (PIC32)

config ARCH_RGMP
	bool "RGMP"
	---help---
		RTOS and GPOS on Multi-Processor (RGMP) architecture.  See 
		http://rgmp.sourceforge.net/wiki/index.php/Main_Page.

config ARCH_SH
	bool "Renesas"
	select ARCH_NOINTC
	select ARCH_HAVE_INTERRUPTSTACK
	---help---
		Renesas architectures (SH and M16C).

config ARCH_SIM
	bool "Simulation"
	---help---
		Linux/Cywgin user-mode simulation.

config ARCH_X86
	bool "x86"
	---help---
		Intel x86 architectures.

config ARCH_Z16
	bool "ZNEO"
	select ARCH_HAVE_HEAP2
	---help---
		ZiLOG ZNEO 16-bit architectures (z16f).

config ARCH_Z80
	bool "z80"
	select ARCH_HAVE_HEAP2
	---help---
		ZiLOG 8-bit architectures (z80, ez80, z8).

endchoice

config ARCH
	string
	default "8051"	if ARCH_8051
	default "arm"	if ARCH_ARM
	default "avr"	if ARCH_AVR
	default "hc"	if ARCH_HC
	default "mips"	if ARCH_MIPS
	default "rgmp"	if ARCH_RGMP
	default "sh"	if ARCH_SH
	default "sim"	if ARCH_SIM
	default "x86"	if ARCH_X86
	default "z16"	if ARCH_Z16
	default "z80"	if ARCH_Z80

source arch/8051/Kconfig
source arch/arm/Kconfig
source arch/avr/Kconfig
source arch/hc/Kconfig
source arch/mips/Kconfig
source arch/rgmp/Kconfig
source arch/sh/Kconfig
source arch/sim/Kconfig
source arch/x86/Kconfig
source arch/z16/Kconfig
source arch/z80/Kconfig

comment "Architecture Options"

config ARCH_NOINTC
	bool
	default n

config ARCH_DMA
	bool
	default n

config ARCH_STACKDUMP
	bool "Dump stack on assertions"
	default n
	---help---
		Enable to do stack dumps after assertions

config ENDIAN_BIG
	bool "Big Endian Architecture"
	default n
	---help---
		Select if architecture operates using big-endian byte ordering.

comment "Board Settings"

config BOARD_LOOPSPERMSEC
	int "Loops per millisecond"
	help
		Must be calibrated for correct operation of delay loops.
		You simply use a stop watch to measure the 100 second delay
		then adjust CONFIG_BOARD_LOOPSPERMSEC until it is actually
		is 100 seconds.

config DRAM_START
	hex "DRAM start physical address"
	help
		The physical start address of installed RAM.  Despite the naming,
		this may be SDRAM or SRAM or any other RAM technology that support
		program execution.

config DRAM_VSTART
	hex "DRAM start virtual address"
	depends on ARCH_HAVE_MMU
	help
		The virtual start address of installed RAM.  Despite the naming,
		this may be SDRAM or SRAM or any other RAM technology that support
		program execution.

config DRAM_SIZE
	int "DRAM size"
	help
		The size in bytes of the installed RAM.  Despite the naming,
		this may be SDRAM or SRAM or any other RAM technology that support
		program execution.

config ARCH_HAVE_INTERRUPTSTACK
	bool

config ARCH_INTERRUPTSTACK
	int "Interrupt Stack Size"
	depends on ARCH_HAVE_INTERRUPTSTACK
	default 0
	---help---
		This architecture supports an interrupt stack. If defined, this symbol
		will be the size of the interrupt stack in bytes.  If not defined (or
		defined to be zero), the user task stacks will be used during interrupt
		handling.

comment "Boot options"

choice
	prompt "Boot Mode"
	default BOOT_RUNFROMFLASH

config BOOT_RUNFROMEXTSRAM
	bool "Run from external SRAM"
	---help---
		Some configuration support booting and running from external SRAM.

config BOOT_RUNFROMFLASH
	bool "Boot and run from flash"
	---help---
		Most configurations support XIP operation from FLASH but must copy
		initialized .data sections to RAM. (This is the default).

config BOOT_RUNFROMISRAM
	bool "Boot and run from internal SRAM"
	---help---
		Some configuration support booting and running from internal SRAM.

config BOOT_RUNFROMSDRAM
	bool "Boot and run from external SDRAM"
	---help---
		Some configuration support booting and running from external SDRAM.

config BOOT_COPYTORAM
	bool "Boot from FLASH but copy to ram"
	---help---
		Some configurations boot in FLASH but copy themselves entirely into
		RAM for better performance.

endchoice
```

## nuttx/arch/arm/Kconfig
```kconfig
#
# For a description of the syntax of this configuration file,
# see misc/tools/kconfig-language.txt.
#

if ARCH_ARM
comment "ARM Options"

choice
	prompt "ARM chip selection"
	default ARCH_CHIP_STM32

config ARCH_CHIP_C5471
	bool "TMS320 C5471"
	select ARCH_ARM7TDMI
	select ARCH_HAVE_LOWVECTORS
	---help---
		TI TMS320 C5471, A180, or DA180 (ARM7TDMI)

config ARCH_CHIP_CALYPSO
	bool "Calypso"
	select ARCH_ARM7TDMI
	select ARCH_HAVE_HEAP2
	select ARCH_HAVE_LOWVECTORS
	---help---
		TI Calypso-based cell phones (ARM7TDMI)

config ARCH_CHIP_DM320
	bool "TMS320 DM320"
	select ARCH_ARM926EJS
	select ARCH_HAVE_LOWVECTORS
	select ARCH_HAVE_MMU
	---help---
		TI DMS320 DM320 (ARM926EJS)

config ARCH_CHIP_IMX
	bool "Freescale iMX"
	select ARCH_ARM920T
	select ARCH_HAVE_HEAP2
	select ARCH_HAVE_LOWVECTORS
	select ARCH_HAVE_MMU
	---help---
		Freescale iMX architectures (ARM920T)

config ARCH_CHIP_KINETIS
	bool "Freescale Kinetis"
	select ARCH_CORTEXM4
	select ARCH_HAVE_MPU
	select ARCH_IRQPRIO
	---help---
		Freescale Kinetis Architectures (ARM Cortex-M4)

config ARCH_CHIP_LM
	bool "TI Stellaris"
	select ARCH_HAVE_MPU
	select ARCH_IRQPRIO
	---help---
		TI Stellaris LMS3 architecutres (ARM Cortex-M3)

config ARCH_CHIP_LPC17XX
	bool "NXP LPC17xx"
	select ARCH_CORTEXM3
	select ARCH_HAVE_MPU
	select ARCH_IRQPRIO
	---help---
		NXP LPC17xx architectures (ARM Cortex-M3)

config ARCH_CHIP_LPC214X
	bool "NXP LPC214x"
	select ARCH_ARM7TDMI
	select ARCH_HAVE_LOWVECTORS
	---help---
		NXP LPC2145x architectures (ARM7TDMI)

config ARCH_CHIP_LPC2378
	bool "NXP LPC2378"
	select ARCH_ARM7TDMI
	select ARCH_HAVE_LOWVECTORS
	---help---
		NXP LPC2145x architectures (ARM7TDMI)

config ARCH_CHIP_LPC31XX
	bool "NXP LPC31XX"
	select ARCH_ARM926EJS
	select ARCH_HAVE_LOWVECTORS
	select ARCH_HAVE_MMU
	---help---
		NPX LPC31XX architectures (ARM926EJS).

config ARCH_CHIP_LPC43XX
	bool "NXP LPC43XX"
	select ARCH_CORTEXM4
	select ARCH_HAVE_CMNVECTOR
	select ARMV7M_CMNVECTOR
	select ARCH_HAVE_MPU
	select ARCH_IRQPRIO
	---help---
		NPX LPC43XX architectures (ARM Cortex-M4).

config ARCH_CHIP_SAM3U
	bool "Atmel AT91SAM3U"
	select ARCH_CORTEXM3
	select ARCH_HAVE_MPU
	select ARCH_IRQPRIO
	---help---
		Atmel AT91SAM3U architectures (ARM Cortex-M3)

config ARCH_CHIP_STM32
	bool "STMicro STM32"
	select ARCH_HAVE_CMNVECTOR
	select ARCH_HAVE_MPU
	select ARCH_HAVE_I2CRESET
	select ARCH_IRQPRIO
	---help---
		STMicro STM32 architectures (ARM Cortex-M3/4).

config ARCH_CHIP_STR71X
	bool "STMicro STR71x"
	select ARCH_ARM7TDMI
	select ARCH_HAVE_LOWVECTORS
	---help---
		STMicro STR71x architectures (ARM7TDMI).

endchoice

config ARCH_ARM7TDMI
	bool

config ARCH_ARM926EJS
	bool

config ARCH_ARM920T
	bool

config ARCH_CORTEXM3
	bool

config ARCH_CORTEXM4
	bool

config ARCH_FAMILY
	string
	default "arm"		if ARCH_ARM7TDMI || ARCH_ARM926EJS || ARCH_ARM920T
	default "armv7-m"	if ARCH_CORTEXM3 || ARCH_CORTEXM4

config ARCH_CHIP
	string
	default "c5471"		if ARCH_CHIP_C5471
	default "calypso"	if ARCH_CHIP_CALYPSO
	default "dm320"		if ARCH_CHIP_DM320
	default "imx"		if ARCH_CHIP_IMX
	default "kinetis"	if ARCH_CHIP_KINETIS
	default "lm"		if ARCH_CHIP_LM
	default "lpc17xx"	if ARCH_CHIP_LPC17XX
	default "lpc214x"	if ARCH_CHIP_LPC214X
	default "lpc2378"	if ARCH_CHIP_LPC2378
	default "lpc31xx"	if ARCH_CHIP_LPC31XX
	default "lpc43xx"	if ARCH_CHIP_LPC43XX
	default "sam3u"		if ARCH_CHIP_SAM3U
	default "stm32"		if ARCH_CHIP_STM32
	default "str71x"	if ARCH_CHIP_STR71X

config ARCH_HAVE_CMNVECTOR
	bool

config ARMV7M_CMNVECTOR
	bool "Use common ARMv7-M vectors"
	default n
	depends on ARCH_HAVE_CMNVECTOR
	---help---
		Some architectures use their own, built-in vector logic.  Some use only
		the common vector logic.  Some can use either their own built-in vector
		logic or the common vector logic.  This applies only to ARMv7-M
		architectures.

config ARCH_FPU
	bool "FPU support"
	default y
	depends on ARCH_CORTEXM4
	---help---
		Build in support for the ARM Cortex-M4 Floating Point Unit (FPU).
		Check your chip specifications first; not all Cortex-M4 chips support the FPU.

config ARCH_HAVE_MPU
	bool

config ARMV7M_MPU
	bool "MPU support"
	default n
	depends on ARCH_HAVE_MPU
	---help---
		Build in support for the ARM Cortex-M3/4 Memory Protection Unit (MPU).
		Check your chip specifications first; not all Cortex-M3/4 chips support the MPU.

config ARCH_HAVE_LOWVECTORS
	bool

config ARCH_LOWVECTORS
	bool "Vectors in low memory"
	default n
	depends on ARCH_HAVE_LOWVECTORS
	---help---
		Support ARM vectors in low memory.

config ARCH_HAVE_MMU
	bool

config PGTABLE_VADDR
	hex "Page table virtual address"
	depends on ARCH_HAVE_MMU
	---help---
		Page table virtual address (might be defined in the board.h file).  Not
		applicable to all architectures.

config ARCH_ROMPGTABLE
	bool "ROM page table"
	default n
	depends on ARCH_HAVE_MMU
	---help---
		Support a fixed memory mapping use a (read-only) page table in ROM/FLASH.

config PAGING
	bool "On-demand paging"
	default n
	depends on ARCH_HAVE_MMU && !ARCH_ROMPGTABLE
	---help---
		If set =y in your configation file, this setting will enable the on-demand
		paging feature as described in http://www.nuttx.org/NuttXDemandPaging.html.

config BOARD_LOOPSPERMSEC
	int "Delay loops per millisecond"
	default 5000
	---help---
		Delay loops nust be calibrated for correct operation.

config ARCH_CALIBRATION
	bool "Calibrate delay loop"
	default n
	---help---
		Enables some built in instrumentation that causes a 100 second delay
		during boot-up.  This 100 second delay serves no purpose other than it
		allows you to calibratre BOARD_LOOPSPERMSEC.  You simply use a stop
		watch to measure the 100 second delay then adjust BOARD_LOOPSPERMSEC until
		the delay actually is 100 seconds.

config DEBUG_HARDFAULT
	bool "Verbose Hard-Fault Debug"
	default n
	depends on DEBUG && (ARCH_CORTEXM3 || ARCH_CORTEXM4)
	---help---
		Enables verbose debug output when a hard fault is occurs.  This verbose
		output is sometimes helpful when debugging difficult hard fault problems,
		but may be more than you typcially want to see.

if ARCH_CORTEXM3 || ARCH_CORTEXM4
source arch/arm/src/armv7-m/Kconfig
endif
if ARCH_ARM7TDMI || ARCH_ARM926EJS
source arch/arm/src/arm/Kconfig
endif
if ARCH_CHIP_C5471
source arch/arm/src/c5471/Kconfig
endif
if ARCH_CHIP_CALYPSO
source arch/arm/src/calypso/Kconfig
endif
if ARCH_CHIP_DM320
source arch/arm/src/dm320/Kconfig
endif
if ARCH_CHIP_IMX
source arch/arm/src/imx/Kconfig
endif
if ARCH_CHIP_KINETIS
source arch/arm/src/kinetis/Kconfig
endif
if ARCH_CHIP_LM
source arch/arm/src/lm/Kconfig
endif
if ARCH_CHIP_LPC17XX
source arch/arm/src/lpc17xx/Kconfig
endif
if ARCH_CHIP_LPC214X
source arch/arm/src/lpc214x/Kconfig
endif
if ARCH_CHIP_LPC2378
source arch/arm/src/lpc2378/Kconfig
endif
if ARCH_CHIP_LPC31XX
source arch/arm/src/lpc31xx/Kconfig
endif
if ARCH_CHIP_LPC43XX
source arch/arm/src/lpc43xx/Kconfig
endif
if ARCH_CHIP_SAM3U
source arch/arm/src/sam3u/Kconfig
endif
if ARCH_CHIP_STM32
source arch/arm/src/stm32/Kconfig
endif
if ARCH_CHIP_STR71X
source arch/arm/src/str71x/Kconfig
endif

endif
```

## nuttx/arch/arm/src/arm/Kconfig
```kconfig
#
# For a description of the syntax of this configuration file,
# see misc/tools/kconfig-language.txt.
#

comment "ARM Configuration Options"

choice
	prompt "Toolchain Selection"
	default ARM_TOOLCHAIN_CODESOURCERYW if HOST_WINDOWS
	default ARM_TOOLCHAIN_GNU_EABI if !HOST_WINDOWS

config ARM_TOOLCHAIN_BUILDROOT
	bool "Buildroot (Cygwin or Linux)"
	depends on !WINDOWS_NATIVE

config ARM_TOOLCHAIN_CODESOURCERYL
	bool "CodeSourcery GNU toolchain under Linux"
	depends on HOST_LINUX

config ARM_TOOLCHAIN_CODESOURCERYW
	bool "CodeSourcery GNU toolchain under Windows"
	depends on HOST_WINDOWS

config ARM_TOOLCHAIN_DEVKITARM
	bool "devkitARM GNU toolchain"
	depends on HOST_WINDOWS

config ARM_TOOLCHAIN_GNU_EABI
	bool "Generic GNU EABI toolchain"
	---help---
		This option should work for any modern GNU toolchain (GCC 4.5 or newer)
		configured for arm-none-eabi.

endchoice
```

## nuttx/arch/arm/src/armv7-m/Kconfig
```kconfig
#
# For a description of the syntax of this configuration file,
# see misc/tools/kconfig-language.txt.
#

comment "ARMV7M Configuration Options"

choice
	prompt "Toolchain Selection"
	default ARMV7M_TOOLCHAIN_CODESOURCERYW if HOST_WINDOWS
	default ARMV7M_TOOLCHAIN_GNU_EABI if !HOST_WINDOWS

config ARMV7M_TOOLCHAIN_ATOLLIC
	bool "Atollic Lite/Pro for Windows"
	depends on HOST_WINDOWS

config ARMV7M_TOOLCHAIN_BUILDROOT
	bool "Buildroot (Cygwin or Linux)"
	depends on !WINDOWS_NATIVE

config ARMV7M_TOOLCHAIN_CODEREDL
	bool "CodeRed for Linux"
	depends on HOST_LINUX

config ARMV7M_TOOLCHAIN_CODEREDW
	bool "CodeRed for Windows"
	depends on HOST_WINDOWS

config ARMV7M_TOOLCHAIN_CODESOURCERYL
	bool "CodeSourcery GNU toolchain under Linux"
	depends on HOST_LINUX

config ARMV7M_TOOLCHAIN_CODESOURCERYW
	bool "CodeSourcery GNU toolchain under Windows"
	depends on HOST_WINDOWS

config ARMV7M_TOOLCHAIN_DEVKITARM
	bool "devkitARM GNU toolchain"
	depends on HOST_WINDOWS

config ARMV7M_TOOLCHAIN_GNU_EABI
	bool "Generic GNU EABI toolchain"
	---help---
		This option should work for any modern GNU toolchain (GCC 4.5 or newer)
		configured for arm-none-eabi.

config ARMV7M_TOOLCHAIN_RAISONANCE
	bool "STMicro Raisonance for Windows"
	depends on HOST_WINDOWS

endchoice

config ARMV7M_OABI_TOOLCHAIN
	bool "OABI (vs EABI)"
	default y
	depends on ARMV7M_TOOLCHAIN_BUILDROOT
	---help---
		Most of the older buildroot toolchains are OABI and are named arm-nuttx-elf- vs. arm-nuttx-eabi-
```

## nuttx/arch/arm/src/imx/Kconfig
```kconfig
#
# For a description of the syntax of this configuration file,
# see misc/tools/kconfig-language.txt.
#

if ARCH_CHIP_IMX

config IMX_UART0
	bool "UART0"
	select ARCH_HAVE_UART0
	default n

config IMX_UART1
	bool "UART1"
	select ARCH_HAVE_UART1
	default n

config IMX_UART2
	bool "UART2"
	select ARCH_HAVE_UART2
	default n

endif
```
