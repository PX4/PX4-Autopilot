## nuttx/arch/arm/src/lm/Kconfig
```kconfig
#
# For a description of the syntax of this configuration file,
# see misc/tools/kconfig-language.txt.
#

comment "Stellaris Configuration Options"

choice
	prompt "Stellaris Chip Selection"
	default ARCH_CHIP_LM3S6965
	depends on ARCH_CHIP_LM

config ARCH_CHIP_LM3S6918
	bool "LM3S6918"
	select ARCH_CORTEXM3
	select ARCH_CHIP_LM3S
	select LM_HAVE_SSI1

config ARCH_CHIP_LM3S9B96
	bool "LM3S9B96"
	select ARCH_CORTEXM3
	select ARCH_CHIP_LM3S

config ARCH_CHIP_LM3S6432
	bool "LM3S6432"
	select ARCH_CORTEXM3
	select ARCH_CHIP_LM3S

config ARCH_CHIP_LM3S6965
	bool "LM3S6965"
	select ARCH_CORTEXM3
	select ARCH_CHIP_LM3S

config ARCH_CHIP_LM3S8962
	bool "LM3S8962"
	select ARCH_CORTEXM3
	select ARCH_CHIP_LM3S

endchoice

# Chip families

config ARCH_CHIP_LM3S
	bool

config ARCH_CHIP_LM4F
	bool

config LM_HAVE_SSI1
	bool

config LM_REVA2
	bool "Rev A2"
	default n
	---help---
		Some early silicon returned an increase LDO voltage or 2.75V to work
		around a PLL bug

config LM_DFU
	bool "DFU"
	default y

menu "Stellaris Peripheral Support"

config LM_UART0
	bool "UART0"
	select ARCH_HAVE_UART0
	default n

config LM_UART1
	bool "UART1"
	select ARCH_HAVE_UART1
	default n

config SSI0_DISABLE
	bool "Disable SSI0"
	default y

config SSI1_DISABLE
	bool "Disable SSI1"
	default y

config LM_UART2
	bool "UART2"
	select ARCH_HAVE_UART2
	default n

config LM_ETHERNET
	bool "Stellaris Ethernet"
	default n
	---help---
		This must be set (along with NET) to build the Stellaris Ethernet driver.

endmenu

menu "Disable GPIO Interrupts"

config LM_DISABLE_GPIOA_IRQS
	bool "Disable GPIOA IRQs"
	default n

config LM_DISABLE_GPIOB_IRQS
	bool "Disable GPIOB IRQs"
	default n

config LM_DISABLE_GPIOC_IRQS
	bool "Disable GPIOC IRQs"
	default n

config LM_DISABLE_GPIOD_IRQS
	bool "Disable GPIOD IRQs"
	default n

config LM_DISABLE_GPIOE_IRQS
	bool "Disable GPIOE IRQs"
	default n

config LM_DISABLE_GPIOF_IRQS
	bool "Disable GPIOF IRQs"
	default n

config LM_DISABLE_GPIOG_IRQS
	bool "Disable GPIOG IRQs"
	default n

config LM_DISABLE_GPIOH_IRQS
	bool "Disable GPIOH IRQs"
	default n

config LM_DISABLE_GPIOJ_IRQS
	bool "Disable GPIOJ IRQs"
	default n

endmenu

if LM_ETHERNET
menu "Stellaris Ethernet Configuration"

config LM_ETHLEDS
	bool "Ethernet LEDs"
	default n
	---help---
	Enable to use Ethernet LEDs on the board.

config LM_BOARDMAC
	bool "Board MAC"
	default n
	---help---
		If the board-specific logic can provide a MAC address (via
		lm_ethernetmac()), then this should be selected.

config LM_ETHHDUPLEX
	bool "Force Half Duplex"
	default n
	---help---
		Set to force half duplex operation

config LM_ETHNOAUTOCRC
	bool "Disable auto-CRC"
	default n
	---help---
		Set to suppress auto-CRC generation

config LM_ETHNOPAD
	bool "Disable Tx Padding"
	default n
	---help---
		Set to suppress Tx padding

config LM_MULTICAST
	bool "Enable Multicast"
	default n
	---help---
		Set to enable multicast frames

config LM_PROMISCUOUS
	bool "Enable Promiscuous Mode"
	default n
	---help---
		Set to enable promiscuous mode

config LM_TIMESTAMP
	bool "Enable Timestamping"
	default n

config LM_BADCRC
	bool "Enable Bad CRC Rejection"
	default n
	---help---
		Set to enable bad CRC rejection.

config M3S_DUMPPACKET
	bool "Dump Packets"
	default n
	---help---
		Dump each packet received/sent to the console.

endmenu
endif

if !SSI0_DISABLE || !SSI1_DISABLE
menu "Stellaris SSI Configuration"

config SSI_POLLWAIT
	bool "Poll Wait (No-Interrupt) Mode"
	default y

config SSI_TXLIMIT
	int "Tx Limit"
	default 4
	---help---
		Default of 4 assumes half of the 8 entry FIFO

endmenu
endif
```

## nuttx/arch/arm/src/lm3s/Kconfig
```kconfig
#
# For a description of the syntax of this configuration file,
# see misc/tools/kconfig-language.txt.
#

comment "LM3S Configuration Options"

choice
	prompt "LM3S Chip Selection"
	default ARCH_CHIP_LM3S6965
	depends on ARCH_CHIP_LM3S

config ARCH_CHIP_LM3S6918
	bool "LM3S6918"

config ARCH_CHIP_LM3S9B96
	bool "LM3S9B96"

config ARCH_CHIP_LM3S6432
	bool "LM3S6432"

config ARCH_CHIP_LM3S6965
	bool "LM3S6965"

config ARCH_CHIP_LM3S8962
	bool "LM3S8962"

endchoice

config LM3S_DFU
	bool "DFU"
	default y

config LM3S_DISABLE_GPIOA_IRQS
	bool "Disable GPIOA IRQs"

config LM3S_DISABLE_GPIOB_IRQS
	bool "Disable GPIOB IRQs"

config LM3S_DISABLE_GPIOC_IRQS
	bool "Disable GPIOC IRQs"

config LM3S_DISABLE_GPIOD_IRQS
	bool "Disable GPIOD IRQs"

config LM3S_DISABLE_GPIOE_IRQS
	bool "Disable GPIOE IRQs"

config LM3S_DISABLE_GPIOF_IRQS
	bool "Disable GPIOF IRQs"

config LM3S_DISABLE_GPIOG_IRQS
	bool "Disable GPIOG IRQs"

config LM3S_DISABLE_GPIOH_IRQS
	bool "Disable GPIOH IRQs"

config LM3S_DISABLE_GPIOJ_IRQS
	bool "Disable GPIOJ IRQs"
```
