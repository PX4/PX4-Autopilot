## nuttx/arch/arm/src/lpc31xx/Kconfig
```kconfig
#
# For a description of the syntax of this configuration file,
# see misc/tools/kconfig-language.txt.
#

comment "LPC31xx Configuration Options"

choice
	prompt "LPC31 Chip Selection"
	default ARCH_CHIP_LPC3131
	depends on ARCH_CHIP_LPC31XX

config ARCH_CHIP_LPC3130
	bool "LPC3130"
	select ARCH_HAVE_EXTNAN
	select ARCH_HAVE_EXTSRAM0
	select ARCH_HAVE_EXTSRAM1
	select ARCH_HAVE_EXTDRAM

config ARCH_CHIP_LPC3131
	bool "LPC3131"
	select ARCH_HAVE_EXTNAND
	select ARCH_HAVE_EXTSRAM0
	select ARCH_HAVE_EXTSRAM1
	select ARCH_HAVE_EXTDRAM

config ARCH_CHIP_LPC3152
	bool "LPC3152"
	select ARCH_HAVE_EXTNAND
	select ARCH_HAVE_EXTSRAM0
	select ARCH_HAVE_EXTSRAM1
	select ARCH_HAVE_EXTDRAM

config ARCH_CHIP_LPC3154
	bool "LPC3154"
	select ARCH_HAVE_EXTNAND
	select ARCH_HAVE_EXTSRAM0
	select ARCH_HAVE_EXTSRAM1
	select ARCH_HAVE_EXTDRAM

endchoice

choice
	prompt "Toolchain Selection"
	default LPC31_BUILDROOT if !HOST_WINDOWS
	default LPC31_CODESOURCERYW if HOST_WINDOWS
	depends on ARCH_CHIP_LPC31XX

config LPC31_CODESOURCERYW
	bool "CodeSourcery GNU toolchain under Windows"
	depends on HOST_WINDOWS

config LPC31_CODESOURCERYL
	bool "CodeSourcery GNU toolchain under Linux"
	depends on HOST_LINUX

config LPC31_DEVKITARM
	bool "devkitARM GNU toolchain"
	depends on HOST_WINDOWS

config LPC31_BUILDROOT
	bool "Buildroot"
	depends on !WINDOWS_NATIVE

endchoice

config LPC31_SDRAMHCLK
	int "External SDRAM HCLK"
	depends on ARCH_EXTSDRAM
	---help---
		The SDRAM HCLK may be specified here (if not, it will be calculated).

menu "LPC31xx Peripheral Support"

config LPC31_UART
	bool "UART"
	default n
	select ARCH_HAVE_UART

config LPC31_SPI
	bool "SPI"
	default n

config LPC31_USB
	bool "USB"
	default n

config LPC31_MCI
	bool "MCI"
	default n

endmenu

menu "LPC31xx UART Configuration"
	depends on LPC31_UART

config LPC31_UART_DIVADDVAL
	int "BAUD pre-scaler divisor"
	---help---
		BAUD pre-scaler divisor

config LPC31_UART_DIVISOR
	int "BAUD divisor"
	---help---
		BAUD divisor

config LPC31_UART_MULVAL
	int "BAUD multiplier"
	---help---
		BAUD multiplier

endmenu

menu "USB device driver options"

config LPC31_USBDEV_EP0_MAXSIZE
	int "EP0 Max packet size"
	depends on USBDEV
	default 64
	---help---
		Endpoint 0 maximum packet size.  Default: 64

config LPC31_USBDEV_FRAME_INTERRUPT
	bool "USB frame interrupt"
	depends on USBDEV
	default n
	---help---
		Handle USB Start-Of-Frame events.  Enable reading SOF from interrupt
		handler vs. simply reading on demand. Probably a bad idea... Unless
		there is some issue with sampling the SOF from hardware asynchronously.

config LPC31_USBDEV_DMA
	bool "Enable USB device DMA"
	depends on USBDEV
	default n
	---help---
		Enable lpc31xx-specific DMA support

config LPC31_USBDEV_REGDEBUG
	bool "Register level debug"
	depends on USBDEV && DEBUG
	default n
	---help---
		Output detailed register-level USB device debug information.  Requires also DEBUG.

endmenu

menu "SPI device driver options"

config LPC31_SPI_REGDEBUG
	bool "SPI Register level debug"
	depends on LPC31_SPI && DEBUG
	default n
	---help---
		Output detailed register-level SPI device debug information.  Requires also DEBUG.

endmenu
```

## nuttx/arch/arm/src/lpc43xx/Kconfig
```kconfig
#
# For a description of the syntax of this configuration file,
# see misc/tools/kconfig-language.txt.
#

comment "LPC43xx Configuration Options"

choice
	prompt "LPC43XX Chip Selection"
	default ARCH_CHIP_LPC4330FET100
	depends on ARCH_CHIP_LPC43XX

config ARCH_CHIP_LPC4310FBD144
	bool "LPC4310FBD144"

config ARCH_CHIP_LPC4310FET100
	bool "LPC4310FET100"

config ARCH_CHIP_LPC4320FBD144
	bool "LPC4320FBD144"

config ARCH_CHIP_LPC4320FET100
	bool "LPC4320FET100"

config ARCH_CHIP_LPC4330FBD144
	bool "LPC4330FBD144"

config ARCH_CHIP_LPC4330FET100
	bool "LPC4330FET100"

config ARCH_CHIP_LPC4330FET180
	bool "LPC4330FET180"

config ARCH_CHIP_LPC4330FET256
	bool "LPC4330FET256"

config ARCH_CHIP_LPC4350FBD208
	bool "LPC4350FBD208"

config ARCH_CHIP_LPC4350FET180
	bool "LPC4350FET180"

config ARCH_CHIP_LPC4350FET256
	bool "LPC4350FET256"

config ARCH_CHIP_LPC4353FBD208
	bool "LPC4353FBD208"

config ARCH_CHIP_LPC4353FET180
	bool "LPC4353FET180"

config ARCH_CHIP_LPC4353FET256
	bool "LPC4353FET256"

config ARCH_CHIP_LPC4357FET180
	bool "LPC4357FET180"

config ARCH_CHIP_LPC4357FBD208
	bool "LPC4357FBD208"

config ARCH_CHIP_LPC4357FET256
	bool "LPC4357FET256"

endchoice

config ARCH_FAMILY_LPC4310
	bool
	default y if ARCH_CHIP_LPC4310FBD144 || ARCH_CHIP_LPC4310FET100

config ARCH_FAMILY_LPC4320
	bool
	default y if ARCH_CHIP_LPC4320FBD144 || ARCH_CHIP_LPC4320FET100

config ARCH_FAMILY_LPC4330
	bool
	default y if ARCH_CHIP_LPC4330FBD144 || ARCH_CHIP_LPC4330FET100 || ARCH_CHIP_LPC4330FET180 || ARCH_CHIP_LPC4330FET256

config ARCH_FAMILY_LPC4350
	bool
	default y if ARCH_CHIP_LPC4350FBD208 || ARCH_CHIP_LPC4350FET180 || ARCH_CHIP_LPC4350FET256

config ARCH_FAMILY_LPC4353
	bool
	default y if ARCH_CHIP_LPC4353FBD208 || ARCH_CHIP_LPC4353FET180 || ARCH_CHIP_LPC4353FET256

config ARCH_FAMILY_LPC4357
	bool
	default y if ARCH_CHIP_LPC4357FET180 || ARCH_CHIP_LPC4357FBD208 || ARCH_CHIP_LPC4357FET256

choice
	prompt "LPC43XX Boot Configuration"
	default BOOT_SRAM
	depends on ARCH_CHIP_LPC43XX
	---help---
		The startup code needs to know if the code is running from internal FLASH,
		external FLASH, SPIFI, or SRAM in order to initialize properly.  Note that
		a boot device is not specified for cases where the code is copied into SRAM;
		those cases are all covered by BOOT_SRAM.

config BOOT_SRAM
	bool "Running from SRAM"

config BOOT_SPIFI
	bool "Running from QuadFLASH"

config BOOT_FLASHA
	bool "Running in internal FLASHA"

config BOOT_FLASHB
	bool "Running in internal FLASHA"

config BOOT_CS0FLASH
	bool "Running in external FLASH CS0"

config BOOT_CS1FLASH
	bool "Running in external FLASH CS1"

config BOOT_CS2FLASH
	bool "Running in external FLASH CS2"

config BOOT_CS3FLASH
	bool "Running in external FLASH CS3"

endchoice

menu "LPC43xx Peripheral Support"

config LPC43_ADC0
	bool "ADC0"
	default n

config LPC43_ADC1
	bool "ADC1"
	default n

config LPC43_ATIMER
	bool "Alarm timer"
	default n

config LPC43_CAN1
	bool "C_CAN1"
	default n

config LPC43_CAN2
	bool "C_CAN1"
	default n

config LPC43_DAC
	bool "DAC"
	default n

config LPC43_EMC
	bool "External Memory Controller (EMC)"
	default n

config LPC43_ETHERNET
	bool "Ethernet"
	default n

config LPC43_EVNTMNTR
	bool "Event Monitor"
	default n

config LPC43_GPDMA
	bool "GPDMA"
	default n

config LPC43_I2C0
	bool "I2C0"
	default n

config LPC43_I2C1
	bool "I2C1"
	default n

config LPC43_I2S0
	bool "I2S0"
	default n

config LPC43_I2S1
	bool "I2S1"
	default n

config LPC43_LCD
	bool "LCD"
	default n

config LPC43_MCPWM
	bool "Motor Control PWM (MCPWM)"
	default n

config LPC43_QEI
	bool "Quadrature Controller Interface (QEI)"
	default n

config LPC43_RIT
	bool "Repetitive Interrupt Timer (RIT)"
	default n

config LPC43_RTC
	bool "Real Time Clock (RTC)"
	default n

config LPC43_SCT
	bool "State Configurable Timer (SCT)"
	default n

config LPC43_SDMMC
	bool "SD/MMC"
	default n

config LPC43_SPI
	bool "SPI"
	default n

config LPC43_SPIFI
	bool "SPI Flash Interface (SPIFI)"
	default n

config LPC43_SSP0
	bool "SSP0"
	default n

config LPC43_SSP1
	bool "SSP1"
	default n

config LPC43_TMR0
	bool "ADC1"
	default n

config LPC43_TMR1
	bool "Timer 1"
	default n

config LPC43_TMR2
	bool "Timer 2"
	default n

config LPC43_TMR3
	bool "Timer 3"
	default n

config LPC43_USART0
	bool "USART0"
	select ARCH_HAVE_USART0
	default n

config LPC43_UART1
	bool "UART1"
	select ARCH_HAVE_UART1
	default n

config LPC43_USART2
	bool "USART2"
	select ARCH_HAVE_USART2
	default n

config LPC43_USART3
	bool "USART3"
	select ARCH_HAVE_USART3
	default n

config LPC43_USB0
	bool "USB0"
	default n

config LPC43_USB1
	bool "USB1"
	default n

config LPC43_USB1_ULPI
	bool "USB1 with ULPI"
	default n
	depends on LPC43_USB1

config LPC43_WWDT
	bool "Windowing Watchdog Timer (WWDT)"
	default n

endmenu

config SERIAL_TERMIOS
	bool "Serial driver TERMIOS supported"
	depends on LPC43_USART0 || LPC43_UART1 || LPC43_USART2 || LPC43_USART3
	default n
	---help---
		Serial driver supports termios.h interfaces (tcsetattr, tcflush, etc.).
		If this is not defined, then the terminal settings (baud, parity, etc).
		are not configurable at runtime; serial streams cannot be flushed, etc..
```
