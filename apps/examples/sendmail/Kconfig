## apps/modbus/Kconfig
```kconfig
#
# For a description of the syntax of this configuration file,
# see misc/tools/kconfig-language.txt.
#

comment "FreeModbus"

config MB_ASCII_ENABLED
	bool "Modbus ASCII support"
	depends on MODBUS
	default y

config MB_RTU_ENABLED
	bool "Modbus RTU support"
	depends on MODBUS
	default y

config MB_TCP_ENABLED
	bool "Modbus TCP support"
	depends on MODBUS
	default y

config MB_ASCII_TIMEOUT_SEC
	int "Character timeout"
	depends on MB_ASCII_ENABLED
	default 1
	---help---
		Character timeout value for Modbus ASCII

		The character timeout value is not fixed for Modbus ASCII and is therefore
		a configuration option. It should be set to the maximum expected delay
		time of the network.

config MB_ASCII_TIMEOUT_WAIT_BEFORE_SEND_MS
	int "Timeout to wait before sending"
	depends on MB_ASCII_ENABLED
	default 0
	---help---
		Timeout to wait in ASCII prior to enabling transmitter

		If defined the function calls vMBPortSerialDelay with the argument
		MB_ASCII_TIMEOUT_WAIT_BEFORE_SEND_MS to allow for a delay before
		the serial transmitter is enabled. This is required because some
		targets are so fast that there is no time between receiving and
		transmitting the frame. If the master is to slow with enabling its 
		receiver then he will not receive the response correctly.

config MB_FUNC_HANDLERS_MAX
	int "Maximum number of Modbus functions"
	depends on MODBUS
	default 16
	---help---
		Maximum number of Modbus functions codes the protocol stack should support.

		The maximum number of supported Modbus functions must be greater than
		the sum of all enabled functions in this file and custom function
		handlers. If set to small adding more functions will fail.

config MB_FUNC_OTHER_REP_SLAVEID_BUF
	int "Size of Slave ID report buffer"
	depends on MB_FUNC_OTHER_REP_SLAVEID_ENABLED
	default 32
	---help---
		Number of bytes which should be allocated for the Report Slave ID command.

		This number limits the maximum size of the additional segment in the
		report slave id function. See eMBSetSlaveID() for more information on
		how to set this value. It is only used if MB_FUNC_OTHER_REP_SLAVEID_ENABLED
		is set to 1.

config MB_FUNC_OTHER_REP_SLAVEID_ENABLED
	bool "Report Slave ID function"
	depends on MODBUS
	default y
	---help---
		If the Report Slave ID function should be enabled.

config MB_FUNC_READ_INPUT_ENABLED
	bool "Read Input Registers function"
	depends on MODBUS
	default y
	---help---
		If the Read Input Registers function should be enabled.

config MB_FUNC_READ_HOLDING_ENABLED
	bool "Read Holding Registers function"
	depends on MODBUS
	default y
	---help---
		If the Read Holding Registers function should be enabled.

config MB_FUNC_WRITE_HOLDING_ENABLED
	bool "Write Single Register function"
	depends on MODBUS
	default y
	---help---
		If the Write Single Register function should be enabled.

config MB_FUNC_WRITE_MULTIPLE_HOLDING_ENABLED
	bool "Write Multiple registers function"
	depends on MODBUS
	default y
	---help---
		If the Write Multiple registers function should be enabled.

config MB_FUNC_READ_COILS_ENABLED
	bool "Read Coils function"
	depends on MODBUS
	default y
	---help---
		If the Read Coils function should be enabled.

config MB_FUNC_WRITE_COIL_ENABLED
	bool "Write Coils function"
	depends on MODBUS
	default y
	---help---
		If the Write Coils function should be enabled.

config MB_FUNC_WRITE_MULTIPLE_COILS_ENABLED
	bool "Write Multiple Coils function"
	depends on MODBUS
	default y
	---help---
		If the Write Multiple Coils function should be enabled.

config MB_FUNC_READ_DISCRETE_INPUTS_ENABLED
	bool "Read Discrete Inputs function"
	depends on MODBUS
	default y
	---help---
		If the Read Discrete Inputs function should be enabled.

config MB_FUNC_READWRITE_HOLDING_ENABLED
	bool "Read/Write Multiple Registers function"
	depends on MODBUS
	default y
	---help---
		If the Read/Write Multiple Registers function should be enabled.
```

## apps/namedapp/Kconfig
```kconfig
#
# For a description of the syntax of this configuration file,
# see misc/tools/kconfig-language.txt.
#

config NAMEDAPP
	bool "Support named applications"
	default n
	---help---
		Enable support for named applications.  This features assigns a string
		name to an application.  This feature is also the underlying requirement
		to support built-in applications in the NuttShell (NSH).

if NAMEDAPP
endif
```

## apps/netutils/Kconfig
```kconfig
#
# For a description of the syntax of this configuration file,
# see misc/tools/kconfig-language.txt.
#

comment "Networking Utilities"

source "$APPSDIR/netutils/codecs/Kconfig"
source "$APPSDIR/netutils/dhcpc/Kconfig"
source "$APPSDIR/netutils/dhcpd/Kconfig"
source "$APPSDIR/netutils/ftpc/Kconfig"
source "$APPSDIR/netutils/ftpd/Kconfig"
source "$APPSDIR/netutils/json/Kconfig"
source "$APPSDIR/netutils/resolv/Kconfig"
source "$APPSDIR/netutils/smtp/Kconfig"
source "$APPSDIR/netutils/telnetd/Kconfig"
source "$APPSDIR/netutils/tftpc/Kconfig"
source "$APPSDIR/netutils/thttpd/Kconfig"
source "$APPSDIR/netutils/uiplib/Kconfig"
source "$APPSDIR/netutils/webclient/Kconfig"
source "$APPSDIR/netutils/webserver/Kconfig"
source "$APPSDIR/netutils/discover/Kconfig"
source "$APPSDIR/netutils/xmlrpc/Kconfig"
```

## apps/netutils/codecs/Kconfig
```kconfig
#
# For a description of the syntax of this configuration file,
# see misc/tools/kconfig-language.txt.
#

config NETUTILS_CODECS
	bool "CODEC Library"
	default n
	---help---
		Enables the netutils/code library: Base64 coding, URL coding, MD5.

if NETUTILS_CODECS

config CODECS_BASE64
	bool "Base 64 Support"
	default n
	---help---
		Enables support for the following interfaces: base64_encode(),
		base64_decode(), base64w_encode(), and base64w_decode(),

		Contributed NuttX by Darcy Gong.

config CODECS_HASH_MD5
	bool "MD5 Support"
	default n
	---help---
		Enables support for the following interfaces: MD5Init(),
		MD5Update(), MD5Final(), MD5Transform(), md5_sum() and md5_hash()

		Contributed NuttX by Darcy Gong.

config CODECS_URLCODE
	bool "URL Decode Support"
	default n
	---help---
		Enables support for the following interfaces: urlencode() and
		urldecode()

		Contributed NuttX by Darcy Gong.

config CODECS_URLCODE_NEWMEMORY
	bool "URL Allocating Decode Support"
	default n
	---help---
		Enables support for the following interfaces: url_encode() and
		url_decode()

		Contributed NuttX by Darcy Gong.

config CODECS_AVR_URLCODE
	bool "URL Raw Decode Support"
	default n
	---help---
		Enables support for the following interfaces: urlrawdecode() and
		urlrawencode()

		Contributed NuttX by Darcy Gong.

endif
```

## apps/netutils/dhcpc/Kconfig
```kconfig
#
# For a description of the syntax of this configuration file,
# see misc/tools/kconfig-language.txt.
#

config NETUTILS_DHCPC
	bool "DHCP client"
	default n
	---help---
		Enable support for the DHCP client.

if NETUTILS_DHCPC
endif
```

## apps/netutils/dhcpd/Kconfig
```kconfig
#
# For a description of the syntax of this configuration file,
# see misc/tools/kconfig-language.txt.
#

config NETUTILS_DHCPD
	bool "DHCP server"
	default n
	---help---
		Enable support for the DHCP server.

if NETUTILS_DHCPD
endif
```
