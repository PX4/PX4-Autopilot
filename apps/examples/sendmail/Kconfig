## apps/examples/sendmail/Kconfig
```kconfig
#
# For a description of the syntax of this configuration file,
# see misc/tools/kconfig-language.txt.
#

config EXAMPLES_SENDMAIL
	bool "Sendmail example"
	default n
	---help---
		Enable the sendmail example

if EXAMPLES_SENDMAIL
endif
```

## apps/examples/serloop/Kconfig
```kconfig
#
# For a description of the syntax of this configuration file,
# see misc/tools/kconfig-language.txt.
#

config EXAMPLES_SERLOOP
	bool "Serial loopback example"
	default n
	---help---
		Enable the serial loopback example

if EXAMPLES_SERLOOP
endif
```

## apps/examples/telnetd/Kconfig
```kconfig
#
# For a description of the syntax of this configuration file,
# see misc/tools/kconfig-language.txt.
#

config EXAMPLES_TELNETD
	bool "Telnet daemon example"
	default n
	---help---
		Enable the Telnet daemon example

if EXAMPLES_TELNETD
endif
```

## apps/examples/thttpd/Kconfig
```kconfig
#
# For a description of the syntax of this configuration file,
# see misc/tools/kconfig-language.txt.
#

config EXAMPLES_THTTPD
	bool "THTTPD web server example"
	default n
	---help---
		Enable the THTTPD web server example

if EXAMPLES_THTTPD
endif
```

## apps/examples/tiff/Kconfig
```kconfig
#
# For a description of the syntax of this configuration file,
# see misc/tools/kconfig-language.txt.
#

config EXAMPLES_TIFF
	bool "TIFF file generation example"
	default n
	---help---
		Enable the TIFF file generation example

if EXAMPLES_TIFF
endif
```

## apps/examples/touchscreen/Kconfig
```kconfig
#
# For a description of the syntax of this configuration file,
# see misc/tools/kconfig-language.txt.
#

config EXAMPLES_TOUCHSCREEN
	bool "Touchscreen example"
	default n
	---help---
		Enable the touchscreen example

if EXAMPLES_TOUCHSCREEN
endif
```

## apps/examples/udp/Kconfig
```kconfig
#
# For a description of the syntax of this configuration file,
# see misc/tools/kconfig-language.txt.
#

config EXAMPLES_UDP
	bool "UDP example"
	default n
	---help---
		Enable the UDP example

if EXAMPLES_UDP
endif
```

## apps/examples/uip/Kconfig
```kconfig
#
# For a description of the syntax of this configuration file,
# see misc/tools/kconfig-language.txt.
#

config EXAMPLES_UIP
	bool "uIP web server example"
	default n
	---help---
		Enable the uIP web server example

if EXAMPLES_UIP
endif
```

## apps/examples/usbserial/Kconfig
```kconfig
#
# For a description of the syntax of this configuration file,
# see misc/tools/kconfig-language.txt.
#

config EXAMPLES_USBSERIAL
	bool "USB serial test example"
	default n
	---help---
		Enable the USB serial test example

if EXAMPLES_USBSERIAL
endif
```

## apps/examples/usbstorage/Kconfig
```kconfig
#
# For a description of the syntax of this configuration file,
# see misc/tools/kconfig-language.txt.
#

config EXAMPLES_USBMSC
	bool "USB mass storage class example"
	default n
	---help---
		Enable the USB mass storage class example

config EXAMPLES_USBMSC_BUILTIN
	bool "NSH built-in command"
	default y
	depends on EXAMPLES_USBMSC && NSH_BUILTIN_APPS
	---help---
		This example can be built as two NSH "built-in" commands if this
		option is selected: 'msconn' will connect the USB mass storage
		device; 'msdis' will disconnect the USB storage device.

config EXAMPLES_USBMSC_NLUNS
	int "Number of LUNs"
	default 1
	depends on EXAMPLES_USBMSC
	---help---
		Defines the number of logical units (LUNs) exported by the USB
		storage driver.  Each LUN corresponds to one exported block driver
		(or partition of a block driver).  May be 1, 2, or 3.  Default is 1.

config EXAMPLES_USBMSC_DEVMINOR1
	int "LUN1 Minor Device Number"
	default 0
	depends on EXAMPLES_USBMSC
	---help---
		The minor device number of the block driver for the first LUN. For
		example, N in /dev/mmcsdN.  Used for registering the block driver.
		Default is zero.

config EXAMPLES_USBMSC_DEVPATH1
	string "LUN1 Device Path"
	default "/dev/mmcsd0"
	depends on EXAMPLES_USBMSC
	---help---
		The full path to the registered block driver.  Default is
		"/dev/mmcsd0"

config EXAMPLES_USBMSC_DEVMINOR2
	int "LUN2 Minor Device Number"
	default 1
	depends on EXAMPLES_USBMSC
	---help---
		The minor device number of the block driver for the second LUN. For
		example, N in /dev/mmcsdN.  Used for registering the block driver.
		Ignored if EXAMPLES_USBMSC_NLUNS < 2. Default is one.

config EXAMPLES_USBMSC_DEVPATH2
	string "LUN2 Device Path"
	default "/dev/mmcsd1"
	depends on EXAMPLES_USBMSC
	---help---
		The full path to the registered block driver.  Ignored if
		EXAMPLES_USBMSC_NLUNS < 2. Default is "/dev/mmcsd1"

config EXAMPLES_USBMSC_DEVMINOR3
	int "LUN3 Minor Device Number"
	default 2
	depends on EXAMPLES_USBMSC
	---help---
		The minor device number of the block driver for the third LUN. For
		example, N in /dev/mmcsdN.  Used for registering the block driver.
		Ignored if EXAMPLES_USBMSC_NLUNS < 2. Default is two.

config EXAMPLES_USBMSC_DEVPATH3
	string "LUN3 Device Path"
	default "/dev/mmcsd2"
	depends on EXAMPLES_USBMSC
	---help---
		The full path to the registered block driver.  Ignored if
		EXAMPLES_USBMSC_NLUNS < 2. Default is "/dev/mmcsd2"

config EXAMPLES_USBMSC_DEBUGMM
	bool "USB MSC MM Debug"
	default n
	depends on EXAMPLES_USBMSC
	---help---
		Enables some debug tests to check for memory usage and memory leaks.

config EXAMPLES_USBMSC_TRACEINIT
	bool "USB Trace Initialization"
	default n
	depends on EXAMPLES_USBMSC
	---help---
		If USBDEV_TRACE is enabled (or CONFIG_DEBUG and CONFIG_DEBUG_USB),
		then the example code will also manage the USB trace output.  The
		amount of trace output can be controlled this configuration value:
		This setting will show USB initialization events

config EXAMPLES_USBMSC_TRACECLASS
	bool "USB Trace Class"
	default n
	depends on EXAMPLES_USBMSC
	---help---
		If USBDEV_TRACE is enabled (or CONFIG_DEBUG and CONFIG_DEBUG_USB),
		then the example code will also manage the USB trace output.  The
		amount of trace output can be controlled this configuration value:
		This setting will show USB class driver events

config EXAMPLES_USBMSC_TRACETRANSFERS
	bool "USB Trace Transfers"
	default n
	depends on EXAMPLES_USBMSC
	---help---
		If USBDEV_TRACE is enabled (or CONFIG_DEBUG and CONFIG_DEBUG_USB),
		then the example code will also manage the USB trace output.  The
		amount of trace output can be controlled this configuration value:
		This setting will show USB data transfer events

config EXAMPLES_USBMSC_TRACECONTROLLER
	bool "USB Trace Device Controller Events"
	default n
	depends on EXAMPLES_USBMSC
	---help---
		If USBDEV_TRACE is enabled (or CONFIG_DEBUG and CONFIG_DEBUG_USB),
		then the example code will also manage the USB trace output.  The
		amount of trace output can be controlled this configuration value:
		This setting will show USB device controller events

config EXAMPLES_USBMSC_TRACEINTERRUPTS
	bool "USB Trace Device Controller Interrupt Events"
	default n
	depends on EXAMPLES_USBMSC
	---help---
		If USBDEV_TRACE is enabled (or CONFIG_DEBUG and CONFIG_DEBUG_USB),
		then the example code will also manage the USB trace output.  The
		amount of trace output can be controlled this configuration value:
		This setting will show USB device controller interrupt-related events.
```

## apps/examples/usbterm/Kconfig
```kconfig
#
# For a description of the syntax of this configuration file,
# see misc/tools/kconfig-language.txt.
#

config EXAMPLES_USBTERM
	bool "USB serial terminal example"
	default n
	---help---
		Enable the USB serial terminal example

if EXAMPLES_USBTERM
endif
```

## apps/examples/watchdog/Kconfig
```kconfig
#
# For a description of the syntax of this configuration file,
# see misc/tools/kconfig-language.txt.
#

config EXAMPLES_WATCHDOG
	bool "Watchdog Timer example"
	default n
	---help---
		Enable the watchdog timer example

if EXAMPLES_WATCHDOG

config EXAMPLES_WATCHDOG_DEVPATH
	string "Watchdog device path"
	default "/dev/watchdog0"
	---help---
		The path to the watchdog device. Default: /dev/watchdog0

config CONFIG_EXAMPLES_WATCHDOG_PINGTIME
	int "Watchdog ping time"
	default 5000
	---help---
		Time in milliseconds that the example will ping the watchdog before letting the
		watchdog expire. Default: 5000 milliseconds.

config CONFIG_EXAMPLES_WATCHDOG_PINGDELAY
	int "Watchdog ping delay"
	default 500
	---help---
		Time delay between pings in milliseconds. Default: 500 milliseconds.

config EXAMPLES_WATCHDOG_TIMEOUT
	int "Watchdog timeout"
	default 2000
	---help---
		The watchdog timeout value in milliseconds before the watchdog timer
		expires.  Default:  2000 milliseconds.

endif
```

## apps/examples/wget/Kconfig
```kconfig
#
# For a description of the syntax of this configuration file,
# see misc/tools/kconfig-language.txt.
#

config EXAMPLES_WGET
	bool "wget example"
	default n
	depends on NET_TCP && !NSH_BUILTIN_APPS
	---help---
		Enable the wget example

if EXAMPLES_WGET

config EXAMPLES_WGET_URL
	string "File URL"
	default ""
	---help---
	The URL of the file to get

config EXAMPLES_WGET_NOMAC
	bool "Use Canned MAC Address"
	default n

config EXAMPLES_WGET_IPADDR
	hex "Target IP address"
	default 0x0a000002

config EXAMPLES_WGET_DRIPADDR
	hex "Default Router IP address (Gateway)"
	default 0x0a000001

config EXAMPLES_WGET_NETMASK
	hex "Network Mask"
	default 0xffffff00

endif
```

## apps/examples/wgetjson/Kconfig
```kconfig
#
# For a description of the syntax of this configuration file,
# see misc/tools/kconfig-language.txt.
#

config EXAMPLES_WGETJSON
	bool "wget JSON Example"
	default n
	depends on NETUTILS_JSON
	---help---
		Enable the wget JSON example

if EXAMPLES_WGETJSON

config EXAMPLES_WGETJSON_MAXSIZE
	int "Max. JSON Buffer Size"
	default 1024

config EXAMPLES_WGETJSON_URL
	string "wget URL"
	default "http://10.0.0.1/wgetjson/json_cmd.php"

config EXAMPLES_WGETPOST_URL
	string "wget_post URL"
	default "http://10.0.0.1/wgetjson/post_cmd.php"

endif
```

## apps/examples/wlan/Kconfig
```kconfig
#
# For a description of the syntax of this configuration file,
# see misc/tools/kconfig-language.txt.
#

config EXAMPLES_WLAN
	bool "WLAN example"
	default n
	---help---
		Enable the WLAN example

if EXAMPLES_WLAN
endif
```

## apps/examples/xmlrpc/Kconfig
```kconfig
#
# For a description of the syntax of this configuration file,
# see misc/tools/kconfig-language.txt.
#

config EXAMPLES_XMLRPC
	bool "XML RPC example"
	default n
	depends on NET_TCP && !DISABLE_POLL
	select NETUTILS_XMLRPC
	---help---
		An example for the netutils/xmlrpc library.
		This example implements a lightweight HTTP server and uses the xmlrpc lib
		for parsing xml remote procedure calls.

config EXAMPLES_XMLRPC_BUFFERSIZE
	int "HTTP buffer size"
	default 1024
	depends on EXAMPLES_XMLRPC

config EXAMPLES_XMLRPC_DHCPC
	bool "DHCP Client"
	default n
	depends on EXAMPLES_XMLRPC && !NSH_BUILTIN_APPS
	select NETUTILS_DHCPC
	select NETUTILS_RESOLV

config EXAMPLES_XMLRPC_NOMAC
	bool "Use Canned MAC Address"
	default n
	depends on EXAMPLES_XMLRPC && !NSH_BUILTIN_APPS

config EXAMPLES_XMLRPC_IPADDR
	hex "Target IP address"
	default 0x0a000002
	depends on EXAMPLES_XMLRPC && !NSH_BUILTIN_APPS && !EXAMPLES_XMLRPC_DHCPC

config EXAMPLES_XMLRPC_DRIPADDR
	hex "Default Router IP address (Gateway)"
	default 0x0a000001
	depends on EXAMPLES_XMLRPC && !NSH_BUILTIN_APPS

config EXAMPLES_XMLRPC_NETMASK
	hex "Network Mask"
	default 0xffffff00
	depends on EXAMPLES_XMLRPC && !NSH_BUILTIN_APPS
```

## apps/graphics/Kconfig
```kconfig
#
# For a description of the syntax of this configuration file,
# see misc/tools/kconfig-language.txt.
#

config TIFF
	bool "TIFF file generation utility"
	default n
	---help---
		Enable support for the TIFF file generation program.

if TIFF
endif
```

## apps/interpreters/Kconfig
```kconfig
#
# For a description of the syntax of this configuration file,
# see misc/tools/kconfig-language.txt.
#

comment "Interpreters"

source "$APPSDIR/interprets/hello/Kconfig"

config PCODE
	bool "Pascal p-code interpreter"
	default n
	---help---
		Enable support for the Pascal p-code interpreter.  See README file at misc/pascal
		and also the README.txt file in the apps/interpreter directory. Use of this
		configuration implies that you have performed the required installation of the
		Pascal run-time code.

if PCODE
endif
```

## apps/interpreters/ficl/Kconfig
```kconfig
#
# For a description of the syntax of this configuration file,
# see misc/tools/kconfig-language.txt.
#

config INTERPRETERS_FICL
	bool "Ficl Forth interpreter"
	default n
	---help---
		Enable support for the Ficl interpreter interpreter.  See README.txt file in the
		apps/interpreters/ficl directory.  Use of this configuration assumes
		that you have performed the required installation of the Ficl run-time code.

if INTERPRETERS_FICL
endif
```
