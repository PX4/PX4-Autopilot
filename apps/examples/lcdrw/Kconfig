## apps/examples/posix_spawn/Kconfig
```kconfig
#
# For a description of the syntax of this configuration file,
# see misc/tools/kconfig-language.txt.
#

config EXAMPLES_POSIXSPAWN
	bool "posix_spawn Unit Test"
	default n
	---help---
		Enable the posix_spawn() unit test

if EXAMPLES_POSIXSPAWN
config EXAMPLES_POSIXSPAWN_DEVMINOR
	int "ROMFS Minor Device Number"
	default 0
	---help---
		The minor device number of the ROMFS block. For example, the N in /dev/ramN.
		Used for registering the RAM block driver that will hold the ROMFS file system
		containing the ELF executables to be tested.  Default: 0

config EXAMPLES_POSIXSPAWN_DEVPATH
	string "ROMFS Devie Path"
	default "/dev/ram0"
	---help---
		The path to the ROMFS block driver device.  This must match EXAMPLES_POSIXSPAWN_DEVMINOR.
		Used for registering the RAM block driver that will hold the ROMFS file system
		containing the ELF executables to be tested.  Default: "/dev/ram0"

endif
```

## apps/examples/pwm/Kconfig
```kconfig
#
# For a description of the syntax of this configuration file,
# see misc/tools/kconfig-language.txt.
#

config EXAMPLES_PWM
	bool "Pulse width modulation (PWM) example"
	default n
	depends on PWM && NSH_BUILTIN_APPS
	---help---
		Enable the Pulse width modulation (PWM) example

if EXAMPLES_PWM

config EXAMPLES_PWM_DEVPATH
	string "PWM device path"
	default "/dev/pwm0"
	---help---
		The path to the PWM device. Default: /dev/pwm0

config EXAMPLES_PWM_FREQUENCY
	int "Default PWM freququency"
	default 100
	---help---
		The default PWM frequency.  Default: 100 Hz

config EXAMPLES_PWM_DUTYPCT
	int "Default PWM duty percentage"
	default 50
	---help---
		The default PWM duty as a percentage.  Default: 50%

config EXAMPLES_PWM_DURATION
	int "Default PWM duration"
	default 5 if !EXAMPLES_PWM_PULSECOUNT
	---help---
		The default PWM pulse train duration in seconds.  Used only if the current
		pulse count is zero (pulse countis only supported if CONFIG_PWM_PULSECOUNT
		is defined). Default: 5 seconds

config EXAMPLES_PWM_PULSECOUNT
	int "Default pulse count"
	default 0
	---help---
	The initial PWM pulse count.  This option is only available if CONFIG_PWM_PULSECOUNT
	is nonzero. Default: 0 (i.e., use the duration, not the count).

endif
```

## apps/examples/qencoder/Kconfig
```kconfig
#
# For a description of the syntax of this configuration file,
# see misc/tools/kconfig-language.txt.
#

config EXAMPLES_QENCODER
	bool "Quadrature encoder example"
	default n
	---help---
		Enable the quadrature encoder example

if EXAMPLES_QENCODER
endif
```

## apps/examples/relays/Kconfig
```kconfig
#
# For a description of the syntax of this configuration file,
# see misc/tools/kconfig-language.txt.
#

config EXAMPLES_RELAYS
	bool "wget JSON Example"
	default n
	depends on NETUTILS_JSON
	---help---
		Enable the wget JSON example

if EXAMPLES_RELAYS

config EXAMPLES_RELAYS_NRELAYS
	int "Number of Relays"
	default 2
	depends on ARCH_RELAYS

endif
```

## apps/examples/rgmp/Kconfig
```kconfig
#
# For a description of the syntax of this configuration file,
# see misc/tools/kconfig-language.txt.
#

config EXAMPLES_RGMP
	bool "RGMP example"
	default n
	---help---
		Enable the RGMP example

if EXAMPLES_RGMP
endif
```

## apps/examples/romfs/Kconfig
```kconfig
#
# For a description of the syntax of this configuration file,
# see misc/tools/kconfig-language.txt.
#

config EXAMPLES_ROMFS
	bool "ROMFS example"
	default n
	---help---
		Enable the ROMFS example

if EXAMPLES_ROMFS
endif
```
