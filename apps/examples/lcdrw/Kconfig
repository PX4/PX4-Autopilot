## apps/examples/lcdrw/Kconfig
```kconfig
#
# For a description of the syntax of this configuration file,
# see misc/tools/kconfig-language.txt.
#

config EXAMPLES_LCDRW
	bool "LCD read/write example"
	default n
	---help---
		Enable the LCD read/write example

if EXAMPLES_LCDRW
endif
```

## apps/examples/mm/Kconfig
```kconfig
#
# For a description of the syntax of this configuration file,
# see misc/tools/kconfig-language.txt.
#

config EXAMPLES_MM
	bool "Memory management example"
	default n
	---help---
		Enable the memory management example

if EXAMPLES_MM
endif
```

## apps/examples/modbus/Kconfig
```kconfig
#
# For a description of the syntax of this configuration file,
# see misc/tools/kconfig-language.txt.
#

config EXAMPLES_MODBUS
	bool "FreeModBus example"
	default n
	---help---
		Enable the FreeModBus example

if EXAMPLES_MODBUS

config EXAMPLES_MODBUS_PORT
	int "Port used for MODBUS transmissions"
	default 0
	---help---
		Port used for MODBUS transmissions, default = 0 (i.e., /dev/ttyS0)

config EXAMPLES_MODBUS_BAUD
	int "MODBUS baudrate"
	default 38400
	range 50 3000000
	---help---
		MODBUS baudrate, allowed values {50, 75, 110, 134, 150, 200, 300, 600,
		1200, 1800, 2400, 4800, 9600, 19200, 38400, 57600, 115200, 128000,
		230400, 256000, 460800, 500000, 576000, 921600, 1000000, 1152000,
		1500000, 2000000, 2500000, 3000000}

config EXAMPLES_MODBUS_PARITY
	int "MODBUS parity"
	default 2
	range 0 2
	---help---
		MODBUS parity, 0 - none, 1 - odd, 2 - even

config EXAMPLES_MODBUS_REG_INPUT_START
	int "Input registers start address"
	default 1000

config EXAMPLES_MODBUS_REG_INPUT_NREGS
	int "Number of input registers"
	default 4

config EXAMPLES_MODBUS_REG_HOLDING_START
	int "Holding registers start address"
	default 2000

config EXAMPLES_MODBUS_REG_HOLDING_NREGS
	int "Number of holding registers"
	default 130

endif
```

## apps/examples/mount/Kconfig
```kconfig
#
# For a description of the syntax of this configuration file,
# see misc/tools/kconfig-language.txt.
#

config EXAMPLES_MOUNT
	bool "File system mount example"
	default n
	---help---
		Enable the file system mount example

if EXAMPLES_MOUNT
endif
```

## apps/examples/nettest/Kconfig
```kconfig
#
# For a description of the syntax of this configuration file,
# see misc/tools/kconfig-language.txt.
#

config EXAMPLES_NETTEST
	bool "Network test example"
	default n
	depends on NET_TCP
	---help---
		Enable the network test example

if EXAMPLES_NETTEST

config EXAMPLES_NETTEST_SERVER
	bool "Target is server"
	default n
	---help---
	Select to use the host as the client side of the test.  Default:  The
	target is the client side of the test

config EXAMPLES_NETTEST_PERFORMANCE
	bool "Test for Performance"
	default n
	---help---
	Configure the example to test for network performance.  Default:  Test
	is for network functionality.

config EXAMPLES_NETTEST_NOMAC
	bool "Use Canned MAC Address"
	default n

config EXAMPLES_NETTEST_IPADDR
	hex "Target IP address"
	default 0x0a000002

config EXAMPLES_NETTEST_DRIPADDR
	hex "Default Router IP address (Gateway)"
	default 0x0a000001

config EXAMPLES_NETTEST_NETMASK
	hex "Network Mask"
	default 0xffffff00

config EXAMPLES_NETTEST_CLIENTIP
	hex "Client IP Address"
	default 0x0a000001 if !EXAMPLES_NETTEST_SERVER
	default 0x0a000002 if EXAMPLES_NETTEST_SERVER
	---help---
		IP address of the client.  If the target is the client, then
		EXAMPLES_NETTEST_CLIENTIP should be the same as
		EXAMPLES_NETTEST_IPADDR (default).  If the target is the server,
		then the default value of EXAMPLES_NETTEST_CLIENTIP is set to the
		gateway address, EXAMPLES_NETTEST_DRIPADDR.

endif
```

## apps/examples/nsh/Kconfig
```kconfig
#
# For a description of the syntax of this configuration file,
# see misc/tools/kconfig-language.txt.
#

config EXAMPLES_NSH
	bool "NuttShell (NSH) example"
	default n
	select NSH_LIBRARY
	select SYSTEM_READLINE
	---help---
		Enable the NuttShell (NSH) example

if EXAMPLES_NSH
endif
```

## apps/examples/null/Kconfig
```kconfig
#
# For a description of the syntax of this configuration file,
# see misc/tools/kconfig-language.txt.
#

config EXAMPLES_NULL
	bool "NULL example"
	default n
	---help---
		Enable the NULL example

if EXAMPLES_NULL
endif
```

## apps/examples/nx/Kconfig
```kconfig
#
# For a description of the syntax of this configuration file,
# see misc/tools/kconfig-language.txt.
#

config EXAMPLES_NX
	bool "NX graphics example"
	default n
	---help---
		Enable the NX graphics example

if EXAMPLES_NX

config EXAMPLES_NX_BUILTIN
	bool "NSH Built-IN"
	depends on NSH_BUILTIN_APPS
	---help---
		Build the NX example as a "built-in" that can be executed from the
		NSH command line    

config EXAMPLES_NX_VPLANE
	int "Video Plane"
	default 0
	---help---
		The plane to select from the framebuffer driver for use in the test.
		Default: 0

config EXAMPLES_NX_DEVNO
	int "Video Device Number"
	default 0
	---help---
		The LCD device to select from the LCD driver for use in the test:
		Default: 0

config EXAMPLES_NX_DEFAULT_COLORS
	bool "Use Default Colors"
	default y

if !EXAMPLES_NX_DEFAULT_COLORS

config EXAMPLES_NX_BGCOLOR
	hex "Background Color"
	---help---
		The color of the background.  Default depends on config EXAMPLES_NX_BPP.

config EXAMPLES_NX_COLOR1
	hex "Color of Window 1"
	---help---
		The color of window 1. Default depends on config EXAMPLES_NX_BPP.

config EXAMPLES_NX_COLOR2
	hex "Color of Window 2"
	---help---
		The color of window 2. Default depends on config EXAMPLES_NX_BPP.

config EXAMPLES_NX_TBCOLOR
	hex "Toolbar Color"
	---help---
		The color of the toolbar. Default depends on config EXAMPLES_NX_BPP.

config EXAMPLES_NX_FONTCOLOR
	hex "Font Color"
	---help---
		The color of the fonts. Default depends on config EXAMPLES_NX_BPP.

endif

config EXAMPLES_NX_DEFAULT_FONT
	bool "Use Default Font"
	default y

config EXAMPLES_NX_FONTID
	bool "Font ID"
	depends on !EXAMPLES_NX_DEFAULT_FONT
	---help---
		Selects the font (see font ID numbers in include/nuttx/nx/nxfonts.h)

config EXAMPLES_NX_BPP
	int "Bits-Per-Pixel"
	default 32
	---help---
		Pixels per pixel to use.  Valid options include 2, 4, 8, 16, 24,
		and 32.  Default is 32.

config EXAMPLES_NX_RAWWINDOWS
	bool "Use Raw Windows"
	default n
	---help---
		Use raw windows;  Default is to use pretty, framed NXTK windows with
		toolbars.

config EXAMPLES_NX_EXTERNINIT
	bool "External Device Initialization"
	default n
	---help---
		The driver for the graphics device on this platform requires some
		unusual initialization.  This is the for, for example, SPI LCD/OLED
		devices.  If this configuration is selected, then the platform code
		must provide an LCD initialization function with a prototype like:

		#ifdef CONFIG_NX_LCDDRIVER
		FAR struct lcd_dev_s *up_nxdrvinit(unsigned int devno);
		#else
		FAR struct fb_vtable_s *up_nxdrvinit(unsigned int devno);
		#endif

if NX_MULTIUSER
comment "Multi-User Configuration Options"

config EXAMPLES_NX_STACKSIZE
	int "NX Server Stack Size"
	default 2048
	---help---
		The stacksize to use when creating the NX server.  Default 2048

config EXAMPLES_NX_CLIENTPRIO
	int "Client Priority"
	default 100
	---help---
		The client priority.  Default: 100

config EXAMPLES_NX_SERVERPRIO
	int "Server Priority"
	default 120
	---help---
		The server priority.  Default: 120

config EXAMPLES_NX_LISTENERPRIO
	int "Listener Priority"
	default 80
	---help---
		The priority of the event listener thread. Default 80.

config EXAMPLES_NX_NOTIFYSIGNO
	int "Notify Signal Number"
	default 4
	---help---
		The signal number to use with nx_eventnotify().  Default: 4

endif
endif
```

## apps/examples/nxconsole/Kconfig
```kconfig
#
# For a description of the syntax of this configuration file,
# see misc/tools/kconfig-language.txt.
#

config EXAMPLES_NXCONSOLE
	bool "NxConsole example"
	default n
	---help---
		Enable the NxConsole example

if EXAMPLES_NXCONSOLE
endif
```

## apps/examples/nxffs/Kconfig
```kconfig
#
# For a description of the syntax of this configuration file,
# see misc/tools/kconfig-language.txt.
#

config EXAMPLES_NXFFS
	bool "NXFFS file system example"
	default n
	---help---
		Enable the NXFFS file system example

if EXAMPLES_NXFFS
endif
```

## apps/examples/nxflat/Kconfig
```kconfig
#
# For a description of the syntax of this configuration file,
# see misc/tools/kconfig-language.txt.
#

config EXAMPLES_NXFLAT
	bool "NXFLAT example"
	default n
	---help---
		Enable the NXFLAT example

if EXAMPLES_NXFLAT
endif
```

## apps/examples/nxhello/Kconfig
```kconfig
#
# For a description of the syntax of this configuration file,
# see misc/tools/kconfig-language.txt.
#

config EXAMPLES_NXHELLO
	bool "NX graphics \"Hello, World!\" example"
	default n
	---help---
		Enable the NX graphics \"Hello, World!\" example

if EXAMPLES_HELLOXX
endif
```

## apps/examples/nximage/Kconfig
```kconfig
#
# For a description of the syntax of this configuration file,
# see misc/tools/kconfig-language.txt.
#

config EXAMPLES_NXIMAGE
	bool "NX graphics image example"
	default n
	---help---
		Enable the X graphics image example

if EXAMPLES_NXIMAGE
endif
```

## apps/examples/nxlines/Kconfig
```kconfig
#
# For a description of the syntax of this configuration file,
# see misc/tools/kconfig-language.txt.
#

config EXAMPLES_NXLINES
	bool "NX graphics lines example"
	default n
	---help---
		Enable the X graphics lines example

if EXAMPLES_NXLINES

config EXAMPLES_NXLINES_VPLANE
	int "Graphics Plane"
	default 0
	---help---
		The plane to select from the frame-buffer driver for use in the test.  Default: 0

config EXAMPLES_NXLINES_DEVNO
	int "Graphics Device Number"
	default 0
	---help---
		The LCD device to select from the LCD driver for use in the test: Default: 0

config EXAMPLES_NXLINES_BGCOLOR
	hex "Background Color"
	default 0x00
	---help---
		The color of the background.  Default depends on EXAMPLES_NXLINES_BPP.

config EXAMPLES_NXLINES_LINEWIDTH
	int "Line Width"
	default 16
	---help---
		Selects the width of the lines in pixels (default: 16)

config EXAMPLES_NXLINES_LINECOLOR
	hex "Line Color"
	default 0x00
	---help---
		The color of the central lines drawn in the background window. Default
		depends on EXAMPLES_NXLINES_BPP (there really is no meaningful default).

config EXAMPLES_NXLINES_BORDERWIDTH
	int "Border Width"
	default 16
	---help---
		The width of the circular border drawn in the background window. (default: 16).

config EXAMPLES_NXLINES_BORDERCOLOR
	hex "Border Color"
	default 0x00
	---help---
		The color of the circular border drawn in the background window. Default
		depends on EXAMPLES_NXLINES_BPP (there really is no meaningful default).

config EXAMPLES_NXLINES_CIRCLECOLOR
	hex "Circle Color"
	default 0x00
	---help---
		The color of the circular region filled in the background window. Default
		depends on EXAMPLES_NXLINES_BPP (there really is no meaningful default).

config EXAMPLES_NXLINES_BPP
	int "Bits Per Pixel"
	default 8
	---help---
		Pixels per pixel to use.  Valid options include 2, 4, 8, 16, 24, and 32.
		Default is 16.

config EXAMPLES_NXLINES_EXTERNINIT
	bool "External Device Initialization"
	default false
	---help---
		The driver for the graphics device on this platform requires some unusual
		initialization.  This is the for, for example, SPI LCD/OLED devices.  If
		this configuration is selected, then the platform code must provide an LCD
		initialization function with a prototype like:

		#ifdef NX_LCDDRIVER
		FAR struct lcd_dev_s *up_nxdrvinit(unsigned int devno);
		#else
		FAR struct fb_vtable_s *up_nxdrvinit(unsigned int devno);
		#endif

endif
```

## apps/examples/nxtext/Kconfig
```kconfig
#
# For a description of the syntax of this configuration file,
# see misc/tools/kconfig-language.txt.
#

config EXAMPLES_NXTEXT
	bool "NX graphics text example"
	default n
	---help---
		Enable the NX graphics text example

if EXAMPLES_NXTEXT
endif
```

## apps/examples/ostest/Kconfig
```kconfig
#
# For a description of the syntax of this configuration file,
# see misc/tools/kconfig-language.txt.
#

config EXAMPLES_OSTEST
	bool "OS test example"
	default n
	---help---
		Enable the OS test example

if EXAMPLES_OSTEST

config EXAMPLES_OSTEST_BUILTIN
	bool "NSH built-in application"
	default y if NSH_LIBRARY
	default n if !NSH_LIBRARY
	---help---
		Build the OS test example as an NSH built-in application.

config EXAMPLES_OSTEST_LOOPS
	int "OS test loop"
	default 1
	---help---
		Used to control the number of executions of the test.  If undefined, the test
		executes one time.  If defined to be zero, the test runs forever.

config EXAMPLES_OSTEST_STACKSIZE
	int "OS test stack size"
	default 8192
	---help---
		Size of the stack used to create the ostest task.  Default is 8192.

config EXAMPLES_OSTEST_NBARRIER_THREADS
	int "Number of barrier threads"
	default 8
	---help---
		Specifies the number of threads to create in the barrier test.  The default
		is 8 but a smaller number may be needed on systems without sufficient memory
		to start so many threads.

config EXAMPLES_OSTEST_RR_RANGE
	int "Round-robin test - end of search range"
	default 10000
	range 1 32767
	---help---
		During round-robin scheduling test two threads are created. Each of the threads
		searches for prime numbers in the configurable range, doing that configurable
		number of times.

		This value specifies the end of search range and together with number of runs
		allows to configure the length of this test - it should last at least a few
		tens of seconds. Allowed values [1; 32767], default 10000

config EXAMPLES_OSTEST_RR_RUNS
	int "Round-robin test - number of runs"
	default 10
	range 1 32767
	---help---
		During round-robin scheduling test two threads are created. Each of the threads
		searches for prime numbers in the configurable range, doing that configurable
		number of times.

		This value specifies the number of times the thread searches the range for
		prime numbers and together with end of search range allows to configure the
		length of this test - it should last at least a few tens of seconds. Allowed
		values [1; 32767], default 10

endif
```

## apps/examples/pashello/Kconfig
```kconfig
#
# For a description of the syntax of this configuration file,
# see misc/tools/kconfig-language.txt.
#

config EXAMPLES_PASHELLO
	bool "Pascal \"Hello, World!\" example"
	default n
	---help---
		Enable the Pascal \"Hello, World!\" example

if EXAMPLES_PASHELLO
endif
```

## apps/examples/pipe/Kconfig
```kconfig
#
# For a description of the syntax of this configuration file,
# see misc/tools/kconfig-language.txt.
#

config EXAMPLES_PIPE
	bool "Pipe example"
	default n
	---help---
		Enable the pipe example

if EXAMPLES_PIPE
endif
```

## apps/examples/poll/Kconfig
```kconfig
#
# For a description of the syntax of this configuration file,
# see misc/tools/kconfig-language.txt.
#

config EXAMPLES_POLL
	bool "Poll example"
	default n
	depends on !NSH_BUILTIN_APPS
	---help---
		Enable the poll example

if EXAMPLES_POLL

config EXAMPLES_POLL_NOMAC
	bool "Use Canned MAC Address"
	default n

config EXAMPLES_POLL_IPADDR
	hex "Target IP address"
	default 0x0a000002

config EXAMPLES_POLL_DRIPADDR
	hex "Default Router IP address (Gateway)"
	default 0x0a000001

config EXAMPLES_POLL_NETMASK
	hex "Network Mask"
	default 0xffffff00

endif
```
