## apps/vsn/poweroff/Kconfig
```kconfig
#
# For a description of the syntax of this configuration file,
# see misc/tools/kconfig-language.txt.
#

config VSN_POWEROFF
	bool "NSH poweroff command"
	default n
	---help---
		Enable support for the NSH poweroff command.

if VSN_POWEROFF
endif
```

## apps/vsn/ramtron/Kconfig
```kconfig
#
# For a description of the syntax of this configuration file,
# see misc/tools/kconfig-language.txt.
#

config VSN_RAMTRON
	bool "NSH ramtron command"
	default n
	---help---
		Enable support for the NSH ramtron command.

if VSN_RAMTRON
endif
```

## apps/vsn/sdcard/Kconfig
```kconfig
#
# For a description of the syntax of this configuration file,
# see misc/tools/kconfig-language.txt.
#

config VSN_SDCARD
	bool "NSH sdcard command"
	default n
	---help---
		Enable support for the NSH sdcard command.

if VSN_SDCARD
endif
```

## apps/vsn/sysinfo/Kconfig
```kconfig
#
# For a description of the syntax of this configuration file,
# see misc/tools/kconfig-language.txt.
#

config VSN_SYSINFO
	bool "NSH sysinfo command"
	default n
	---help---
		Enable support for the NSH sysinfo command.

if VSN_SYSINFO
endif
```

## boards/airmind/mindracer_gen3_finch/src/patch/Kconfig.patch
```kconfig
--- a/Kconfig
+++ b/Kconfig
@@ -1399,8 +1399,13 @@
 	default n
 	depends on STM32F7_HAVE_ETHRNET
 	select NETDEVICES
-	select ARCH_HAVE_PHY
-	select STM32F7_HAVE_PHY_POLLED
+    select ARCH_HAVE_PHY if !STM32F7_NO_PHY
+    select STM32F7_PHY_POLLING if !STM32F7_NO_PHY
+
+config STM32F7_NO_PHY
+    bool "RMII Direct connection mode"
+    default n
+    depends on STM32F7_RMII
 
 config STM32F7_FMC
 	bool "FMC"
```

## boards/airmind/mindracer_gen3_redpoll/src/drivers/adj_bec/Kconfig
```kconfig
menuconfig Adjustable_BEC
    bool "Adjustable_BEC"
    default y
    ---help---
        Enable adjustable BEC output
```

## boards/airmind/mindracer_gen3_redpoll/src/drivers/rgbled_ktd202x/Kconfig
```kconfig
menuconfig DRIVERS_LIGHTS_RGBLED_KTD202X
	bool "rgbled ktd202x"
	default n
	---help---
		Enable support for rgbled ktd202x driver
```

## boards/auav/esc35-v1/nuttx-config/nsh/defconfig
```kconfig
# CONFIG_DISABLE_OS_API is not set
# CONFIG_NSH_CMDOPT_HEXDUMP is not set
# CONFIG_NSH_DISABLE_DATE is not set
# CONFIG_NSH_DISABLE_PS is not set
# CONFIG_SERIAL is not set
CONFIG_ARCH="arm"
CONFIG_ARCH_BOARD_CUSTOM_DIR="../nuttx-config"
CONFIG_ARCH_BOARD_CUSTOM_NAME="px4"
CONFIG_ARCH_CHIP_STM32=y
CONFIG_ARCH_CHIP_STM32F303CC=y
CONFIG_ARCH_INTERRUPTSTACK=4096
CONFIG_ARCH_MATH_H=y
CONFIG_ARCH_STACKDUMP=y
CONFIG_ARMV7M_MEMCPY=y
CONFIG_ARMV7M_USEBASEPRI=y
CONFIG_BOARDCTL_RESET=y
CONFIG_BOARD_CUSTOM_LEDS=y
CONFIG_BOARD_INITIALIZE=y
CONFIG_BOARD_LOOPSPERMSEC=5483
CONFIG_BUILTIN=y
CONFIG_BUILTIN_PROXY_STACKSIZE=4096
CONFIG_C99_BOOL8=y
CONFIG_CDCACM=y
CONFIG_CDCACM_BULKIN_REQLEN=96
CONFIG_CDCACM_CONSOLE=y
CONFIG_CDCACM_PRODUCTSTR="AUAV ESC35"
CONFIG_CDCACM_RXBUFSIZE=256
CONFIG_CDCACM_TXBUFSIZE=256
CONFIG_CDCACM_VENDORSTR="Auav"
CONFIG_DEBUG_CUSTOMOPT=y
CONFIG_DEBUG_HARDFAULT_ALERT=y
CONFIG_DEBUG_OPTLEVEL="-Os"
CONFIG_DEBUG_SYMBOLS=y
CONFIG_DEV_FIFO_SIZE=0
CONFIG_DEV_PIPE_SIZE=70
CONFIG_FDCLONE_STDIO=y
CONFIG_HAVE_CXX=y
CONFIG_HAVE_CXXINITIALIZE=y
CONFIG_IDLETHREAD_STACKSIZE=4096
CONFIG_LIBC_FLOATINGPOINT=y
CONFIG_LIBC_STRERROR=y
CONFIG_MAX_TASKS=16
CONFIG_MAX_WDOGPARMS=2
CONFIG_MEMSET_64BIT=y
CONFIG_MEMSET_OPTSPEED=y
CONFIG_NAME_MAX=93
CONFIG_NFILE_DESCRIPTORS=54
CONFIG_NFILE_STREAMS=12
CONFIG_NSH_ARCHINIT=y
CONFIG_NSH_BUILTIN_APPS=y
CONFIG_NSH_DISABLE_BASENAME=y
CONFIG_NSH_DISABLE_DIRNAME=y
CONFIG_NSH_DISABLE_PSSTACKUSAGE=y
CONFIG_NSH_DISABLE_REBOOT=y
CONFIG_NSH_DISABLE_TELNETD=y
CONFIG_NSH_DISABLE_TIME=y
CONFIG_NSH_DISABLE_WGET=y
CONFIG_NSH_FILEIOSIZE=512
CONFIG_NSH_LINELEN=128
CONFIG_NSH_MAXARGUMENTS=12
CONFIG_NSH_NESTDEPTH=8
CONFIG_NSH_READLINE=y
CONFIG_NSH_STRERROR=y
CONFIG_PIPES=y
CONFIG_POSIX_SPAWN_PROXY_STACKSIZE=4096
CONFIG_PREALLOC_MQ_MSGS=4
CONFIG_PREALLOC_TIMERS=20
CONFIG_PREALLOC_WDOGS=20
CONFIG_PRIORITY_INHERITANCE=y
CONFIG_PTHREAD_STACK_DEFAULT=4096
CONFIG_PTHREAD_STACK_MIN=4096
CONFIG_RAM_SIZE=131072
CONFIG_RAM_START=0x20000000
CONFIG_RAW_BINARY=y
CONFIG_READLINE_CMD_HISTORY=y
CONFIG_READLINE_CMD_HISTORY_LEN=4
CONFIG_READLINE_CMD_HISTORY_LINELEN=64
CONFIG_READLINE_TABCOMPLETION=y
CONFIG_SCHED_ATEXIT=y
CONFIG_SCHED_HPWORK=y
CONFIG_SCHED_HPWORKPRIORITY=192
CONFIG_SCHED_HPWORKSTACKSIZE=4096
CONFIG_SCHED_INSTRUMENTATION=y
CONFIG_SCHED_LPWORK=y
CONFIG_SCHED_LPWORKPRIORITY=50
CONFIG_SCHED_LPWORKSTACKSIZE=4096
CONFIG_SCHED_WAITPID=y
CONFIG_SDCLONE_DISABLE=y
CONFIG_SEM_NNESTPRIO=8
CONFIG_SEM_PREALLOCHOLDERS=0
CONFIG_SIG_SIGWORK=4
CONFIG_STACK_COLORATION=y
CONFIG_START_DAY=30
CONFIG_START_MONTH=11
CONFIG_STM32_DISABLE_IDLE_SLEEP_DURING_DEBUG=y
CONFIG_STM32_DMA1=y
CONFIG_STM32_DMA2=y
CONFIG_STM32_FORCEPOWER=y
CONFIG_STM32_JTAG_SW_ENABLE=y
CONFIG_STM32_PWR=y
CONFIG_STM32_TIM1=y
CONFIG_STM32_TIM2=y
CONFIG_STM32_USB=y
CONFIG_SYMTAB_ORDEREDBYNAME=y
CONFIG_SYSTEM_CDCACM=y
CONFIG_SYSTEM_NSH=y
CONFIG_TASK_NAME_SIZE=24
CONFIG_TASK_SPAWN_DEFAULT_STACKSIZE=4096
CONFIG_TIME_EXTENDED=y
CONFIG_USBDEV_BUSPOWERED=y
CONFIG_USBDEV_DUALSPEED=y
CONFIG_USBDEV_MAXPOWER=500
CONFIG_USEC_PER_TICK=1000
CONFIG_USERMAIN_STACKSIZE=4096
CONFIG_USER_ENTRYPOINT="nsh_main"
CONFIG_WATCHDOG=y
```

## boards/intel/aerofc-v1/nuttx-config/Kconfig
```kconfig
#
# For a description of the syntax of this configuration file,
# see misc/tools/kconfig-language.txt.
#

if ARCH_BOARD_AEROFC_V1

config BOARD_HAS_PROBES
	bool "Board provides GPIO or other Hardware for signaling to timing analyze."
	default y
	---help---
		This board provides GPIO FMU-CH1-6 as PROBE_1-6 to provide timing signals from selected drivers.

config BOARD_USE_PROBES
	bool "Enable the use the board provided GPIO FMU-CH1-6 as PROBE_1-6 to provide timing signals from selected drivers"
	default n
	depends on BOARD_HAS_PROBES

	---help---
		Select to use GPIO FMU-CH1-6 to provide timing signals from selected drivers.

endif

# Hack to ensure ARCH_MATH_H is kept
config BOARD_HAVE_MATH_H
	bool "Provide ARCH math.h (selects ARCH_HAVE_MATH_H)"
	default y
	select ARCH_HAVE_MATH_H
```

## boards/matek/gnss-m9n-f4/nuttx-config/Kconfig
```kconfig
menu "SERIAL_PASSTHRU Configuration"
config SERIAL_PASSTHRU_UBLOX
	bool "Detect and Auto Connect on U-Center messages"
	default n
	---help---
		This option will enable the cdc_acm_check to launch
		The passthru driver.

config SERIAL_PASSTHRU_UBLOX_DEV
	string "Device path of the GPS"
	depends on SERIAL_PASSTHRU_UBLOX
	default "/dev/ttyS2"
	---help---
		This is the path of the device used as the right side
		of the passthru.

config SERIAL_PASSTHRU_UBLOX_BAUDRATE
	string "baudrate"
	depends on SERIAL_PASSTHRU_UBLOX
	default "115200"
	---help---
		This option sets the baudrate for the passthru.
endmenu
```

## boards/modalai/voxl2-slpi/src/drivers/ghst_rc/Kconfig
```kconfig
menuconfig DRIVERS_GHST_RC
	bool "ghst_rc"
	default n
	---help---
		Enable support for ghst rc
```

## boards/nxp/fmurt1062-v1/nuttx-config/Kconfig
```kconfig
#
# For a description of the syntax of this configuration file,
# see the file kconfig-language.txt in the NuttX tools repository.
#

choice
	prompt "Boot Flash"
	default NXP_FMURT1062_V3_QSPI_FLASH

config NXP_FMURT1062_V3_HYPER_FLASH
	bool "HYPER Flash"

config NXP_FMURT1062_V3_QSPI_FLASH
	bool "QSPI Flash"

endchoice # Boot Flash
```

## boards/nxp/fmurt1170-v1/nuttx-config/Kconfig
```kconfig
#
# For a description of the syntax of this configuration file,
# see the file kconfig-language.txt in the NuttX tools repository.
#

choice
	prompt "Boot Flash"
	default NXP_FMURT1170_V3_QSPI_FLASH

config NXP_FMURT1170_V3_HYPER_FLASH
	bool "HYPER Flash"

config NXP_FMURT1170_V3_QSPI_FLASH
	bool "QSPI Flash"

endchoice # Boot Flash

config BOARD_HAS_PROBES
	bool "Board provides GPIO or other Hardware for signaling to timing analyze."
	default y
	---help---
		This board provides GPIO FMU-CH1-8, as PROBE_1-8 to provide timing signals
		from selected drivers.

config BOARD_USE_PROBES
	bool "Enable the use the board provided FMU-CH1-8 as PROBE_1-8"
	default n
	depends on BOARD_HAS_PROBES

	---help---
		Select to use GPIO FMU-CH1-8, as PROBE_1-8 to provide timing signals
		from selected drivers.

config BOARD_FORCE_ALIGNMENT
	bool "Forces all acesses to be Aligned"
	default n

	---help---
		Adds -mno-unaligned-access to build flags. to force alignment.
		This can be needed if data is stored in a region of memory, that
		is Strongly ordered and dcache is off.

config BOARD_BOOTLOADER_INVALID_FCB
	bool "Disables the FCB header"
	default n

	---help---
		This can be used to keep the ROM bootloader in the serial Download mode.
		Thus preventing bootlooping on `is_debug_pending` in the lame Rev B
		silicon ROM bootloader. You can not cold boot (Power cycle) but can
		Jtag from Load and be abel to reset it.

config BOARD_BOOTLOADER_FIXUP
	bool "Restores OCTAL Flash when No FCB"
	default n
	select ARCH_RAMFUNCS

	---help---
		Restores OCTAL Flash when FCB is invalid.
```

## boards/nxp/mr-canhubk3/nuttx-config/Kconfig
```kconfig
#
# For a description of the syntax of this configuration file,
# see the file kconfig-language.txt in the NuttX tools repository.
#

config BOARD_HAS_PROBES
	bool "Board provides GPIO or other Hardware for signaling to timing analyze."
	default y
	---help---
		This board provides GPIO PWM-CH0-7 as PROBE_1-8 to provide timing signals from selected drivers.

config BOARD_USE_PROBES
	bool "Enable the use the board provided PWM-CH0-7 as PROBE_1-8"
	default n
	depends on BOARD_HAS_PROBES

	---help---
		Select to use GPIO PWM-CH0-7 to provide timing signals from selected drivers.
```
