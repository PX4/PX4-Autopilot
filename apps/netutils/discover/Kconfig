## apps/netutils/discover/Kconfig
```kconfig
#
# For a description of the syntax of this configuration file,
# see misc/tools/kconfig-language.txt.
#

config NETUTILS_DISCOVER
	bool "Network Discovery Utility"
	default n
	depends on NET_UDP
	select NETUTILS_UIPLIB
	---help---
		Tool for discovering devices on the local network per UDP broadcast.

if NETUTILS_DISCOVER

config DISCOVER_STACK_SIZE
	int "Discover Daemon Stack Size"
	default 1024

config DISCOVER_PRIORITY
	int "Discover Daemon Priority"
	default 50

config DISCOVER_PORT
	int "Discover Daemon Port Number"
	default 96

config DISCOVER_INTERFACE
	string "Network Interface Name"
	default "eth0"

config DISCOVER_DEVICE_CLASS
	hex "Network Discovery Class"
	default 0xff

config CONFIG_DISCOVER_DESCR
	string "Discoverer Description"
	default "NuttX"

endif
```

## apps/netutils/ftpc/Kconfig
```kconfig
#
# For a description of the syntax of this configuration file,
# see misc/tools/kconfig-language.txt.
#

config NETUTILS_FTPC
	bool "FTP client"
	default n
	---help---
		Enable support for the FTP client.

if NETUTILS_FTPC
endif
```

## apps/netutils/ftpd/Kconfig
```kconfig
#
# For a description of the syntax of this configuration file,
# see misc/tools/kconfig-language.txt.
#

config NETUTILS_FTPD
	bool "FTP server"
	default n
	---help---
		Enable support for the FTP server.

if NETUTILS_FTPD
endif
```

## apps/netutils/json/Kconfig
```kconfig
#
# For a description of the syntax of this configuration file,
# see misc/tools/kconfig-language.txt.
#

config NETUTILS_JSON
	bool "cJSON library"
	default n
	---help---
		Enables the cJSON library.  cJSON is an ultra-lightweight, portable,
		single-file, simple-as-can-be ANSI-C compliant JSON parser, under MIT
		license. Embeddable Lightweight XML-RPC Server discussed at
		http://www.drdobbs.com/web-development/an-embeddable-lightweight-xml-rpc-server/184405364.
		This code was taken from http://sourceforge.net/projects/cjson/ and
		adapted for NuttX by Darcy Gong.

if NETUTILS_JSON
endif
```

## apps/netutils/resolv/Kconfig
```kconfig
#
# For a description of the syntax of this configuration file,
# see misc/tools/kconfig-language.txt.
#

config NETUTILS_RESOLV
	bool "Name resolution"
	default n
	---help---
		Enable support for the name resolution.

config NET_RESOLV_ENTRIES
	int "Number of resolver entries"
	default 8
	depends on NETUTILS_RESOLV
	---help---
		Number of resolver entries.  Default: 8

config NET_RESOLV_MAXRESPONSE
	int "Max response size"
	default 96
	depends on NETUTILS_RESOLV
	---help---
		This setting determines the maximum size of response message that can be
		received by the DNS resolver.  The default is 96 but may need to be larger on
 		enterprise networks (perhaps 176).
```

## apps/netutils/smtp/Kconfig
```kconfig
#
# For a description of the syntax of this configuration file,
# see misc/tools/kconfig-language.txt.
#

config NETUTILS_SMTP
	bool "SMTP"
	default n
	---help---
		Enable support for SMTP.

if NETUTILS_SMTP
endif
```

## apps/netutils/telnetd/Kconfig
```kconfig
#
# For a description of the syntax of this configuration file,
# see misc/tools/kconfig-language.txt.
#

config NETUTILS_TELNETD
	bool "Telet daemon"
	default n
	---help---
		Enable support for the Telnet daemon.

if NETUTILS_TELNETD
endif
```

## apps/netutils/tftpc/Kconfig
```kconfig
#
# For a description of the syntax of this configuration file,
# see misc/tools/kconfig-language.txt.
#

config NETUTILS_TFTPC
	bool "TFTP client"
	default n
	---help---
		Enable support for the TFTP client.

if NETUTILS_TFTPC
endif
```

## apps/netutils/thttpd/Kconfig
```kconfig
#
# For a description of the syntax of this configuration file,
# see misc/tools/kconfig-language.txt.
#

config NETUTILS_THTTPD
	bool "THTTPD webserver"
	default n
	---help---
		Enable support for the THTTPD webservert.

if NETUTILS_TFTPC
config THTTPD_PORT
	int "THTTPD port number"
	default 80
	---help---
		THTTPD Server port number.  Default: 80

config THTTPD_IPADDR
	hex "THTTPD IP address"
	default 0x10000002
	---help---
		Server IP address (no host name).  Default: 0x10000002

		This is a 32-bit integer value in host order.  So, as an example,
		the default value of 0x10000002 would correspond to 10.0.0.2.

config THTTPD_SERVER_ADDRESS
	string "Reported server URL"
	default "http://www.nuttx.org"
	---help---
		SERVER_ADDRESS: response, Default: "http://www.nuttx.org"

config THTTPD_SERVER_SOFTWARE
	string "Reporter server software string"
	default "thttpd/2.25b 29dec2003-NuttX"
	---help---
		SERVER_SOFTWARE: response, Default: "thttpd/2.25b 29dec2003-NuttX"

config THTTPD_PATH
	string "Path to the server content"
	default "/mnt/www"
	---help---
		Server working directory.  Default: "/mnt/www"

config THTTPD_CGI_PATH
	string "Path to CGI content"
	default "/mnt/www/cgi-bin"
	---help---
		Path to CGI executables.  Default: "/mnt/www/cgi-bin"

config THTTPD_CGI_PATTERN
	string "CGI match pattern"
	default "/mnt/www/cgi-bin/*"
	---help---
		Only CGI programs matching this pattern will be executed.  In
		fact, if this value is not defined then no CGI logic will be built.
		Default: "/mnt/www/cgi-bin/*"

config THTTPD_CGI_PRIORITY
	int "CGI child priority"
	default 50
	---help---
		Provides the priority of CGI child tasks.  Default: 50

config THTTPD_CGI_STACKSIZE
	int "CGI child stack size"
	default 2048
	---help---
		Provides the default stack size of CGI child task (will be overridden
		by the stack size in the NXFLAT header)

config THTTPD_CGI_BYTECOUNT
	int "Byte output limit"
	default 200000
	---help---
		Byte output limit for CGI tasks.  Default: 200000

config THTTPD_CGI_TIMELIMIT
	int "CGI time limit"
	default 0
	---help---
		How many seconds to allow CGI programs to run before killing them.
		Default: 0 (no time limit)

config THTTPD_CHARSET
	string "Default character set"
	default "iso-8859-1"
	---help---
		The default character set name to use with text MIME types.
		Default: "iso-8859-1"

config THTTPD_IOBUFFERSIZE
	int "Initial I/O buffer size"
	default 256
	---help---
		Initial I/O buffer size.  Default: 256

config THTTPD_MINSTRSIZE
	int "Minimum string size"
	default 64
	---help---
		Minimum string size.  Default: 64

config THTTPD_REALLOCINCR
	int "String reallocation increment"
	default 64
	---help---
		String reallocation increment.  Default: 64

config THTTPD_MAXREALLOC
	int "Maximum string reallocation size"
	default 4096
	---help---
		Maximum string reallocation size.  Default: 4096

config THTTPD_CGIINBUFFERSIZ
	int "CGI interpose input buffer size"
	default 512
	---help---
		CGI interpose input buffer size.  Default: 512

config THTTPD_CGIOUTBUFFERSIZE
	int "CGI interpose output buffer size"
	default 512
	---help---
		CGI interpose output buffer size.  Default: 512

config THTTPD_INDEX_NAMES
	string "Index file name list"
	default "\"index.html\", \"index.htm\", \"index.cgi\""
	---help---
		A list of index filenames to check. The files are searched for
		in this order.  Default: "\"index.html\", \"index.htm\", \"index.cgi\""

config AUTH_FILE
	string "Authorization file"
#	default ".htpasswd"
	---help---
		The file to use for authentication. If this is defined then thttpd
		checks for this file in the local directory before every fetch. If
		the file exists then authentication is done, otherwise the fetch proceeds
		as usual. If you leave this undefined then thttpd will not implement
		authentication at all and will not check for auth files, which saves a
		bit of CPU time. A typical value is ".htpasswd"

config THTTPD_LISTEN_BACKLOG
	int "Listen backlog"
	default 8
	---help---
		The listen() backlog queue length.  Default: 8

config THTTPD_LINGER_MSEC
	int "Linger time (msec)"
	default 500
	---help---
		How many milliseconds to leave a connection open while doing a lingering
		close.  Default: 500

config THTTPD_OCCASIONAL_MSEC
	int "Occasional clean-up time (msec)"
	default 120
	---help---
		How often to run the occasional cleanup job in milliseconds.
		Default: 120 (2 minutes)

config THTTPD_MEMDEBUG
	bool "Enable memory debug"
	default n
	depends on DEBUG && DEBUG_NET
	---help---
		Enable THTTPD memory usage debug output.  Default: n

config THTTPD_IDLE_READ_LIMIT_SEC
	int "Idle read time limit (sec)"
	default 300
	---help---
		How many seconds to allow for reading the initial request on a new connection.
		Default: 300

config THTTPD_IDLE_SEND_LIMIT_SEC
	int "Idle send time limit (sec)"
	default 300
	---help---
		How many seconds before an idle connection gets closed.
		Default: 300

config THTTPD_TILDE_MAP1
	string "Tilde mapping"
	---help---
		Tilde mapping.

		Many URLs use ~username to indicate a user's home directory. thttpd
		provides two options for mapping this construct to an  actual filename.

		1) Map ~username to <prefix>/username. This is the recommended choice.
		 Each user gets a subdirectory in the main web tree, and the tilde
		 construct points there. The prefix could be something like "users",
		 or it could be empty.
		2) Map ~username to <user's homedir>/<postfix>. The postfix would be
		 the name of a subdirectory off of the user's actual home dir,
		 something like "public_html".

		You can also leave both options undefined, and thttpd will not do
		anything special about tildes. Enabling both options is an error.
		Typical values, if they're defined, are "users" for
		config THTTPD_TILDE_MAP1 and "public_html" for THTTPD_TILDE_MAP2. 

config THTTPD_TILDE_MAP2
	string "Tilde mapping"
	---help---
		Tilde mapping.

		Many URLs use ~username to indicate a user's home directory. thttpd
		provides two options for mapping this construct to an  actual filename.

		1) Map ~username to <prefix>/username. This is the recommended choice.
		 Each user gets a subdirectory in the main web tree, and the tilde
		 construct points there. The prefix could be something like "users",
		 or it could be empty.
		2) Map ~username to <user's homedir>/<postfix>. The postfix would be
		 the name of a subdirectory off of the user's actual home dir,
		 something like "public_html".

		You can also leave both options undefined, and thttpd will not do
		anything special about tildes. Enabling both options is an error.
		Typical values, if they're defined, are "users" for
		config THTTPD_TILDE_MAP1 and "public_html" for THTTPD_TILDE_MAP2. 

config THTTPD_GENERATE_INDICES
	bool "Generate name indices"
	default n
	---help---

config THTTPD_URLPATTERN
	string "URL pattern"
	---help---
		If defined, then it will be used to match and verify referrers.

endif
```

## apps/netutils/uiplib/Kconfig
```kconfig
#
# For a description of the syntax of this configuration file,
# see misc/tools/kconfig-language.txt.
#

config NETUTILS_UIPLIB
	bool "Network support library"
	default n
	---help---
		Enable support for the network support library.

if NETUTILS_UIPLIB
endif
```

## apps/netutils/webclient/Kconfig
```kconfig
#
# For a description of the syntax of this configuration file,
# see misc/tools/kconfig-language.txt.
#

config NETUTILS_WEBCLIENT
	bool "uIP web client"
	default n
	---help---
		Enable support for the uIP web client.

if NETUTILS_WEBCLIENT

config NSH_WGET_USERAGENT
	string "wget Usert Agent"
	default "NuttX/6.xx.x (; http://www.nuttx.org/)"

endif
```

## apps/netutils/webserver/Kconfig
```kconfig
#
# For a description of the syntax of this configuration file,
# see misc/tools/kconfig-language.txt.
#

config NETUTILS_WEBSERVER
	bool "uIP web server"
	default n
	---help---
		Enable support for the uIP web server.  This tiny web server was
		from uIP 1.0, but has undergone many changes.  It is, however,
		still referred to as the "uIP" web server.

if NETUTILS_WEBSERVER

config NETUTILS_HTTPD_SINGLECONNECT
	bool "Single Connection"
	default n if !DISABLE_PTHREAD
	default y if DISABLE_PTHREAD
	---help---
		By default, the uIP web server will create a new, independent thread
		for each connection.  This can, however, use a lot of stack space 
		if there are many connections and that can be a problem is RAM is
		limited.  If this option is selected, then a single thread will
		service all HTTP requests and, in this case, only a single connection
		at a time is supported at a time.

config NETUTILS_HTTPD_SCRIPT_DISABLE
	bool "Disable %! scripting"
	default y if NETUTILS_HTTPD_SENDFILE
	default n if !NETUTILS_HTTPD_SENDFILE
	---help---
		This option, if selected, will elide the %! scripting

config NETUTILS_HTTPD_CGIPATH
	bool "URL/CGI function mapping"
	default n
	---help---
		This option enables mappings from URLs to call CGI functions.  The
		effect is that the existing httpd_cgi_register() interface can be
		used thus:

		const static struct httpd_cgi_call a[] = {
		{ NULL, "/abc", cgi_abc },
		{ NULL, "/xyz", cgi_xyz }
		};

		for (i = 0; i < sizeof a / sizeof *a; i++) {
		httpd_cgi_register(&a[i]);
		}

		Where (under CONFIG_NETUTILS_HTTPD_CGIPATH) the "/xyz" is a URL path,
		rather than a %! xyz style call in the existing manner.

		This is useful when CONFIG_NETUTILS_HTTPD_SCRIPT_DISABLE is defined.

		In other words, this provides a way to get your CGI functions called
		without needing the scripting language. I'm using this to provide a
		REST style interface over HTTP, where my CGI handlers just return a
		HTTP status code with a content length of 0.

config NETUTILS_HTTPD_SERVERHEADER_DISABLE
	bool "Disabled the SERVER header"
	default n
	---help---
		This option, if selected, will elide the Server\: header

config NETUTILS_HTTPD_TIMEOUT
	int "Receive Timeout (sec)"
	default 0
	---help---
		Receive timeout setting (in seconds).  A timeout value of zero
		disables the timeout.  An HTTP 408 error is generated if the timeout
		expires.

choice
	prompt "File Transfer Method"
	default NETUTILS_HTTPD_CLASSIC

config NETUTILS_HTTPD_CLASSIC
	bool "Pre-processed files"
	---help---
		Traditionally, the uIP-based webserver only sends "files" that have
		been prepared as a data structure using nutts/tools/mkfsdata.pl

config NETUTILS_HTTPD_MMAP
	bool "File mmap-ing"
	---help---
		Traditionally, the uIP-based webserver only sends "files" that have
		been prepared as a data structure using nutts/tools/mkfsdata.pl
		However, extensions have been contributed.  If this option is
		selected, then files can be accessed from the NuttX file system
		as well.  This selection will map the files into memory (using mmap)
		so that the logic is still basically compatible with the classic
		approach.  NOTE, however, that since files are copied into memory,
		this limits solution to small files that will fit into available RAM.

config NETUTILS_HTTPD_MMAP
	bool "sendfile()"
	select NETUTILS_HTTPD_SCRIPT_DISABLE
	---help---
		Traditionally, the uIP-based webserver only sends "files" that have
		been prepared as a data structure using nutts/tools/mkfsdata.pl
		However, extensions have been contributed.  If this option is
		selected, then files can be accessed from the NuttX file system
		as well.  This selection will use the NuttX sendfile() interface
		to send files.  NOTE: If this option is selected, then scripting
		must be disabled since it depends on the classic, in-memory
		representation.

endchoice
endif
```

## apps/netutils/xmlrpc/Kconfig
```kconfig
#
# For a description of the syntax of this configuration file,
# see misc/tools/kconfig-language.txt.
#

config NETUTILS_XMLRPC
	bool "XML RPC library"
	default n
	depends on NET_TCP
	select NETUTILS_UIPLIB
	---help---
		Enables the Embeddable Lightweight XML-RPC Server discussed at
		http://www.drdobbs.com/web-development/an-embeddable-lightweight-xml-rpc-server/184405364

if NETUTILS_XMLRPC

config XMLRPC_STRINGSIZE
	int "Maximum string length"
	default 64
	---help---
		Maximum string length for method names and XML RPC string values.

endif
```
