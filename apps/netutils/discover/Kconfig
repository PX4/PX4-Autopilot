## apps/system/Kconfig
```kconfig
#
# For a description of the syntax of this configuration file,
# see misc/tools/kconfig-language.txt.
#

menu "Custom Free Memory Command"
source "$APPSDIR/system/free/Kconfig"
endmenu

menu "I2C tool"
source "$APPSDIR/system/i2c/Kconfig"
endmenu

menu "FLASH Program Installation"
source "$APPSDIR/system/install/Kconfig"
endmenu

menu "readline()"
source "$APPSDIR/system/readline/Kconfig"
endmenu

menu "Power Off"
source "$APPSDIR/system/poweroff/Kconfig"
endmenu

menu "RAMTRON"
source "$APPSDIR/system/ramtron/Kconfig"
endmenu

menu "SD Card"
source "$APPSDIR/system/sdcard/Kconfig"
endmenu

menu "Sysinfo"
source "$APPSDIR/system/sysinfo/Kconfig"
endmenu

menu "USB Monitor"
source "$APPSDIR/system/usbmonitor/Kconfig"
endmenu
```

## apps/system/free/Kconfig
```kconfig
#
# For a description of the syntax of this configuration file,
# see misc/tools/kconfig-language.txt.
#

config SYSTEM_FREE
	bool "NSH free command replacement"
	default n
	---help---
		Enable support for the NSH free replacement command.

if SYSTEM_FREE
endif
```

## apps/system/i2c/Kconfig
```kconfig
#
# For a description of the syntax of this configuration file,
# see misc/tools/kconfig-language.txt.
#


config SYSTEM_I2CTOOL
	bool "I2C tool"
	default n
	depends on I2C
	---help---
		Enable support for the I2C tool.

if SYSTEM_I2CTOOL
config I2CTOOL_BUILTIN
	bool "NSH built-in command"
	default y
	depends on NSH_BUILTIN_APPS
	---help---
		Build the tools as an NSH built-in command

config I2CTOOL_MINBUS
	int "Minimum bus number"
	default 0
	---help---
		Smallest bus index supported by the hardware (default 0).

config I2CTOOL_MAXBUS
	int "Maximum bus number"
	default 3
	---help---
		Largest bus index supported by the hardware (default 3)

config I2CTOOL_MINADDR
	hex "Minimum I2C address"
	default 0x03
	---help---
		Minium 7-bit device address (default: 0x03)

config I2CTOOL_MAXADDR
	hex "Maximum I2C address"
	default 0x77
	---help---
		Largest 7-bit device address (default: 0x77)

config I2CTOOL_MAXREGADDR
	hex "Maximum I2C register address"
	default 0xff
	---help---
		Largest I2C register address (default: 0xff)

config I2CTOOL_DEFFREQ
	int "Default I2C frequency"
	default 4000000
	---help---
		Default I2C frequency (default: 4000000)

endif
```

## apps/system/install/Kconfig
```kconfig
#
# For a description of the syntax of this configuration file,
# see misc/tools/kconfig-language.txt.
#

config SYSTEM_INSTALL
	bool "FLASH installation tool"
	default n
	---help---
		Enable support for the FLASH installation tool.

if SYSTEM_INSTALL
endif
```

## apps/system/poweroff/Kconfig
```kconfig
#
# For a description of the syntax of this configuration file,
# see misc/tools/kconfig-language.txt.
#

config SYSTEM_POWEROFF
	bool "Power-Off command"
	default n
	---help---
		Enable support for the NSH poweroff command.  NOTE: This option
		provides the NSH power-off command only.  It requires board-specific
		support to actually implement the power-off.

if SYSTEM_POWEROFF
endif
```

## apps/system/ramtron/Kconfig
```kconfig
#
# For a description of the syntax of this configuration file,
# see misc/tools/kconfig-language.txt.
#

config SYSTEM_RAMTRON
	bool "RAMTRON command"
	default n
	---help---
		Enable support for the NSH RAMTRON command.

if SYSTEM_RAMTRON
endif
```

## apps/system/readline/Kconfig
```kconfig
#
# For a description of the syntax of this configuration file,
# see misc/tools/kconfig-language.txt.
#

config SYSTEM_READLINE
	bool "readline() support"
	default n
	---help---
		Enable support for the readline() function.

if SYSTEM_READLINE
config READLINE_ECHO
	bool "Echo character input"
	default y
	---help---
		Echo received character input back via stdout.  This is normal
		behavior and should be selected unless the source of stdin input
		already has local echo support or you need to suppress the back-channel
		responses for any other reason.

endif
```

## apps/system/sdcard/Kconfig
```kconfig
#
# For a description of the syntax of this configuration file,
# see misc/tools/kconfig-language.txt.
#

config SYSTEM_SDCARD
	bool "NSH sdcard command"
	default n
	---help---
		Enable support for the NSH sdcard command.

if SYSTEM_SDCARD
endif
```

## apps/system/sysinfo/Kconfig
```kconfig
#
# For a description of the syntax of this configuration file,
# see misc/tools/kconfig-language.txt.
#

config SYSTEM_SYSINFO
	bool "NSH sysinfo command"
	default n
	---help---
		Enable support for the NSH sysinfo command.

if SYSTEM_SYSINFO
endif
```

## apps/system/usbmonitor/Kconfig
```kconfig
#
# For a description of the syntax of this configuration file,
# see misc/tools/kconfig-language.txt.
#

config SYSTEM_USBMONITOR
	bool "USB Monitor"
	default n
	depends on USBDEV && USBDEV_TRACE && SYSLOG
	---help---
		If USB device tracing is enabled (USBDEV_TRACE), then this option
		will select the USB monitor.  The USB monitor is a daemon that will
		periodically collect the buffered USB trace data and dump it to the
		SYSLOG device.

if SYSTEM_USBMONITOR

config SYSTEM_USBMONITOR_STACKSIZE
	int "USB Monitor daemon stack size"
	default 2048
	---help---
		The stack size to use the the USB monitor daemon.  Default: 2048

config SYSTEM_USBMONITOR_PRIORITY
	int "USB Monitor daemon priority"
	default 50
	---help---
		The priority to use the the USB monitor daemon.  Default: 50

config SYSTEM_USBMONITOR_INTERVAL
	int "USB Monitor dump frequency"
	default 2
	---help---
		The rate in seconds that the USB monitor will wait before dumping
		the next set of buffered USB trace data.  Default:  2 seconds.

config SYSTEM_USBMONITOR_TRACEINIT
	bool "Show initialization events"
	default n
	---help---
		Show initialization events

config SYSTEM_USBMONITOR_TRACECLASS
	bool "Show class driver events"
	default n
	---help---
		Show class driver events

config SYSTEM_USBMONITOR_TRACETRANSFERS
	bool "Show data transfer events"
	default n
	---help---
		Show data transfer events

config SYSTEM_USBMONITOR_TRACECONTROLLER
	bool "Show controller events"
	default n
	---help---
		Show controller events

config SYSTEM_USBMONITOR_TRACEINTERRUPTS
	bool "Show interrupt-related events"
	default n
	---help---
		Show interrupt-related events
endif
```

## apps/vsn/Kconfig
```kconfig
#
# For a description of the syntax of this configuration file,
# see misc/tools/kconfig-language.txt.
#

comment "VSN board add-ons"

source "$APPSDIR/vsn/poweroff/Kconfig"
source "$APPSDIR/vsn/ramtron/Kconfig"
source "$APPSDIR/vsn/sdcard/Kconfig"
source "$APPSDIR/vsn/sysinfo/Kconfig"
```
