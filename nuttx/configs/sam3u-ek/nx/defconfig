## nuttx/configs/stm3210e-eval/Kconfig
```kconfig
#
# For a description of the syntax of this configuration file,
# see misc/tools/kconfig-language.txt.
#

if ARCH_BOARD_STM3210E_EVAL
comment "STM3210E-EVAL LCD Hardware Configuration"

config ARCH_LEDS
	bool "NuttX LED support"
	default n
	---help---
		"Support control of board LEDs by NuttX to indicate system state"

config ARCH_BUTTONS
	bool "Button support"
	default n
	---help---
		"Support interfaces to use buttons provided by the board."

config ARCH_IRQBUTTONS
	bool "Button interrupt support"
	default n
	depends on ARCH_BUTTONS
	---help---
		"Support EXTI interrupts on button presses and releases."

config STM3210E_LCD
	bool "Select support for the STM3210E-EVAL LCD"
	default y
	depends on LCD && STM32_FSMC

config LCD_BACKLIGHT
	bool "LCD backlight support"
	depends on STM3210E_LCD
	default n
	---help---
		Define to support a backlight.

config LCD_PWM
	bool "LCD backlight PWM control"
	default n
	depends on LCD_BACKLIGHT && STM32_TIM1
	---help---
		If STM32_TIM1 is also defined, then an adjustable backlight will be
		provided using timer 1 to generate various pulse widthes.  The
		granularity of the settings is determined by LCD_MAXPOWER.  If LCD_PWM
		(or STM32_TIM1) is not defined, then a simple on/off backlight is
		provided.

config LCD_RDSHIFT
	int "LCD data shift"
	default 5
	depends on STM3210E_LCD
	---help---
		When reading 16-bit gram data, there appears to be a shift in the returned
		data.  This value fixes the offset.  Default 5.

config STM32_AM240320_DISABLE
	bool "Disable AM240320 support"
	default n
	depends on STM3210E_LCD
	---help---
		The LCD driver dynamically selects the LCD based on the reported LCD
		ID value.  However, code size can be reduced by suppressing support for
		individual LCDs using this option

config STM32_SPFD5408B_DISABLE
	bool "Disable SPFD5408B support"
	default n
	depends on STM3210E_LCD
	---help---
		The LCD driver dynamically selects the LCD based on the reported LCD
		ID value.  However, code size can be reduced by suppressing support for
		individual LCDs using this option

config STM32_R61580_DISABLE
	bool "Disable R61580 support"
	default n
	depends on STM3210E_LCD
	---help---
		The LCD driver dynamically selects the LCD based on the reported LCD
		ID value.  However, code size can be reduced by suppressing support for
		individual LCDs using this option

endif

config PM_BUTTONS
	bool "PM Button support"
	default n
	depends on PM && ARCH_IRQBUTTONS
	---help---
		Enable PM button EXTI interrupts to support PM testing

config PM_BUTTONS_MIN
	int "Minimum button number"
	default 0
	depends on PM_BUTTONS
	---help---
		The lowest button code to use for PM testing (see board.h)

config PM_BUTTONS_MAX
	int "Maximum button number"
	default 7
	depends on PM_BUTTONS
	---help---
		The highest button code to use for PM testing (see board.h)

config PM_IRQBUTTONS_MIN
	int "Minimum interrupting button number"
	default 0
	depends on PM_BUTTONS
	---help---
		The lowest interrupting button code to use for PM testing (see board.h)

config PM_IRQBUTTONS_MAX
	int "Maximum interrupting button number"
	default 7
	depends on PM_BUTTONS
	---help---
		The highest interrupting button code to use for PM testing (see board.h)

config PM_BUTTON_ACTIVITY
	int "Button PM activity weight"
	default 10
	depends on PM_BUTTONS
	---help---
		The activity weight to report to the power management subsystem when a button is pressed.

config PM_ALARM_SEC
	int "PM_STANDBY delay (seconds)"
	default 15
	depends on PM && RTC_ALARM
	--help---
		Number of seconds to wait in PM_STANDBY before going to PM_STANDBY mode.

config PM_ALARM_NSEC
	int "PM_STANDBY delay (nanoseconds)"
	default 0
	depends on PM && RTC_ALARM
	--help---
		Number of additional nanoseconds to wait in PM_STANDBY before going to PM_STANDBY mode.

config PM_SLEEP_WAKEUP
	bool "PM_SLEEP wake-up alarm"
	default n
	depends on PM && RTC_ALARM
	--help---
		Wake-up of PM_SLEEP mode after a delay and resume normal operation.

config PM_SLEEP_WAKEUP_SEC
	int "PM_SLEEP delay (seconds)"
	default 10
	depends on PM && RTC_ALARM
	--help---
		Number of seconds to wait in PM_SLEEP before going to PM_STANDBY mode.

config PM_SLEEP_WAKEUP_NSEC
	int "PM_SLEEP delay (nanoseconds)"
	default 0
	depends on PM && RTC_ALARM
	--help---
		Number of additional nanoseconds to wait in PM_SLEEP before going to PM_STANDBY mode.
```
