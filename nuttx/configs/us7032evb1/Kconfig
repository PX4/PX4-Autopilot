## nuttx/drivers/usbhost/Kconfig
```kconfig
#
# For a description of the syntax of this configuration file,
# see misc/tools/kconfig-language.txt.
#

config USBHOST_NPREALLOC
	int "Number of pre-allocated class instances"
	default 4
	---help---
		Number of pre-allocated class instances

config USBHOST_BULK_DISABLE
	bool "Disable bulk endpoint support"
	default n
	---help---
		On some architectures, selecting this setting will reduce driver size
		by disabling bulk endpoint support

config USBHOST_INT_DISABLE
	bool "Disable interrupt endpoint support"
	default n
	---help---
		On some architectures, selecting this setting will reduce driver size
		by disabling interrupt endpoint support

config USBHOST_ISOC_DISABLE
	bool "Disable isochronous endpoint support"
	default n
	---help---
		On some architectures, selecting this setting will reduce driver size
		by disabling isochronous endpoint support

config USBHOST_MSC
	bool "Mass Storage Class Support"
	default n
	depends on !BULK_DISABLE
	---help---
		Enable support for the keyboard class driver.  This also depends on
		NFILE_DESCRIPTORS > 0 && SCHED_WORKQUEUE=y

config USBHOST_HIDKBD
	bool "HID Keyboard Class Support"
	default n
	depends on !INT_DISABLE
	---help---
		Enable support for the keyboard class driver.  This also depends on
		SCHED_WORKQUEUE && !DISABLE_SIGNALS

if  USBHOST_HIDKBD
config HIDKBD_POLLUSEC
	int "Keyboard Poll Rate (MSEC)"
	default 100000
	---help---
		Device poll rate in microseconds. Default: 100,000 microseconds.

config HIDKBD_DEFPRIO
	int "Polling Thread Priority"
	default 50
	---help---
		Priority of the polling thread.  Default: 50.

config HIDKBD_STACKSIZE
	int "Polling thread stack size"
	default 1024
	---help---
		Stack size for polling thread.  Default: 1024

config HIDKBD_BUFSIZE
	int "Scancode Buffer Size"
	default 64
	---help---
		Scancode buffer size.  Default: 64.

config HIDKBD_NPOLLWAITERS
	int "Max Number of Waiters for Poll Event"
	default 2
	depends on !DISABLE_POLL
	---help---
		If the poll() method is enabled, this defines the maximum number
		of threads that can be waiting for keyboard events.  Default: 2.

config HIDKBD_RAWSCANCODES
	bool "Use Raw Scan Codes"
	default n
	---help---
		If set to y no conversions will be made on the raw keyboard scan
		codes.  This option is useful during testing. Default: ASCII conversion.

config HIDKBD_ENCODED
	bool "Enocode Special Keys"
	default n
	depends on !HIDKBD_RAWSCANCODES && LIB_KBDCODEC
	---help---
		Encode special key press events in the user buffer.  In this case,
		the user end must decode the encoded special key values using the
		interfaces defined in include/nuttx/input/kbd_codec.h.  These
		special keys include such things as up/down arrows, home and end
		keys, etc.  If this not defined, only 7-bit print-able and control
		ASCII characters will be provided to the user.

config HIDKBD_ALLSCANCODES
	bool "Use All Scancodes"
	default n
	---help---
		If set to y all 231 possible scancodes will be converted to
		something.  Default:  104 key US keyboard.

config HIDKBD_NODEBOUNCE
	bool "Disable Debounce"
	default n
	---help---
		If set to y normal debouncing is disabled.  Default: 
		Debounce enabled (No repeat keys).
endif
```

## nuttx/fs/Kconfig
```kconfig
#
# For a description of the syntax of this configuration file,
# see misc/tools/kconfig-language.txt.
#

comment "File system configuration"

config DISABLE_MOUNTPOINT
	bool "Disable support for mount points"
	default n

source fs/mmap/Kconfig
source fs/fat/Kconfig
source fs/nfs/Kconfig
source fs/nxffs/Kconfig
source fs/romfs/Kconfig
source fs/binfs/Kconfig

comment "System Logging"

config SYSLOG_ENABLE
	bool "Enable SYSLOG Controls"
	default n
	---help---
		Support an interface called syslog_enable to dynamically enable or
		disable SYSLOG output.  Default:  SYSLOG output is always enabled.

config SYSLOG
	bool "Advanced SYSLOG features"
	default n
	---help---
		Enables generic system logging features.  NOTE: This setting is not
		required to enable system logging.  If this feature is not enable
		system logging will still be available and will log to the system
		console (like printf()).  This setting is required to enable
		customization of the basic system loggin capability.

if SYSLOG

config SYSLOG_CHAR
	bool "System log character device support"
	default y
	---help---
		Enable the generic character device for the SYSLOG. The full path to the
		SYSLOG device is provided by SYSLOG_DEVPATH. A valid character device (or
		file) must exist at this path.  It will by opened by syslog_initialize.

		Do not enable more than one SYSLOG device.

config SYSLOG_DEVPATH
	string "System log device"
	default "/dev/syslog"
	depends on SYSLOG_CHAR
	---help---
		The full path to the system logging device.  For the RAMLOG SYSLOG device,
		this is normally "/dev/ramlog".  For character SYSLOG devices, it should be
		some other existing character device (or file) supported by the configuration
		(such as "/dev/ttyS1")/

endif
```

## nuttx/fs/binfs/Kconfig
```kconfig
#
# For a description of the syntax of this configuration file,
# see misc/tools/kconfig-language.txt.
#

config FS_BINFS
	bool "BINFS File System"
	default n
	depends on BUILTIN
	---help---
		The BINFS file system is provides access to builtin applications through
		the NuttX file system.  The BINFS may, for example, be mount at /bin.
		Then all of the built-in applications will appear as executable files in
		/bin.  Then, for example, you list them from NSH like:

		nsh> ls -l /bin

		If the BINFS BINFMT loader is also enabled, then the builtin applications
		can be executed through the normal mechanisms (posix_spawn(), exev(), etc.)
```

## nuttx/fs/fat/Kconfig
```kconfig
#
# For a description of the syntax of this configuration file,
# see misc/tools/kconfig-language.txt.
#

config FS_FAT
	bool "FAT file system"
	default n
	depends on !DISABLE_MOUNTPOINT
	---help---
		Enable FAT filesystem support

if FS_FAT
config FAT_LCNAMES
	bool "FAT upper/lower names"
	default n
	---help---
		Enable use of the NT-style upper/lower case 8.3
		file name support.

config FAT_LFN
	bool "FAT long file names"
	default n
	---help---
		Enable FAT long file names.  NOTE:  Microsoft claims
		patents on FAT long file name technology.  Please read the
		disclaimer in the top-level COPYING file and only enable this
		feature if you understand these issues.

config FAT_MAXFNAME
	int "FAT maximum file name size"
	depends on FAT_LFN
	---help---
		If CONFIG_FAT_LFN is defined, then the default, maximum long file
		name is 255 bytes.  This can eat up a lot of memory (especially stack
		space).  If you are willing to live with some non-standard, short long
		file names, then define this value to be something more reasonable.  A
		good choice would be the same value as selected for NAME_MAX which will
		limit the visibility of longer file names anyway.

config FS_FATTIME
	bool "FAT timestamps"
	default n
	---help---
		Support FAT date and time. NOTE:  There is not
		much sense in supporting FAT date and time unless you have a
		hardware RTC or other way to get the time and date.

config FAT_DMAMEMORY
	bool "DMA memory allocator"
	default n
	---help---
		The FAT file system allocates two I/O buffers for data transfer, each
		are the size of one device sector.  One of the buffers is allocated
		once for each FAT volume that is mounted; the other buffers are
		allocated each time a FAT file is opened.

		Some hardware, however, may require special DMA-capable memory in
		order to perform the the transfers.  If FAT_DMAMEMORY is defined
		then the architecture-specific hardware must provide the funtions
		fat_dma_alloc() and fat_dma_free():  fat_dmalloc() will allocate
		DMA-capable memory of the specified size; fat_dmafree() is the
		corresponding function that will be called to free the DMA-capable
		memory.

endif
```

## nuttx/fs/mmap/Kconfig
```kconfig
#
# For a description of the syntax of this configuration file,
# see misc/tools/kconfig-language.txt.
#

config FS_RAMMAP
	bool "File mapping emulation"
	default n
	---help---
		NuttX operates in a flat open address space and is focused on MCUs that do
		support Memory Management Units (MMUs).  Therefore, NuttX generally does not
		require mmap() functionality and the MCUs generally cannot support true
		memory-mapped files.

		However, memory mapping of files is the mechanism used by NXFLAT, the NuttX
		tiny binary format, to get files into memory in order to execute them.
		mmap() support is therefore required to support NXFLAT.

		If FS_RAMMAP is defined in the configuration, then mmap() will
		support simulation of memory mapped files by copying files whole
		into RAM.  These copied files have some of the properties of
		standard memory mapped files.

		See nuttx/fs/mmap/README.txt for additonal information.

if FS_RAMMAP
endif
```

## nuttx/fs/nfs/Kconfig
```kconfig
#
# For a description of the syntax of this configuration file,
# see misc/tools/kconfig-language.txt.
#

config NFS
	bool "NFS client file system"
	default n
	depends on NET && !DISABLE_MOUNTPOINT
	---help---
		Enable network file system (NFS) client file system

#if NFS

config NFS_STATISTICS
	bool "NFS Stastics"
	default n
	depends on NFS
	---help---
		Collect support for NFS statistics.  There is no user interface to
		obtain these statistics, however.  So they would only be of value
		if you add debug instrumentation or use a debugger.

#endif
```

## nuttx/fs/nxffs/Kconfig
```kconfig
#
# For a description of the syntax of this configuration file,
# see misc/tools/kconfig-language.txt.
#

config FS_NXFFS
	bool "NXFFS file system"
	default n
	depends on !DISABLE_MOUNTPOINT
	---help---
		Enable NuttX FLASH file system (NXFF) support.

if FS_NXFFS
config NXFFS_ERASEDSTATE
	hex "FLASH erased state"
	default 0xff
	---help---	
		The erased state of FLASH. 
		This must have one of the values of 0xff or 0x00.
		Default: 0xff.

config NXFFS_PACKTHRESHOLD
	int "Re-packing threshold"
	default 32
	---help---
		When packing flash file data,
		don't both with file chunks smaller than this number of data bytes.
		Default: 32.

config NXFFS_MAXNAMLEN
	int "Maximum file name length"
	default 255
	---help---	
		The maximum size of an NXFFS file name.
		Default: 255.

config NXFFS_TAILTHRESHOLD
	int "Tail threshold"
	default 8192
	---help---	
		clean-up can either mean
		packing files together toward the end of the file or, if file are
		deleted at the end of the file, clean up can simply mean erasing
		the end of FLASH memory so that it can be re-used again.  However,
		doing this can also harm the life of the FLASH part because it can
		mean that the tail end of the FLASH is re-used too often. This
		threshold determines if/when it is worth erased the tail end of FLASH
		and making it available for re-use (and possible over-wear).
		Default: 8192.

endif
```
