## nuttx/drivers/mmcsd/Kconfig
```kconfig
#
# For a description of the syntax of this configuration file,
# see misc/tools/kconfig-language.txt.
#

config MMCSD_NSLOTS
	int "Number of MMC/SD slots"
	default 1
	---help---
		Number of MMC/SD slots supported by the
		driver. Default is one.

config MMCSD_READONLY
	bool "Disable MMC/SD write access"
	default n
	---help---
		Provide read-only access.  Default is
		Read/Write

config MMCSD_MULTIBLOCK_DISABLE
	bool "Disable MMC/SD multiblock transfer"
	default n
	---help---
		Use only the single block transfer method.
		This setting is used to work around buggy SDIO drivers that cannot handle
		multiple block transfers.

config MMCSD_MMCSUPPORT
	bool "MMC cards support"
	default y
	---help---
		Enable support for MMC cards

config MMCSD_HAVECARDDETECT
	bool "MMC/SD card detection"
	default y
	---help---
		SDIO driver card detection is
		100% accurate

config MMCSD_SPI
	bool "MMC/SD SPI transfer support"
	default y
	depends on SPI

config MMCSD_SPICLOCK
	int "MMC/SD maximum SPI clock"
	default 20000000
	depends on MMCSD_SPI
	---help---
		Maximum SPI clock to drive MMC/SD card.
		Default is 20MHz.

config MMCSD_SDIO
	bool "MMC/SD sdio transfer support"
	default n

if MMCSD_SDIO
config SDIO_DMA
	bool "SDIO dma support"
	default n
	---help---
		SDIO driver supports DMA

config SDIO_MUXBUS
	bool "SDIO bus share support"
	default n
	---help---
		Set this SDIO interface if the SDIO interface
		or hardware resources are shared with other drivers.

config SDIO_WIDTH_D1_ONLY
	bool "SDIO 1-bit transfer"
	default n
	---help---
		Select 1-bit transfer mode.  Default:
		4-bit transfer mode.
endif
		
```

## nuttx/drivers/mtd/Kconfig
```kconfig
#
# For a description of the syntax of this configuration file,
# see misc/tools/kconfig-language.txt.
#
config MTD_AT24XX
	bool "I2C-based AT24XX eeprom"
	default n
	select I2C

config AT24XX_SIZE
	int "at24xx size(kByte)"
	default 64
	depends on MTD_AT24XX

config AT24XX_ADDR
	hex "at24xx i2c address"
	default 0x50
	depends on MTD_AT24XX
		
config MTD_AT45DB
	bool "SPI-based AT45DB flash"
	default n
	select SPI
	
config AT45DB_FREQUENCY
	int "at45db frequency"
	default 1000000
	depends on MTD_AT45DB
	
config AT45DB_PREWAIT
	bool "enables higher performance write logic"
	default y
	depends on MTD_AT45DB

config AT45DB_PWRSAVE
	bool "enables power save"
	default n
	depends on MTD_AT45DB

config MTD_MP25P
	bool "SPI-based M25P FLASH"
	default n
	select SPI

config MP25P_SPIMODE
	int "MP25P SPI mode"
	default 0
	depends on MTD_MP25P

config MP25P_MANUFACTURER
	hex "MP25P manufacturers ID"
	default 0x20
	depends on MTD_MP25P
	---help---
		Various manufacturers may have produced the parts.  0x20 is the manufacturer ID
		for the STMicro MP25x serial FLASH.  If, for example, you are using the a Macronix
		International MX25 serial FLASH, the correct manufacturer ID would be 0xc2.

config MTD_RAMTRON
	bool "SPI-based RAMTRON NVRAM Devices FM25V10"
	default n
	select SPI
	---help---
		SPI-based RAMTRON NVRAM Devices FM25V10

config MTD_RAM
	bool "Memory bus ram"
	default n

config MTD_SST25
	bool "SPI-based SST25 FLASH"
	default n
	select SPI

config SST25_SPIMODE
	int "SST25 SPI Mode"
	default 0
	depends on MTD_SST25

config SST25_SPIFREQUENCY
	int "SST25 SPI Frequency"
	default 20000000
	depends on MTD_SST25

config SST25_READONLY
	bool "SST25 Read-Only FLASH"
	default n
	depends on MTD_SST25

config SST25_SECTOR512
	bool "Simulate 512 byte Erase Blocks"
	default n
	depends on MTD_SST25

config SST25_SLOWWRITE
	bool
	default y
	depends on MTD_SST25

config SST25_SLOWREAD
	bool
	default n
	depends on MTD_SST25

config MTD_W25
	bool "SPI-based W25 FLASH"
	default n
	select SPI

config W25_SPIMODE
	int "W25 SPI Mode"
	default 0
	depends on MTD_W25

config W25_SPIFREQUENCY
	int "W25 SPI Frequency"
	default 20000000
	depends on MTD_W25

config W25_READONLY
	bool "W25 Read-Only FLASH"
	default n
	depends on MTD_W25

config W25_SECTOR512
	bool "Simulate 512 byte Erase Blocks"
	default n
	depends on MTD_W25

config W25_SLOWREAD
	bool
	default n
	depends on MTD_W25
```

## nuttx/drivers/net/Kconfig
```kconfig
#
# For a description of the syntax of this configuration file,
# see misc/tools/kconfig-language.txt.
#
config NET_DM90x0
	bool "Davicom dm9000/dm9010 support"
	default n
	---help---
		References: Davicom data sheets (DM9000-DS-F03-041906.pdf,
		DM9010-DS-F01-103006.pdf) and looking at lots of other DM90x0
		drivers.

config NET_CS89x0
	bool "CS89x0 support"
	default n
	depends on EXPERIMENTAL
	---help---
	Under construction -- do not use
	
config ENC28J60
	bool "Microchip ENC28J60 support"
	default n
	select SPI
	---help---
		References:
		ENC28J60 Data Sheet, Stand-Alone Ethernet Controller with SPI Interface,
		DS39662C, 2008 Microchip Technology Inc.

if ENC28J60
config ENC28J60_NINTERFACES
	int "Number of physical ENC28J60"
	default 1
	range 1,1
	---help---
		Specifies the number of physical ENC28J60
		devices that will be supported.

config ENC28J60_SPIMODE
	int "SPI mode"
	default 0
	---help---
		Controls the SPI mode.  The ENC28J60 spec says that it supports SPI
		mode 0,0 only: "The implementation used on this device supports SPI
		mode 0,0 only. In addition, the SPI port requires that SCK be at Idle
		in a low state; selectable clock polarity is not supported."
		However, sometimes you need to tinker with these things.

config ENC28J60_FREQUENCY
	int "SPI frequency"
	default 20000000
	---help---
		Define to use a different bus frequency

config ENC28J60_STATS
	bool "Network statistics support"
	default n
	---help---
		Collect network statistics

config ENC28J60_HALFDUPPLEX
	bool "Enable half dupplex"
	default n
	---help---
		Default is full duplex

config ENC28J60_DUMPPACKET
	bool "Dump Packets"
	default n
	---help---
		If selected, the ENC28J60 driver  will dump the contents of each
		packet to the console.

config ENC28J60_REGDEBUG
	bool "Register-Level Debug"
	default n
	depends on DEBUG && DEBUG_NET
	---help---
		Enable very low-level register access debug.  Depends on DEBUG and DEBUG_NET.

endif

config NET_E1000
	bool "E1000 support"
	default n

config NET_SLIP
	bool "SLIP (serial line) support"
	default n
	---help---	
		Reference: RFC 1055

config NET_VNET
	bool "VNET support"
	default n
```

## nuttx/drivers/power/Kconfig
```kconfig
#
# For a description of the syntax of this configuration file,
# see misc/tools/kconfig-language.txt.
#
config BATTERY
	bool "Battery support"
	default n
	
config MAX1704X
	bool "MAX1704X Battery charger support"
	default n
	select I2C
	select I2C_MAX1704X
	depends on BATTERY
	---help---
		The MAX17040/MAX17041 are ultra-compact, low-cost, host-side fuel-gauge
		systems for lithium-ion (Li+) batteries in handheld and portable equipment.
		The MAX17040 is configured to operate with a single lithium cell and the
		MAX17041 is configured for a dual-cell 2S pack.

config I2C_MAX1704X
	bool
	default y if MAX1704X
```

## nuttx/drivers/sensors/Kconfig
```kconfig
#
# For a description of the syntax of this configuration file,
# see misc/tools/kconfig-language.txt.
#
config LIS331DL
	bool "ST LIS331DL device support"
	default n
	select I2C
	
config I2C_LM75
	bool
	default y if LM75

config LM75
	bool "STMicro LM-75 Temperature Sensor support"
	default n
	select I2C
	select I2C_LM75

config DEBUG_LM75
	bool "Enable LM-75 debug"
	default n
	depends on LM75
	
config QENCODER
	bool "Qencoder"
	default n

config DEBUG_QENCODER
	bool "Enable Qencoder Debug"
	default n
	depends on QENCODER
	
```
