## nuttx/drivers/input/Kconfig
```kconfig
#
# For a description of the syntax of this configuration file,
# see misc/tools/kconfig-language.txt.
#

config INPUT_TSC2007
	bool "TI TSC2007 touchscreen controller"
	default n
	select I2C
	---help---
		Enable support for the TI TSC2007 touchscreen controller

if INPUT_TSC2007

config TSC2007_8BIT
	bool "8-bit Conversions"
	default n
	---help---
		Use faster, but less accurate, 8-bit conversions.  Default: 12-bit conversions.

config TSC2007_MULTIPLE
	bool "Multiple TSC2007 Devices"
	default n
	---help---
		Can be defined to support multiple TSC2007 devices on board.

config TSC2007_NPOLLWAITERS
	int "Number poll waiters"
	default 4
	depends on !DISABLE_POLL
	---help---
		Maximum number of threads that can be waiting on poll()

endif

config INPUT_ADS7843E
	bool "TI ADS7843/TSC2046 touchscreen controller"
	default n
	select SPI
	---help---
		Enable support for the TI/Burr-Brown ADS7842 touchscreen controller.  I believe
		that driver should be compatibile with the TI/Burr-Brown TSC2046 and XPT2046
		touchscreen controllers as well. 

if INPUT_ADS7843E

config ADS7843E_MULTIPLE
	bool "Multiple ADS7843E Devices"
	default n
	---help---
		Can be defined to support multiple ADS7843E devices on board.

config ADS7843E_NPOLLWAITERS
	int "Number poll waiters"
	default 4
	depends on !DISABLE_POLL
	---help---
		Maximum number of threads that can be waiting on poll()

config ADS7843E_SPIMODE
	int "SPI mode"
	default 0
	range 0,3
	---help---
		Controls the SPI mode.  The device should work in mode 0, but sometimes
		you need to experiment.

config ADS7843E_FREQUENCY
	int "SPI frequency"
	default 100000
	---help---
		Define to use a different SPI bus frequency.

config ADS7843E_SWAPXY
	bool "Swap X/Y"
	default n
	---help---
		Reverse the meaning of X and Y to handle different LCD orientations.

config ADS7843E_THRESHX
	int "X threshold"
	default 12
	---help---
		New touch positions will only be reported when the X or Y data changes by these
		thresholds. This trades reduces data rate for some loss in dragging accuracy.  For
		12-bit values so the raw ranges are 0-4095. So for example, if your display is
		320x240, then THRESHX=13 and THRESHY=17 would correspond to one pixel.  Default: 12
 
config ADS7843E_THRESHY
	int "Y threshold"
	default 12
	---help---
		New touch positions will only be reported when the X or Y data changes by these
		thresholds. This trades reduces data rate for some loss in dragging accuracy.  For
		12-bit values so the raw ranges are 0-4095. So for example, if your display is
		320x240, then THRESHX=13 and THRESHY=17 would correspond to one pixel.  Default: 12

endif

config INPUT_STMPE811
	bool "STMicro STMPE811 Driver"
	default n
	---help---
		Enables support for the STMPE811 driver 

if INPUT_STMPE811

choice
	prompt "STMPE Interface"
	default STMPE811_I2C

config STMPE811_SPI
	bool "SPI Interface"
	select SPI
	---help---
		Enables support for the SPI interface (not currently supported)

config STMPE811_I2C
	bool "STMPE811 I2C Interface"
	select I2C
	---help---
		Enables support for the I2C interface

endchoice

config STMPE811_ACTIVELOW
	bool "Active Low Interrupt"
	default n
	---help---
		The STMPE811 interrupt is provided by a discrete input (usually a
		GPIO interrupt on most MCU architectures).  This setting determines
		whether the interrupt is active high (or rising edge triggered) or
		active low (or falling edge triggered).  Default:  Active
		high/rising edge.

config STMPE811_EDGE
	bool "Edge triggered Interrupt"
	default n
	---help---
		The STMPE811 interrupt is provided by a discrete input (usually a
		GPIO interrupt on most MCU architectures).  This setting determines
		whether the interrupt is edge or level triggered.  Default: Level
		triggered.

config STMPE811_MULTIPLE
	bool "Multiple STMPE811 Devices"
	default n
	---help---
		Can be defined to support multiple STMPE811 devices on board.

config STMPE811_NPOLLWAITERS
	int "Number poll waiters"
	default 4
	depends on !DISABLE_POLL
	---help---
		Maximum number of threads that can be waiting on poll()

config STMPE811_TSC_DISABLE
	bool "Disable STMPE811 Touchscreen Support"
	default n
	---help---
		Disable driver touchscreen functionality.

config STMPE811_SWAPXY
	bool "Swap X/Y"
	default n
	depends on !STMPE811_TSC_DISABLE
	---help---
		Reverse the meaning of X and Y to handle different LCD orientations.

config STMPE811_THRESHX
	int "X threshold"
	default 12
	depends on !STMPE811_TSC_DISABLE
	---help---
		STMPE811 touchscreen data comes in a a very high rate.  New touch positions
		will only be reported when the X or Y data changes by these thresholds.
		This trades reduces data rate for some loss in dragging accuracy.  The
		STMPE811 is configure for 12-bit values so the raw ranges are 0-4095. So
		for example, if your display is 320x240, then THRESHX=13 and THRESHY=17
		would correspond to one pixel.  Default: 12
 
config STMPE811_THRESHY
	int "Y threshold"
	default 12
	depends on !STMPE811_TSC_DISABLE
	---help---
		STMPE811 touchscreen data comes in a a very high rate.  New touch positions
		will only be reported when the X or Y data changes by these thresholds.
		This trades reduces data rate for some loss in dragging accuracy.  The
		STMPE811 is configure for 12-bit values so the raw ranges are 0-4095. So
		for example, if your display is 320x240, then THRESHX=13 and THRESHY=17
		would correspond to one pixel.  Default: 12

config STMPE811_ADC_DISABLE
	bool "Disable STMPE811 ADC Support"
	default y
	---help---
		Disable driver ADC functionality.

config STMPE811_GPIO_DISABLE
	bool "Disable STMPE811 GPIO Support"
	default y
	---help---
		Disable driver GPIO functionality.

config STMPE811_GPIOINT_DISABLE
	bool "Disable STMPE811 GPIO Interrupt Support"
	default y
	depends on !STMPE811_GPIO_DISABLE
	---help---
		Disable driver GPIO interrupt functionlality (ignored if GPIO functionality is
		disabled).

config STMPE811_TEMP_DISABLE
	bool "Disable STMPE811 Temperature Sensor Support"
	default y
	---help---
		Disable driver temperature sensor functionality.

config STMPE811_REGDEBUG
	bool "Enable Register-Level STMPE811 Debug"
	default n
	depends on DEBUG
	---help---
		Enable very low register-level debug output.

endif
```

## nuttx/drivers/lcd/Kconfig
```kconfig
#
# For a description of the syntax of this configuration file,
# see misc/tools/kconfig-language.txt.
#

config LCD_NOGETRUN
	bool "Write-only LCD"
	default n
	---help---
		Many LCD hardware interfaces provide only minimal graphics capability.  In
		particulary, many simple LCD interfaces are write only.  That is we, can
		write graphics data to the LCD device memory, but we cannot read it back.
		If the LCD hardware does not support reading the graphics memory, then
		this option should be defined so that the NX layer can taking alternative
		measures when the LCD is not readable.  For example, if the LCD is not
		readable, then NX will not attempt to support transparency.

		See also NX_WRITEONLY in the graphics support menu.

config LCD_MAXCONTRAST
	int "LCD maximum contrast"
	default 63 if NOKIA6100_S1D15G10
	default 127 if NOKIA6100_PCF8833
	default 255 if LCD_P14201
	default 63
	---help---
		must be 63 with the Epson controller and 127 with
		the Phillips controller.

config LCD_MAXPOWER
	int "LCD maximum power"
	default 1
	---help---
		Maximum value of backlight setting.  The backlight
		control is managed outside of the 6100 driver so this value has no
		meaning to the driver.  Board-specific logic may place restrictions on
		this value.

config LCD_P14201
	bool "Rit P1402 series display"
	default n
	---help---
		p14201.c.  Driver for RiT P14201 series display with SD1329 IC
		controller.  This OLED is used with older versions of the
		TI/Luminary LM3S8962 Evaluation Kit.

if LCD_P14201
config P14201_NINTERFACES
	int "Number of physical P14201 devices"
	default 1
	range 1,1
	---help---
		Specifies the number of physical P14201
		devices that will be supported.

config P14201_SPIMODE
	int "SPI mode"
	default 2
	range 0,3
	---help---
		Controls the SPI mode

config P14201_FREQUENCY
	int "SPI frequency"
	default 1000000
	---help---
		Define to use a different bus frequency,FIXME DEFAULT VALUE OK?

config P14201_FRAMEBUFFER
	bool "Enable P14201 GDDRAM cache"
	default y
	---help---
		If defined, accesses will be performed
		using an in-memory copy of the OLEDs GDDRAM.  This cost of this
		buffer is 128 * 96 / 2 = 6Kb.  If this is defined, then the driver
		will be fully functional. If not, then it will have the following
		limitations:
		
		Reading graphics memory cannot be supported, and
		
		All pixel writes must be aligned to byte boundaries.
		The latter limitation effectively reduces the 128x96 disply to 64x96.
endif

config LCD_NOKIA6100
	bool "Nokia 6100 display support" 
	default n
	---help---
		nokia6100.c.  Supports the Nokia 6100 display with either the Philips
		PCF883 or the Epson S1D15G10 display controller.  This LCD is used
		with the Olimex LPC1766-STK (but has not been fully integrated).
if LCD_NOKIA6100
config NOKIA6100_NINTERFACES
	int "Number of physical NOKIA6100 devices"
	default 1
	range 1,1
	---help---
		Specifies the number of physical Nokia
		6100 devices that will be supported.

choice NOKIA6100_CONTROLLER
	prompt "Controller Setup"
	default NOKIA6100_S1D15G10
config NOKIA6100_S1D15G10
	bool "S1D15G10 controller"
	---help---
		Selects the Epson S1D15G10 display controller

config NOKIA6100_PCF8833
	bool "PCF8833 controller"
	---help---
		Selects the Phillips PCF8833 display controller
endchoice

config NOKIA6100_SPIMODE
	int "SPI mode"
	default 0
	range 0,3
	---help---
		Controls the SPI mode

config NOKIA6100_FREQUENCY
	int "SPI frequency"
	default 1000000
	---help---
		Define to use a different bus frequency

config NOKIA6100_BLINIT
	bool "Back light initial"
	default n
	---help---
		Initial backlight setting
		The following may need to be tuned for your hardware:

config NOKIA6100_BPP
	int "Display bits per pixel"
	default 8
	---help---
		Device supports 8, 12, and 16 bits per pixel.

config NOKIA6100_INVERT
	int "Display inversion"
	default 1
	range 0,1
	---help---
		Display inversion, 0 or 1, Default: 1

config NOKIA6100_MY
	int "Display row direction"
	default 0
	range 0,1
	---help---
		Display row direction, 0 or 1, Default: 0

config NOKIA6100_MX
	int "Display column direction"
	default 1
	range 0,1
	---help---
		Display column direction, 0 or 1, Default: 1

config NOKIA6100_V
	int "Display address direction"
	default 0
	range 0,1
	---help---
		Display address direction, 0 or 1, Default: 0

config NOKIA6100_ML
	int "Display scan direction"
	default 0
	range 0,1
	---help---
		Display scan direction, 0 or 1, Default: 0

config NOKIA6100_RGBORD
	int "Display RGB order"
	default 0
	range 0,1
	---help---
		Display RGB order, 0 or 1, Default: 0
		Required LCD driver settings:
endif

config LCD_UG9664HSWAG01
	bool "UG-9664HSWAG01 OLED Display Module"
	default n
	---help---
		OLED Display Module, UG-9664HSWAG01, Univision Technology Inc.  Used
		with the LPCXpresso and Embedded Artists base board.

		Required LCD driver settings:
		LCD_MAXCONTRAST should be 255, but any value >0 and <=255 will be accepted.
		LCD_MAXPOWER should be 1:  0=off, 1=on

		Required SPI driver settings:
		SPI_CMDDATA - Include support for cmd/data selection.

if LCD_UG9664HSWAG01

config UG9664HSWAG01_SPIMODE
	int "UG-9664HSWAG01 SPI Mode"
	default 0
	---help---
		Controls the SPI mode

config UG9664HSWAG01_FREQUENCY
	int "UG-9664HSWAG01 SPI Frequency"
	default 3500000
	---help---
		Define to use a different bus frequency

config UG9664HSWAG01_NINTERFACES
	int "Number of UG-9664HSWAG01 Devices"
	default 1
	---help---
		Specifies the number of physical UG-9664HSWAG01 devices that will be
		supported.  NOTE:  At present, this must be undefined or defined to be 1.

config UG9664HSWAG01_POWER
	bool "Power control"
	default n
	---help---
		If the hardware supports a controllable OLED a power supply, this
		configuration should be defined.  In this case the system must
		provide an interface ug_power().

endif

config LCD_UG2864AMBAG01
	bool "UG-2864AMBAG01 OLED Display Module"
	default n
	---help---
		OLED Display Module, UG-2864AMBAG01, Univision Technology Inc. 

		Required LCD driver settings:
		LCD_MAXCONTRAST should be 255, but any value >0 and <=255 will be accepted.
		LCD_MAXPOWER should be 1:  0=off, 1=on

		Required SPI driver settings:
		SPI_CMDDATA - Include support for cmd/data selection.

if LCD_UG2864AMBAG01

	config UG2864AMBAG01_SPIMODE
	int "UG-2864AMBAG01 SPI Mode"
	default 3
	---help---
		Controls the SPI mode

config UG2864AMBAG01_FREQUENCY
	int "UG-2864AMBAG01 SPI Frequency"
	default 3500000
	---help---
		Define to use a different bus frequency

config UG2864AMBAG01_NINTERFACES
	int "Number of UG-2864AMBAG01 Devices"
	default 1
	---help---
		Specifies the number of physical UG-9664HSWAG01 devices that will be
		supported.  NOTE:  At present, this must be undefined or defined to be 1.

endif

config LCD_SSD1289
	bool "LCD Based on SSD1289 Controller"
	default n
	---help---
		Enables generic support for any LCD based on the Solomon Systech,
		Ltd, SSD1289 Controller.  Use of this driver will usually require so
		detailed customization of the LCD initialization code as necessary
		for the specific LCD driven by the SSD1289 controller.

if LCD_SSD1289

choice
	prompt "SSD1289 Initialization Profile"
	default SSD1289_PROFILE1

config SSD1289_PROFILE1
	bool "Profile 1"

config SSD1289_PROFILE2
	bool "Profile 2"

config SSD1289_PROFILE3
	bool "Profile 3"

endchoice
endif

choice
	prompt "LCD Orientation"
	default LCD_LANDSCAPE
	depends on LCD
	---help---
		Some LCD drivers may support displays in different orientations.
		If the LCD driver supports this capability, than these are configuration
		options to select that display orientation.

config LCD_LANDSCAPE
	bool "Landscape orientation"
	---help---
		Define for "landscape" orientation support.  Landscape mode refers one
		of two orientations where the the display is wider than it is tall
		(LCD_RLANDSCAPE is the other).  This is the default orientation.

config LCD_PORTRAIT
	bool "Portrait orientation"
	---help---
		Define for "portrait" orientation support.  Portrait mode refers one
		of two orientations where the the display is taller than it is wide
		(LCD_RPORTAIT is the other).

config LCD_RPORTRAIT
	bool "Reverse portrait display"
	---help---
		Define for "reverse portrait" orientation support.  Reverse portrait mode
		refers one of two orientations where the the display is taller than it is
		wide (LCD_PORTAIT is the other).

config LCD_RLANDSCAPE
	bool "Reverse landscape orientation"
	---help---
		Define for "reverse landscape" orientation support.  Reverse landscape mode
		refers one of two orientations where the the display is wider than it is
		tall (LCD_LANDSCAPE is the other).

endchoice
```
