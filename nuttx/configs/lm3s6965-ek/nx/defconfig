## nuttx/configs/px4fmu/nsh/defconfig
```kconfig
############################################################################
# configs/px4fmu/nsh/defconfig
#
#   Copyright (C) 2012 PX4 Development Team. All rights reserved.
#   Copyright (C) 2011-2012 Gregory Nutt. All rights reserved.
#   Author: Gregory Nutt <gnutt@nuttx.org>
#
# Redistribution and use in source and binary forms, with or without
# modification, are permitted provided that the following conditions
# are met:
#
# 1. Redistributions of source code must retain the above copyright
#    notice, this list of conditions and the following disclaimer.
# 2. Redistributions in binary form must reproduce the above copyright
#    notice, this list of conditions and the following disclaimer in
#    the documentation and/or other materials provided with the
#    distribution.
# 3. Neither the name NuttX nor the names of its contributors may be
#    used to endorse or promote products derived from this software
#    without specific prior written permission.
#
# THIS SOFTWARE IS PROVIDED BY THE COPYRIGHT HOLDERS AND CONTRIBUTORS
# "AS IS" AND ANY EXPRESS OR IMPLIED WARRANTIES, INCLUDING, BUT NOT
# LIMITED TO, THE IMPLIED WARRANTIES OF MERCHANTABILITY AND FITNESS
# FOR A PARTICULAR PURPOSE ARE DISCLAIMED. IN NO EVENT SHALL THE
# COPYRIGHT OWNER OR CONTRIBUTORS BE LIABLE FOR ANY DIRECT, INDIRECT,
# INCIDENTAL, SPECIAL, EXEMPLARY, OR CONSEQUENTIAL DAMAGES (INCLUDING,
# BUT NOT LIMITED TO, PROCUREMENT OF SUBSTITUTE GOODS OR SERVICES; LOSS
# OF USE, DATA, OR PROFITS; OR BUSINESS INTERRUPTION) HOWEVER CAUSED
# AND ON ANY THEORY OF LIABILITY, WHETHER IN CONTRACT, STRICT
# LIABILITY, OR TORT (INCLUDING NEGLIGENCE OR OTHERWISE) ARISING IN
# ANY WAY OUT OF THE USE OF THIS SOFTWARE, EVEN IF ADVISED OF THE
# POSSIBILITY OF SUCH DAMAGE.
#
############################################################################
#
# architecture selection
#
# CONFIG_ARCH - identifies the arch subdirectory and, hence, the
#   processor architecture.
# CONFIG_ARCH_family - for use in C code.  This identifies the
#   particular chip family that the architecture is implemented
#   in.
# CONFIG_ARCH_architecture - for use in C code.  This identifies the
#   specific architecture within the chip family.
# CONFIG_ARCH_CHIP - Identifies the arch/*/chip subdirectory
# CONFIG_ARCH_CHIP_name - For use in C code
# CONFIG_ARCH_BOARD - identifies the configs subdirectory and, hence,
#   the board that supports the particular chip or SoC.
# CONFIG_ARCH_BOARD_name - for use in C code
# CONFIG_ENDIAN_BIG - define if big endian (default is little endian)
# CONFIG_BOARD_LOOPSPERMSEC - for delay loops
# CONFIG_DRAM_SIZE - Describes the installed DRAM.
# CONFIG_DRAM_START - The start address of DRAM (physical)
# CONFIG_ARCH_IRQPRIO - The STM3240xxx supports interrupt prioritization
# CONFIG_ARCH_FPU - The STM3240xxx supports a floating point unit (FPU).
# CONFIG_ARCH_INTERRUPTSTACK - This architecture supports an interrupt
#   stack. If defined, this symbol is the size of the interrupt
#   stack in bytes.  If not defined, the user task stacks will be
#   used during interrupt handling.
# CONFIG_ARCH_STACKDUMP - Do stack dumps after assertions
# CONFIG_ARCH_BOOTLOADER - Set if you are using a bootloader.
# CONFIG_ARCH_LEDS -  Use LEDs to show state. Unique to board architecture.
# CONFIG_ARCH_BUTTONS -  Enable support for buttons. Unique to board architecture.
# CONFIG_ARCH_CALIBRATION - Enables some build in instrumentation that
#   cause a 100 second delay during boot-up.  This 100 second delay
#   serves no purpose other than it allows you to calibrate
#   CONFIG_BOARD_LOOPSPERMSEC.  You simply use a stop watch to measure
#   the 100 second delay then adjust CONFIG_BOARD_LOOPSPERMSEC until
#   the delay actually is 100 seconds.
# CONFIG_ARCH_DMA - Support DMA initialization
#
CONFIG_ARCH="arm"
CONFIG_ARCH_ARM=y
CONFIG_ARCH_CORTEXM4=y
CONFIG_ARCH_CHIP="stm32"
CONFIG_ARCH_CHIP_STM32F405RG=y
CONFIG_ARCH_BOARD="px4fmu"
CONFIG_ARCH_BOARD_PX4FMU=y
CONFIG_BOARD_LOOPSPERMSEC=16717
CONFIG_DRAM_SIZE=0x00030000
CONFIG_DRAM_START=0x20000000
CONFIG_ARCH_IRQPRIO=y
CONFIG_ARCH_FPU=y
CONFIG_ARCH_INTERRUPTSTACK=n
CONFIG_ARCH_STACKDUMP=y
CONFIG_ARCH_BOOTLOADER=n
CONFIG_ARCH_LEDS=y
CONFIG_ARCH_BUTTONS=n
CONFIG_ARCH_CALIBRATION=n
CONFIG_ARCH_DMA=y
CONFIG_ARCH_MATH_H=y

CONFIG_ARMV7M_CMNVECTOR=y

#
# JTAG Enable settings (by default JTAG-DP and SW-DP are enabled):
#
#   CONFIG_STM32_DFU - Use the DFU bootloader, not JTAG (ignored)
#
# JTAG Enable options:
#
#   CONFIG_STM32_JTAG_FULL_ENABLE - Enables full SWJ (JTAG-DP + SW-DP)
#   CONFIG_STM32_JTAG_NOJNTRST_ENABLE - Enables full SWJ (JTAG-DP + SW-DP)
#     but without JNTRST.
#   CONFIG_STM32_JTAG_SW_ENABLE - Set JTAG-DP disabled and SW-DP enabled
#
CONFIG_STM32_DFU=n
CONFIG_STM32_JTAG_FULL_ENABLE=y
CONFIG_STM32_JTAG_NOJNTRST_ENABLE=n
CONFIG_STM32_JTAG_SW_ENABLE=n

#
# On-chip CCM SRAM configuration
#
# CONFIG_STM32_CCMEXCLUDE - Exclude CCM SRAM from the HEAP.  You would need
#   to do this if DMA is enabled to prevent non-DMA-able CCM memory from
#   being a part of the stack.
#

#
# On-board FSMC SRAM configuration
#
# CONFIG_STM32_FSMC - Required.  See below
# CONFIG_MM_REGIONS - Required.  Must be 2 or 3 (see above)
#
# CONFIG_STM32_FSMC_SRAM=y - Indicates that SRAM is available via the
#   FSMC (as opposed to an LCD or FLASH).
# CONFIG_HEAP2_BASE - The base address of the SRAM in the FSMC address space
# CONFIG_HEAP2_END - The end (+1) of the SRAM in the FSMC address space
#
#CONFIG_STM32_FSMC_SRAM=n
#CONFIG_HEAP2_BASE=0x64000000
#CONFIG_HEAP2_END=(0x64000000+(2*1024*1024))

#
#  Individual subsystems can be enabled:
#
# This set is exhaustive for PX4FMU and should be safe to cut and
# paste into any other config.
#
# AHB1:
CONFIG_STM32_CRC=n
CONFIG_STM32_BKPSRAM=y
CONFIG_STM32_CCMDATARAM=y
CONFIG_STM32_DMA1=y
CONFIG_STM32_DMA2=y
CONFIG_STM32_ETHMAC=n
CONFIG_STM32_OTGHS=n
# AHB2:
CONFIG_STM32_DCMI=n
CONFIG_STM32_CRYP=n
CONFIG_STM32_HASH=n
CONFIG_STM32_RNG=n
CONFIG_STM32_OTGFS=y
# AHB3:
CONFIG_STM32_FSMC=n
# APB1:
# TIM2 is owned by PWM output
CONFIG_STM32_TIM2=n
# TIM3 is owned by TONE_ALARM
CONFIG_STM32_TIM3=n
CONFIG_STM32_TIM4=y
CONFIG_STM32_TIM5=y
CONFIG_STM32_TIM6=y
CONFIG_STM32_TIM7=y
CONFIG_STM32_TIM12=y
CONFIG_STM32_TIM13=y
CONFIG_STM32_TIM14=y
CONFIG_STM32_WWDG=y
CONFIG_STM32_IWDG=n
CONFIG_STM32_SPI2=n
CONFIG_STM32_SPI3=y
CONFIG_STM32_USART2=y
CONFIG_STM32_USART3=n
CONFIG_STM32_UART4=n
CONFIG_STM32_UART5=y
CONFIG_STM32_I2C1=y
CONFIG_STM32_I2C2=y
CONFIG_STM32_I2C3=y
CONFIG_STM32_CAN1=n
CONFIG_STM32_CAN2=n
CONFIG_STM32_DAC=n
CONFIG_STM32_PWR=y
# APB2:
# TIM1 is owned by the HRT
CONFIG_STM32_TIM1=n
# TIM8 is owned by PWM output
CONFIG_STM32_TIM8=n
CONFIG_STM32_USART1=y
CONFIG_STM32_USART6=y
# We use our own driver, but leave this on.
CONFIG_STM32_ADC1=y
CONFIG_STM32_ADC2=n
CONFIG_STM32_ADC3=n
CONFIG_STM32_SDIO=n
CONFIG_STM32_SPI1=y
CONFIG_STM32_SYSCFG=y
CONFIG_STM32_TIM9=y
CONFIG_STM32_TIM10=y
CONFIG_STM32_TIM11=y

#
# Enable single wire support.  If this is not defined, then this mode cannot
# be enabled.
#
CONFIG_STM32_USART_SINGLEWIRE=y

#
# We want the flash prefetch on for max performance.
#
STM32_FLASH_PREFETCH=y

#
# Enable the MTD driver for the onboard I2C EEPROM
#
# Note that we are using a private copy of the AT24XX driver that
# does not require CONFIG_MTD_XT24XX to be set.
#
#CONFIG_MTD_AT24XX=y
CONFIG_AT24XX_ADDR=0x50
CONFIG_AT24XX_SIZE=128
CONFIG_AT24XX_MTD_BLOCKSIZE=256

#
# STM32F40xxx specific serial device driver settings
#
# CONFIG_SERIAL_TERMIOS - Serial driver supports termios.h interfaces (tcsetattr,
#   tcflush, etc.).  If this is not defined, then the terminal settings (baud,
#   parity, etc.) are not configurable at runtime; serial streams cannot be
#   flushed, etc.
# CONFIG_SERIAL_CONSOLE_REINIT - re-initializes the console serial port
#   immediately after creating the /dev/console device.  This is required
#   if the console serial port has RX DMA enabled.
#
# CONFIG_USARTn_SERIAL_CONSOLE - selects the USARTn for the
#   console and ttys0 (default is the USART1).
# CONFIG_USARTn_RXBUFSIZE - Characters are buffered as received.
#   This specific the size of the receive buffer
# CONFIG_USARTn_TXBUFSIZE - Characters are buffered before
#   being sent.  This specific the size of the transmit buffer
# CONFIG_USARTn_BAUD - The configure BAUD of the UART.  Must be
# CONFIG_USARTn_BITS - The number of bits.  Must be either 7 or 8.
# CONFIG_USARTn_PARTIY - 0=no parity, 1=odd parity, 2=even parity
# CONFIG_USARTn_2STOP - Two stop bits
#
CONFIG_SERIAL_TERMIOS=y
CONFIG_SERIAL_CONSOLE_REINIT=y
CONFIG_STANDARD_SERIAL=y

CONFIG_USART1_SERIAL_CONSOLE=y
CONFIG_USART2_SERIAL_CONSOLE=n
CONFIG_USART3_SERIAL_CONSOLE=n
CONFIG_UART4_SERIAL_CONSOLE=n
CONFIG_UART5_SERIAL_CONSOLE=n
CONFIG_USART6_SERIAL_CONSOLE=n

#Mavlink messages can be bigger than 128
CONFIG_USART1_TXBUFSIZE=512
CONFIG_USART2_TXBUFSIZE=256
CONFIG_USART3_TXBUFSIZE=256
CONFIG_UART4_TXBUFSIZE=256
CONFIG_UART5_TXBUFSIZE=256
CONFIG_USART6_TXBUFSIZE=128

CONFIG_USART1_RXBUFSIZE=512
CONFIG_USART2_RXBUFSIZE=256
CONFIG_USART3_RXBUFSIZE=256
CONFIG_UART4_RXBUFSIZE=256
CONFIG_UART5_RXBUFSIZE=256
CONFIG_USART6_RXBUFSIZE=256

CONFIG_USART1_BAUD=57600
CONFIG_USART2_BAUD=115200
CONFIG_USART3_BAUD=115200
CONFIG_UART4_BAUD=115200
CONFIG_UART5_BAUD=115200
CONFIG_USART6_BAUD=9600

CONFIG_USART1_BITS=8
CONFIG_USART2_BITS=8
CONFIG_USART3_BITS=8
CONFIG_UART4_BITS=8
CONFIG_UART5_BITS=8
CONFIG_USART6_BITS=8

CONFIG_USART1_PARITY=0
CONFIG_USART2_PARITY=0
CONFIG_USART3_PARITY=0
CONFIG_UART4_PARITY=0
CONFIG_UART5_PARITY=0
CONFIG_USART6_PARITY=0

CONFIG_USART1_2STOP=0
CONFIG_USART2_2STOP=0
CONFIG_USART3_2STOP=0
CONFIG_UART4_2STOP=0
CONFIG_UART5_2STOP=0
CONFIG_USART6_2STOP=0

CONFIG_USART1_RXDMA=y
SERIAL_HAVE_CONSOLE_DMA=y
CONFIG_USART2_RXDMA=y
CONFIG_USART3_RXDMA=n
CONFIG_UART4_RXDMA=n
CONFIG_UART5_RXDMA=y
CONFIG_USART6_RXDMA=y

#
# PX4FMU specific driver settings
#
# CONFIG_HRT_TIMER
#   Enables the high-resolution timer.  The board definition must
#   set HRT_TIMER and HRT_TIMER_CHANNEL to the timer and capture/
#   compare channels to be used.
# CONFIG_HRT_PPM
#   Enables R/C PPM input using the HRT.  The board definition must
#   set HRT_PPM_CHANNEL to the timer capture/compare channel to be
#   used, and define GPIO_PPM_IN to configure the appropriate timer
#   GPIO.
#
CONFIG_HRT_TIMER=y
CONFIG_HRT_PPM=y

#
# STM32F40xxx specific SPI device driver settings
#
CONFIG_SPI_EXCHANGE=y
# DMA needs more work, not implemented on STM32F4x yet
#CONFIG_STM32_SPI_DMA=y

#
# STM32F40xxx specific CAN device driver settings
#
# CONFIG_CAN - Enables CAN support (one or both of CONFIG_STM32_CAN1 or
#   CONFIG_STM32_CAN2 must also be defined)
# CONFIG_CAN_EXTID - Enables support for the 29-bit extended ID.  Default
#   Standard 11-bit IDs.
# CONFIG_CAN_FIFOSIZE - The size of the circular buffer of CAN messages.
#   Default: 8
# CONFIG_CAN_NPENDINGRTR - The size of the list of pending RTR requests.
#   Default: 4
# CONFIG_CAN_LOOPBACK - A CAN driver may or may not support a loopback
#   mode for testing. The STM32 CAN driver does support loopback mode.
# CONFIG_CAN1_BAUD - CAN1 BAUD rate.  Required if CONFIG_STM32_CAN1 is defined.
# CONFIG_CAN2_BAUD - CAN1 BAUD rate.  Required if CONFIG_STM32_CAN2 is defined.
# CONFIG_CAN_TSEG1 - The number of CAN time quanta in segment 1. Default: 6
# CONFIG_CAN_TSEG2 - the number of CAN time quanta in segment 2. Default: 7
#
CONFIG_CAN=n
CONFIG_CAN_EXTID=n
#CONFIG_CAN_FIFOSIZE
#CONFIG_CAN_NPENDINGRTR
CONFIG_CAN_LOOPBACK=n
CONFIG_CAN1_BAUD=700000
CONFIG_CAN2_BAUD=700000


# XXX remove after integration testing
# Allow 180 us per byte, a wide margin for the 400 KHz clock we're using
# e.g. 9.6 ms for an EEPROM page write, 0.9 ms for a MAG update
CONFIG_STM32_I2CTIMEOUS_PER_BYTE=200
# Constant overhead for generating I2C start / stop conditions
CONFIG_STM32_I2CTIMEOUS_START_STOP=700
# XXX this is bad and we want it gone
CONFIG_I2C_WRITEREAD=y

#
# I2C configuration
#
CONFIG_I2C=y
CONFIG_I2C_POLLED=n
CONFIG_I2C_TRANSFER=y
CONFIG_I2C_TRACE=n
CONFIG_I2C_RESET=y
# XXX fixed per-transaction timeout
CONFIG_STM32_I2CTIMEOMS=10


# XXX re-enable after integration testing

#
# I2C configuration
#
#CONFIG_I2C=y
#CONFIG_I2C_POLLED=y
#CONFIG_I2C_TRANSFER=y
#CONFIG_I2C_TRACE=n
#CONFIG_I2C_RESET=y

# Dynamic timeout
#CONFIG_STM32_I2C_DYNTIMEO=y
#CONFIG_STM32_I2C_DYNTIMEO_STARTSTOP=500
#CONFIG_STM32_I2C_DYNTIMEO_USECPERBYTE=200

# Fixed per-transaction timeout
#CONFIG_STM32_I2CTIMEOSEC=0
#CONFIG_STM32_I2CTIMEOMS=10






#
# General build options
#
# CONFIG_RRLOAD_BINARY - make the rrload binary format used with
#   BSPs from www.ridgerun.com using the tools/mkimage.sh script
# CONFIG_INTELHEX_BINARY - make the Intel HEX binary format
#   used with many different loaders using the GNU objcopy program
#   Should not be selected if you are not using the GNU toolchain.
# CONFIG_MOTOROLA_SREC - make the Motorola S-Record binary format
#   used with many different loaders using the GNU objcopy program
#   Should not be selected if you are not using the GNU toolchain.
# CONFIG_RAW_BINARY - make a raw binary format file used with many
#   different loaders using the GNU objcopy program.  This option
#   should not be selected if you are not using the GNU toolchain.
# CONFIG_HAVE_LIBM - toolchain supports libm.a
#
CONFIG_RRLOAD_BINARY=n
CONFIG_INTELHEX_BINARY=n
CONFIG_MOTOROLA_SREC=n
CONFIG_RAW_BINARY=y
CONFIG_HAVE_LIBM=y

#
# General OS setup
#
# CONFIG_APPS_DIR - Identifies the relative path to the directory
#   that builds the application to link with NuttX.  Default: ../apps
# CONFIG_DEBUG - enables built-in debug options
# CONFIG_DEBUG_VERBOSE - enables verbose debug output
# CONFIG_DEBUG_SYMBOLS - build without optimization and with
#   debug symbols (needed for use with a debugger).
# CONFIG_HAVE_CXX - Enable support for C++
# CONFIG_HAVE_CXXINITIALIZE - The platform-specific logic includes support
#   for initialization of static C++ instances for this architecture
#   and for the selected toolchain (via up_cxxinitialize()).
# CONFIG_MM_REGIONS - If the architecture includes multiple
#   regions of memory to allocate from, this specifies the
#   number of memory regions that the memory manager must
#   handle and enables the API mm_addregion(start, end);
# CONFIG_ARCH_LOWPUTC - architecture supports low-level, boot
#   time console output
# CONFIG_MSEC_PER_TICK - The default system timer is 100Hz
#   or MSEC_PER_TICK=10.  This setting may be defined to
#   inform NuttX that the processor hardware is providing
#   system timer interrupts at some interrupt interval other
#   than 10 msec.
# CONFIG_RR_INTERVAL - The round robin timeslice will be set
#   this number of milliseconds;  Round robin scheduling can
#   be disabled by setting this value to zero.
# CONFIG_SCHED_INSTRUMENTATION - enables instrumentation in 
#   scheduler to monitor system performance
# CONFIG_TASK_NAME_SIZE - Spcifies that maximum size of a
#   task name to save in the TCB.  Useful if scheduler
#   instrumentation is selected.  Set to zero to disable.
# CONFIG_START_YEAR, CONFIG_START_MONTH, CONFIG_START_DAY -
#   Used to initialize the internal time logic.
# CONFIG_GREGORIAN_TIME - Enables Gregorian time conversions.
#   You would only need this if you are concerned about accurate
#   time conversions in the past or in the distant future.
# CONFIG_JULIAN_TIME - Enables Julian time conversions. You
#   would only need this if you are concerned about accurate
#   time conversion in the distand past.  You must also define
#   CONFIG_GREGORIAN_TIME in order to use Julian time.
# CONFIG_DEV_CONSOLE - Set if architecture-specific logic
#   provides /dev/console.  Enables stdout, stderr, stdin.
# CONFIG_DEV_LOWCONSOLE - Use the simple, low-level serial console
#   driver (minimul support)
# CONFIG_MUTEX_TYPES: Set to enable support for recursive and
#   errorcheck mutexes. Enables pthread_mutexattr_settype().
# CONFIG_PRIORITY_INHERITANCE : Set to enable support for priority
#   inheritance on mutexes and semaphores. 
# CONFIG_SEM_PREALLOCHOLDERS: This setting is only used if priority
#   inheritance is enabled.  It defines the maximum number of
#   different threads (minus one) that can take counts on a
#   semaphore with priority inheritance support.  This may be 
#   set to zero if priority inheritance is disabled OR if you
#   are only using semaphores as mutexes (only one holder) OR
#   if no more than two threads participate using a counting
#   semaphore.
# CONFIG_SEM_NNESTPRIO.  If priority inheritance is enabled,
#   then this setting is the maximum number of higher priority
#   threads (minus 1) than can be waiting for another thread
#   to release a count on a semaphore.  This value may be set
#   to zero if no more than one thread is expected to wait for
#   a semaphore.
# CONFIG_FDCLONE_DISABLE. Disable cloning of all file descriptors
#   by task_create() when a new task is started.  If set, all
#   files/drivers will appear to be closed in the new task.
# CONFIG_FDCLONE_STDIO. Disable cloning of all but the first
#   three file descriptors (stdin, stdout, stderr) by task_create()
#   when a new task is started. If set, all files/drivers will
#   appear to be closed in the new task except for stdin, stdout,
#   and stderr.
# CONFIG_SDCLONE_DISABLE. Disable cloning of all socket
#   desciptors by task_create() when a new task is started. If
#   set, all sockets will appear to be closed in the new task.
# CONFIG_SCHED_WORKQUEUE.  Create a dedicated "worker" thread to
#   handle delayed processing from interrupt handlers.  This feature
#   is required for some drivers but, if there are not complaints,
#   can be safely disabled.  The worker thread also performs
#   garbage collection -- completing any delayed memory deallocations
#   from interrupt handlers.  If the worker thread is disabled,
#   then that clean will be performed by the IDLE thread instead
#   (which runs at the lowest of priority and may not be appropriate
#   if memory reclamation is of high priority).  If CONFIG_SCHED_WORKQUEUE
#   is enabled, then the following options can also be used:
# CONFIG_SCHED_WORKPRIORITY - The execution priority of the worker
#   thread.  Default: 192
# CONFIG_SCHED_WORKPERIOD - How often the worker thread checks for
#   work in units of microseconds.  Default: 50*1000 (50 MS).
# CONFIG_SCHED_WORKSTACKSIZE - The stack size allocated for the worker
#   thread.  Default: CONFIG_IDLETHREAD_STACKSIZE.
# CONFIG_SIG_SIGWORK - The signal number that will be used to wake-up
#   the worker thread.  Default: 4
#
# CONFIG_SCHED_LPWORK. If CONFIG_SCHED_WORKQUEUE is defined, then a single
#   work queue is created by default.  If CONFIG_SCHED_LPWORK is also defined
#   then an additional, lower-priority work queue will also be created.  This
#   lower priority work queue is better suited for more extended processing
#   (such as file system clean-up operations)
# CONFIG_SCHED_LPWORKPRIORITY - The execution priority of the lower priority
#   worker thread.  Default: 50
# CONFIG_SCHED_LPWORKPERIOD - How often the lower priority worker thread
#  checks for work in units of microseconds.  Default: 50*1000 (50 MS).
# CONFIG_SCHED_LPWORKSTACKSIZE - The stack size allocated for the lower
#   priority worker thread.  Default: CONFIG_IDLETHREAD_STACKSIZE.
# CONFIG_SCHED_WAITPID - Enable the waitpid() API
# CONFIG_SCHED_ATEXIT - Enabled the atexit() API
#
CONFIG_USER_ENTRYPOINT="nsh_main"
#CONFIG_APPS_DIR=
CONFIG_DEBUG=y
CONFIG_DEBUG_VERBOSE=y
CONFIG_DEBUG_SYMBOLS=y
CONFIG_DEBUG_FS=n
CONFIG_DEBUG_GRAPHICS=n
CONFIG_DEBUG_LCD=n
CONFIG_DEBUG_USB=n
CONFIG_DEBUG_NET=n
CONFIG_DEBUG_RTC=n
CONFIG_DEBUG_ANALOG=n
CONFIG_DEBUG_PWM=n
CONFIG_DEBUG_CAN=n
CONFIG_DEBUG_I2C=n
CONFIG_DEBUG_INPUT=n

CONFIG_HAVE_CXX=y
CONFIG_HAVE_CXXINITIALIZE=y
CONFIG_MM_REGIONS=2
CONFIG_ARCH_LOWPUTC=y
CONFIG_MSEC_PER_TICK=1
CONFIG_RR_INTERVAL=0
CONFIG_SCHED_INSTRUMENTATION=y
CONFIG_TASK_NAME_SIZE=24
CONFIG_START_YEAR=1970
CONFIG_START_MONTH=1
CONFIG_START_DAY=1
CONFIG_GREGORIAN_TIME=n
CONFIG_JULIAN_TIME=n
CONFIG_DEV_CONSOLE=y
CONFIG_DEV_LOWCONSOLE=n
CONFIG_MUTEX_TYPES=n
CONFIG_PRIORITY_INHERITANCE=y
CONFIG_SEM_PREALLOCHOLDERS=0
CONFIG_SEM_NNESTPRIO=8
CONFIG_FDCLONE_DISABLE=n
CONFIG_FDCLONE_STDIO=y
CONFIG_SDCLONE_DISABLE=y
CONFIG_SCHED_WORKQUEUE=y
CONFIG_SCHED_WORKPRIORITY=192
CONFIG_SCHED_WORKPERIOD=5000
CONFIG_SCHED_WORKSTACKSIZE=2048
CONFIG_SCHED_LPWORK=y
CONFIG_SCHED_LPWORKPRIORITY=50
CONFIG_SCHED_LPWORKPERIOD=50000
CONFIG_SCHED_LPWORKSTACKSIZE=2048
CONFIG_SIG_SIGWORK=4
CONFIG_SCHED_WAITPID=y
CONFIG_SCHED_ATEXIT=n

#
# System Logging
#
# CONFIG_SYSLOG - Enables the System Logging feature.
# CONFIG_RAMLOG - Enables the RAM logging feature
# CONFIG_RAMLOG_CONSOLE - Use the RAM logging device as a system console.
#   If this feature is enabled (along with CONFIG_DEV_CONSOLE), then all
#   console output will be re-directed to a circular buffer in RAM.  This
#   is useful, for example, if the only console is a Telnet console.  Then
#   in that case, console output from non-Telnet threads will go to the
#   circular buffer and can be viewed using the NSH 'dmesg' command.
# CONFIG_RAMLOG_SYSLOG - Use the RAM logging device for the syslogging
#   interface.  If this feature is enabled (along with CONFIG_SYSLOG),
#   then all debug output (only) will be re-directed to the circular
#   buffer in RAM.  This RAM log can be view from NSH using the 'dmesg'
#   command.
# CONFIG_RAMLOG_NPOLLWAITERS - The number of threads than can be waiting
#   for this driver on poll().  Default: 4
#
# If CONFIG_RAMLOG_CONSOLE or CONFIG_RAMLOG_SYSLOG is selected, then the
# following may also be provided:
#
# CONFIG_RAMLOG_CONSOLE_BUFSIZE - Size of the console RAM log.  Default: 1024
#

CONFIG_SYSLOG=n
CONFIG_RAMLOG=n
CONFIG_RAMLOG_CONSOLE=n
CONFIG_RAMLOG_SYSLOG=n
#CONFIG_RAMLOG_NPOLLWAITERS
#CONFIG_RAMLOG_CONSOLE_BUFSIZE

#
# The following can be used to disable categories of
# APIs supported by the OS.  If the compiler supports
# weak functions, then it should not be necessary to
# disable functions unless you want to restrict usage
# of those APIs.
#
# There are certain dependency relationships in these
# features.
#
# o mq_notify logic depends on signals to awaken tasks
#   waiting for queues to become full or empty.
# o pthread_condtimedwait() depends on signals to wake
#   up waiting tasks.
#
CONFIG_DISABLE_CLOCK=n
CONFIG_DISABLE_POSIX_TIMERS=n
CONFIG_DISABLE_PTHREAD=n
CONFIG_DISABLE_SIGNALS=n
CONFIG_DISABLE_MQUEUE=n
CONFIG_DISABLE_MOUNTPOINT=n
CONFIG_DISABLE_ENVIRON=n
CONFIG_DISABLE_POLL=n

#
# Misc libc settings
#
# CONFIG_NOPRINTF_FIELDWIDTH - sprintf-related logic is a
#   little smaller if we do not support fieldwidthes
# CONFIG_LIBC_FLOATINGPOINT - Enables printf("%f")
# CONFIG_LIBC_FIXEDPRECISION - Sets 7 digits after dot for printing:
#   5.1234567
# CONFIG_HAVE_LONG_LONG - Enabled printf("%llu)
#
CONFIG_NOPRINTF_FIELDWIDTH=n
CONFIG_LIBC_FLOATINGPOINT=y
CONFIG_HAVE_LONG_LONG=y

#
# Allow for architecture optimized implementations
#
# The architecture can provide optimized versions of the
# following to improve system performance
#
CONFIG_ARCH_MEMCPY=y
CONFIG_ARCH_MEMCMP=n
CONFIG_ARCH_MEMMOVE=n
CONFIG_ARCH_MEMSET=n
CONFIG_ARCH_STRCMP=n
CONFIG_ARCH_STRCPY=n
CONFIG_ARCH_STRNCPY=n
CONFIG_ARCH_STRLEN=n
CONFIG_ARCH_STRNLEN=n
CONFIG_ARCH_BZERO=n

#
# Sizes of configurable things (0 disables)
#
# CONFIG_MAX_TASKS - The maximum number of simultaneously
#   active tasks.  This value must be a power of two.
# CONFIG_MAX_TASK_ARGS - This controls the maximum number of
#   of parameters that a task may receive (i.e., maxmum value
#   of 'argc')
# CONFIG_NPTHREAD_KEYS - The number of items of thread-
#   specific data that can be retained
# CONFIG_NFILE_DESCRIPTORS - The maximum number of file
#   descriptors (one for each open)
# CONFIG_NFILE_STREAMS - The maximum number of streams that
#   can be fopen'ed
# CONFIG_NAME_MAX - The maximum size of a file name.
# CONFIG_STDIO_BUFFER_SIZE - Size of the buffer to allocate
#   on fopen. (Only if CONFIG_NFILE_STREAMS > 0)
# CONFIG_STDIO_LINEBUFFER - If standard C buffered I/O is enabled
#   (CONFIG_STDIO_BUFFER_SIZE > 0), then this option may be added
#   to force automatic, line-oriented flushing the output buffer
#   for putc(), fputc(), putchar(), puts(), fputs(), printf(),
#   fprintf(), and vfprintf().  When a newline is encountered in
#   the output string, the output buffer will be flushed.  This
#   (slightly) increases the NuttX footprint but supports the kind
#   of behavior that people expect for printf().
# CONFIG_NUNGET_CHARS - Number of characters that can be
#   buffered by ungetc() (Only if CONFIG_NFILE_STREAMS > 0)
# CONFIG_PREALLOC_MQ_MSGS - The number of pre-allocated message
#   structures.  The system manages a pool of preallocated
#   message structures to minimize dynamic allocations
# CONFIG_MQ_MAXMSGSIZE - Message structures are allocated with
#   a fixed payload size given by this settin (does not include
#   other message structure overhead.
# CONFIG_MAX_WDOGPARMS - Maximum number of parameters that
#   can be passed to a watchdog handler
# CONFIG_PREALLOC_WDOGS - The number of pre-allocated watchdog
#   structures.  The system manages a pool of preallocated
#   watchdog structures to minimize dynamic allocations
# CONFIG_PREALLOC_TIMERS - The number of pre-allocated POSIX
#   timer structures.  The system manages a pool of preallocated
#   timer structures to minimize dynamic allocations.  Set to
#   zero for all dynamic allocations.
#
CONFIG_MAX_TASKS=32
CONFIG_MAX_TASK_ARGS=8
CONFIG_NPTHREAD_KEYS=4
CONFIG_NFILE_DESCRIPTORS=32
CONFIG_NFILE_STREAMS=25
CONFIG_NAME_MAX=32
CONFIG_STDIO_BUFFER_SIZE=256
CONFIG_STDIO_LINEBUFFER=y
CONFIG_NUNGET_CHARS=2
CONFIG_PREALLOC_MQ_MSGS=4
CONFIG_MQ_MAXMSGSIZE=32
CONFIG_MAX_WDOGPARMS=2
CONFIG_PREALLOC_WDOGS=50
CONFIG_PREALLOC_TIMERS=50

#
# Filesystem configuration
#
# CONFIG_FS_FAT - Enable FAT filesystem support
# CONFIG_FAT_SECTORSIZE - Max supported sector size
# CONFIG_FAT_LCNAMES - Enable use of the NT-style upper/lower case 8.3
#   file name support.
# CONFIG_FAT_LFN - Enable FAT long file names.  NOTE:  Microsoft claims
#   patents on FAT long file name technology.  Please read the
#   disclaimer in the top-level COPYING file and only enable this
#   feature if you understand these issues.
# CONFIG_FAT_MAXFNAME - If CONFIG_FAT_LFN is defined, then the
#   default, maximum long file name is 255 bytes.  This can eat up
#   a lot of memory (especially stack space).  If you are willing
#   to live with some non-standard, short long file names, then
#   define this value.  A good choice would be the same value as
#   selected for CONFIG_NAME_MAX which will limit the visibility
#   of longer file names anyway.
# CONFIG_FS_NXFFS: Enable NuttX FLASH file system (NXFF) support.
# CONFIG_NXFFS_ERASEDSTATE: The erased state of FLASH. 
#   This must have one of the values of 0xff or 0x00.
#   Default: 0xff.
# CONFIG_NXFFS_PACKTHRESHOLD: When packing flash file data,
#   don't both with file chunks smaller than this number of data bytes.
# CONFIG_NXFFS_MAXNAMLEN: The maximum size of an NXFFS file name.
#   Default: 255.
# CONFIG_NXFFS_PACKTHRESHOLD: When packing flash file data,
#   don't both with file chunks smaller than this number of data bytes.
#   Default: 32.
# CONFIG_NXFFS_TAILTHRESHOLD: clean-up can either mean
#   packing files together toward the end of the file or, if file are
#   deleted at the end of the file, clean up can simply mean erasing
#   the end of FLASH memory so that it can be re-used again.  However,
#   doing this can also harm the life of the FLASH part because it can
#   mean that the tail end of the FLASH is re-used too often. This
#   threshold determines if/when it is worth erased the tail end of FLASH
#   and making it available for re-use (and possible over-wear).
#   Default: 8192.
# CONFIG_FS_ROMFS - Enable ROMFS filesystem support
# CONFIG_FS_RAMMAP - For file systems that do not support XIP, this
#   option will enable a limited form of memory mapping that is
#   implemented by copying whole files into memory.
#
CONFIG_FS_FAT=y
CONFIG_FAT_LCNAMES=y
CONFIG_FAT_LFN=y
CONFIG_FAT_MAXFNAME=32
CONFIG_FS_NXFFS=y
CONFIG_NXFFS_MAXNAMLEN=32
CONFIG_NXFFS_TAILTHRESHOLD=2048
CONFIG_NXFFS_PREALLOCATED=y
CONFIG_FS_ROMFS=y
CONFIG_FS_BINFS=y

#
# SPI-based MMC/SD driver
#
# CONFIG_MMCSD_NSLOTS
#   Number of MMC/SD slots supported by the driver
# CONFIG_MMCSD_READONLY
#   Provide read-only access (default is read/write)
# CONFIG_MMCSD_SPICLOCK - Maximum SPI clock to drive MMC/SD card.
#   Default is 20MHz, current setting 24 MHz
#
CONFIG_MMCSD=y
CONFIG_MMCSD_SPI=y
CONFIG_MMCSD_NSLOTS=1
CONFIG_MMCSD_READONLY=n
CONFIG_MMCSD_SPICLOCK=24000000

#
# Block driver buffering
#
# CONFIG_FS_READAHEAD
#   Enable read-ahead buffering
# CONFIG_FS_WRITEBUFFER
#   Enable write buffering
#
CONFIG_FS_READAHEAD=n
CONFIG_FS_WRITEBUFFER=n

#
# RTC Configuration
#
# CONFIG_RTC - Enables general support for a hardware RTC.  Specific
#   architectures may require other specific settings.
# CONFIG_RTC_DATETIME - There are two general types of RTC:  (1) A simple
#   battery backed counter that keeps the time when power is down, and (2)
#    A full date / time RTC the provides the date and time information, often
#   in BCD format.  If CONFIG_RTC_DATETIME is selected, it specifies this
#   second kind of RTC. In this case, the RTC is used to "seed" the normal
#   NuttX timer and the NuttX system timer provides for higher resoution
#   time.
# CONFIG_RTC_HIRES - If CONFIG_RTC_DATETIME not selected, then the simple,
#   battery backed counter is used.  There are two different implementations
#   of such simple counters based on the time resolution of the counter:
#   The typical RTC keeps time to resolution of 1 second, usually
#   supporting a 32-bit time_t value.  In this case, the RTC is used to
#   "seed" the normal NuttX timer and the NuttX timer provides for higher
#   resoution time. If CONFIG_RTC_HIRES is enabled in the NuttX configuration,
#   then the RTC provides higher resolution time and completely replaces the
#   system timer for purpose of date and time.
# CONFIG_RTC_FREQUENCY - If CONFIG_RTC_HIRES is defined, then the frequency
#  of the high resolution RTC must be provided.  If CONFIG_RTC_HIRES is
#   not defined, CONFIG_RTC_FREQUENCY is assumed to be one.
# CONFIG_RTC_ALARM - Enable if the RTC hardware supports setting of an
#  alarm.  A callback function will be executed when the alarm goes off
#
CONFIG_RTC=n
CONFIG_RTC_DATETIME=y
CONFIG_RTC_HIRES=n
CONFIG_RTC_FREQUENCY=n
CONFIG_RTC_ALARM=n

#
# USB Device Configuration
#
# CONFIG_USBDEV
#   Enables USB device support
# CONFIG_USBDEV_ISOCHRONOUS
#   Build in extra support for isochronous endpoints
# CONFIG_USBDEV_DUALSPEED
#   Hardware handles high and full speed operation (USB 2.0)
# CONFIG_USBDEV_SELFPOWERED
#   Will cause USB features to indicate that the device is
#   self-powered
# CONFIG_USBDEV_MAXPOWER
#   Maximum power consumption in mA
# CONFIG_USBDEV_TRACE
#   Enables USB tracing for debug
# CONFIG_USBDEV_TRACE_NRECORDS
#   Number of trace entries to remember
#
CONFIG_USBDEV=y
CONFIG_USBDEV_ISOCHRONOUS=n
CONFIG_USBDEV_DUALSPEED=n
CONFIG_USBDEV_SELFPOWERED=y
CONFIG_USBDEV_REMOTEWAKEUP=n
CONFIG_USBDEV_MAXPOWER=500
CONFIG_USBDEV_TRACE=n
CONFIG_USBDEV_TRACE_NRECORDS=512

#
# USB serial device class driver (Standard CDC ACM class)
#
# CONFIG_CDCACM
#   Enable compilation of the USB serial driver
# CONFIG_CDCACM_CONSOLE
#   Configures the CDC/ACM serial port as the console device.
# CONFIG_CDCACM_EP0MAXPACKET
#   Endpoint 0 max packet size. Default 64
# CONFIG_CDCACM_EPINTIN
#   The logical 7-bit address of a hardware endpoint that supports
#   interrupt IN operation.  Default 2.
# CONFIG_CDCACM_EPINTIN_FSSIZE
#   Max package size for the interrupt IN endpoint if full speed mode.
#   Default 64.
# CONFIG_CDCACM_EPINTIN_HSSIZE
#   Max package size for the interrupt IN endpoint if high speed mode.
#   Default 64
# CONFIG_CDCACM_EPBULKOUT
#   The logical 7-bit address of a hardware endpoint that supports
#   bulk OUT operation.  Default 4.
# CONFIG_CDCACM_EPBULKOUT_FSSIZE
#   Max package size for the bulk OUT endpoint if full speed mode.
#   Default 64.
# CONFIG_CDCACM_EPBULKOUT_HSSIZE
#   Max package size for the bulk OUT  endpoint if high speed mode.
#   Default 512.
# CONFIG_CDCACM_EPBULKIN
#   The logical 7-bit address of a hardware endpoint that supports
#   bulk IN operation.  Default 3.
# CONFIG_CDCACM_EPBULKIN_FSSIZE
#   Max package size for the bulk IN endpoint if full speed mode.
#   Default 64.
# CONFIG_CDCACM_EPBULKIN_HSSIZE
#   Max package size for the bulk IN  endpoint if high speed mode.
#   Default 512.
# CONFIG_CDCACM_NWRREQS and CONFIG_CDCACM_NRDREQS
#   The number of write/read requests that can be in flight.
#   Default 256.
# CONFIG_CDCACM_VENDORID and CONFIG_CDCACM_VENDORSTR
#   The vendor ID code/string.  Default 0x0525 and "NuttX"
#   0x0525 is the Netchip vendor and should not be used in any
#   products.  This default VID was selected for compatibility with
#   the Linux CDC ACM default VID.
# CONFIG_CDCACM_PRODUCTID and CONFIG_CDCACM_PRODUCTSTR
#   The product ID code/string. Default 0xa4a7 and "CDC/ACM Serial"
#   0xa4a7 was selected for compatibility with the Linux CDC ACM
#   default PID.
# CONFIG_CDCACM_RXBUFSIZE and CONFIG_CDCACM_TXBUFSIZE
#   Size of the serial receive/transmit buffers. Default 256.
#
CONFIG_CDCACM=y
CONFIG_CDCACM_CONSOLE=n
#CONFIG_CDCACM_EP0MAXPACKET
CONFIG_CDCACM_EPINTIN=1
#CONFIG_CDCACM_EPINTIN_FSSIZE
#CONFIG_CDCACM_EPINTIN_HSSIZE
CONFIG_CDCACM_EPBULKOUT=3
#CONFIG_CDCACM_EPBULKOUT_FSSIZE
#CONFIG_CDCACM_EPBULKOUT_HSSIZE
CONFIG_CDCACM_EPBULKIN=2
#CONFIG_CDCACM_EPBULKIN_FSSIZE
#CONFIG_CDCACM_EPBULKIN_HSSIZE
#CONFIG_CDCACM_NWRREQS
#CONFIG_CDCACM_NRDREQS
CONFIG_CDCACM_VENDORID=0x26AC
CONFIG_CDCACM_VENDORSTR="3D Robotics"
CONFIG_CDCACM_PRODUCTID=0x0010
CONFIG_CDCACM_PRODUCTSTR="PX4 FMU v1.6"
#CONFIG_CDCACM_RXBUFSIZE
#CONFIG_CDCACM_TXBUFSIZE


#
# Settings for apps/nshlib
#
# CONFIG_NSH_BUILTIN_APPS - Support external registered,
#   "named" applications that can be executed from the NSH
#   command line (see apps/README.txt for more information).
# CONFIG_NSH_FILEIOSIZE - Size of a static I/O buffer
# CONFIG_NSH_STRERROR - Use strerror(errno)
# CONFIG_NSH_LINELEN - Maximum length of one command line
# CONFIG_NSH_MAX_ARGUMENTS - Maximum number of arguments for command line
# CONFIG_NSH_NESTDEPTH - Max number of nested if-then[-else]-fi
# CONFIG_NSH_DISABLESCRIPT - Disable scripting support
# CONFIG_NSH_DISABLEBG - Disable background commands
# CONFIG_NSH_ROMFSETC - Use startup script in /etc
# CONFIG_NSH_CONSOLE - Use serial console front end
# CONFIG_NSH_TELNET - Use telnetd console front end
# CONFIG_NSH_ARCHINIT - Platform provides architecture
#   specific initialization (nsh_archinitialize()).
#
# If CONFIG_NSH_TELNET is selected:
# CONFIG_NSH_IOBUFFER_SIZE -- Telnetd I/O buffer size
# CONFIG_NSH_DHCPC - Obtain address using DHCP
# CONFIG_NSH_IPADDR - Provides static IP address
# CONFIG_NSH_DRIPADDR - Provides static router IP address
# CONFIG_NSH_NETMASK - Provides static network mask
# CONFIG_NSH_NOMAC - Use a bogus MAC address
#
# If CONFIG_NSH_ROMFSETC is selected:
# CONFIG_NSH_ROMFSMOUNTPT - ROMFS mountpoint
# CONFIG_NSH_INITSCRIPT - Relative path to init script
# CONFIG_NSH_ROMFSDEVNO - ROMFS RAM device minor
# CONFIG_NSH_ROMFSSECTSIZE - ROMF sector size
# CONFIG_NSH_FATDEVNO - FAT FS RAM device minor
# CONFIG_NSH_FATSECTSIZE - FAT FS sector size
# CONFIG_NSH_FATNSECTORS - FAT FS number of sectors
# CONFIG_NSH_FATMOUNTPT - FAT FS mountpoint
#
CONFIG_BUILTIN=y
CONFIG_NSH_BUILTIN_APPS=y
CONFIG_NSH_FILEIOSIZE=512
CONFIG_NSH_STRERROR=y
CONFIG_NSH_LINELEN=128
CONFIG_NSH_MAX_ARGUMENTS=12
CONFIG_NSH_NESTDEPTH=8
CONFIG_NSH_DISABLESCRIPT=n
CONFIG_NSH_DISABLEBG=n
CONFIG_NSH_ROMFSETC=y
CONFIG_NSH_ARCHROMFS=y
CONFIG_NSH_CONSOLE=y
CONFIG_NSH_USBCONSOLE=n
CONFIG_NSH_USBCONDEV="/dev/ttyACM0"
CONFIG_NSH_TELNET=n
CONFIG_NSH_ARCHINIT=y
CONFIG_NSH_IOBUFFER_SIZE=512
CONFIG_NSH_DHCPC=n
CONFIG_NSH_NOMAC=y
CONFIG_NSH_IPADDR=0x0a000002
CONFIG_NSH_DRIPADDR=0x0a000001
CONFIG_NSH_NETMASK=0xffffff00
CONFIG_NSH_ROMFSMOUNTPT="/etc"
CONFIG_NSH_INITSCRIPT="init.d/rcS"
CONFIG_NSH_ROMFSDEVNO=0
CONFIG_NSH_ROMFSSECTSIZE=128 # Default 64, increased to allow for more than 64 folders on the sdcard
CONFIG_NSH_FATDEVNO=1
CONFIG_NSH_FATSECTSIZE=512
CONFIG_NSH_FATNSECTORS=1024
CONFIG_NSH_FATMOUNTPT=/tmp

#
# Architecture-specific NSH options
#
CONFIG_NSH_MMCSDSPIPORTNO=3
CONFIG_NSH_MMCSDSLOTNO=0
CONFIG_NSH_MMCSDMINOR=0


#
# Stack and heap information
#
# CONFIG_BOOT_RUNFROMFLASH - Some configurations support XIP
#   operation from FLASH but must copy initialized .data sections to RAM.
#   (should also be =n for the STM3240G-EVAL which always runs from flash)
# CONFIG_BOOT_COPYTORAM -  Some configurations boot in FLASH
#   but copy themselves entirely into RAM for better performance.
# CONFIG_CUSTOM_STACK - The up_ implementation will handle
#   all stack operations outside of the nuttx model.
# CONFIG_STACK_POINTER - The initial stack pointer (arm7tdmi only)
# CONFIG_IDLETHREAD_STACKSIZE - The size of the initial stack.
#  This is the thread that (1) performs the inital boot of the system up
#  to the point where user_start() is spawned, and (2) there after is the
#  IDLE thread that executes only when there is no other thread ready to
#  run.
# CONFIG_USERMAIN_STACKSIZE - The size of the stack to allocate
#  for the main user thread that begins at the user_start() entry point.
# CONFIG_PTHREAD_STACK_MIN - Minimum pthread stack size
# CONFIG_PTHREAD_STACK_DEFAULT - Default pthread stack size
# CONFIG_HEAP_BASE - The beginning of the heap
# CONFIG_HEAP_SIZE - The size of the heap
#
CONFIG_BOOT_RUNFROMFLASH=n
CONFIG_BOOT_COPYTORAM=n
CONFIG_CUSTOM_STACK=n
CONFIG_STACK_POINTER=
# Idle thread needs 4096 bytes
# default 1 KB is not enough
# 4096 bytes 
CONFIG_IDLETHREAD_STACKSIZE=6000
# USERMAIN stack size probably needs to be around 4096 bytes
CONFIG_USERMAIN_STACKSIZE=4096
CONFIG_PTHREAD_STACK_MIN=512
CONFIG_PTHREAD_STACK_DEFAULT=2048
CONFIG_HEAP_BASE=
CONFIG_HEAP_SIZE=

# enable bindir 
CONFIG_APPS_BINDIR=y
```
