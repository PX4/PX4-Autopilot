## nuttx/configs/sam3u-ek/Kconfig
```kconfig
#
# For a description of the syntax of this configuration file,
# see misc/tools/kconfig-language.txt.
#

if ARCH_BOARD_SAM3UEK
config ARCH_LEDS
	bool "NuttX LED support"
	default n
	---help---
		"Support control of board LEDs by NuttX to indicate system state"

config ARCH_BUTTONS
	bool "Button support"
	default n
	---help---
		"Support interfaces to use buttons provided by the board."

config ARCH_IRQBUTTONS
	bool "Button interrupt support"
	default n
	depends on ARCH_BUTTONS
	---help---
		"Support interrupts on button presses and releases."

endif
```
