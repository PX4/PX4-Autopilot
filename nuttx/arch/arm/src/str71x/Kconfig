## nuttx/arch/avr/Kconfig
```kconfig
#
# For a description of the syntax of this configuration file,
# see misc/tools/kconfig-language.txt.
#

if ARCH_AVR

choice
	prompt "Atmel AVR chip selection"
	default ARCH_CHIP_AT32UC3B0256

config ARCH_CHIP_ATMEGA128
	bool "ATMega128"
	---help---
		Atmel ATMega128 8-bit AVR.

config ARCH_CHIP_AT90USB646
	bool "AT90USB646"
	---help---
		Atmel AT90USB646 8-bit AVR.

config ARCH_CHIP_AT90USB647
	bool "AT90USB647"
	---help---
		Atmel AT90USB647 8-bit AVR.

config ARCH_CHIP_AT90USB1286
	bool "AT90USB1286"
	---help---
		Atmel AT90USB1286 8-bit AVR.

config ARCH_CHIP_AT90USB1287
	bool "AT90USB1287"
	---help---
		Atmel AT90USB1287 8-bit AVR.

config ARCH_CHIP_AT32UC3B0256
	bool "AT32UC3B0256"
	---help---
		Atmel AT32UC3B0256 32-bit AVR32.

endchoice

config ARCH_FAMILY_AVR
	bool
	default y			if ARCH_CHIP_ATMEGA128 || ARCH_CHIP_AT90USB646 || ARCH_CHIP_AT90USB647 || ARCH_CHIP_AT90USB1286 || ARCH_CHIP_AT90USB1287

config ARCH_FAMILY_AVR32
	bool
	default y			if ARCH_CHIP_AT32UC3B0256

config ARCH_FAMILY
	string
	default "avr"		if ARCH_FAMILY_AVR
	default "avr32"		if ARCH_FAMILY_AVR32

config ARCH_ATMEGA
	bool
	default y			if ARCH_CHIP_ATMEGA128

config ARCH_AT90USB
	bool
	default y			if ARCH_CHIP_AT90USB646 || ARCH_CHIP_AT90USB647 || ARCH_CHIP_AT90USB1286 || ARCH_CHIP_AT90USB1287

config ARCH_AT32UC3
	bool
	default y			if ARCH_CHIP_AT32UC3B0256

config ARCH_CHIP
	string
	default "atmega"	if ARCH_ATMEGA
	default "at90usb"	if ARCH_AT90USB
	default "at32uc3"	if ARCH_AT32UC3

source arch/avr/src/common/Kconfig

if ARCH_FAMILY_AVR
source arch/avr/src/avr/Kconfig
source arch/avr/src/at90usb/Kconfig
source arch/avr/src/atmega/Kconfig
endif
if ARCH_FAMILY_AVR32
source arch/avr/src/avr32/Kconfig
source arch/avr/src/at32uc3/Kconfig
endif

config AVR_USART0
	bool "USART0 specific serial device driver settings"
	select ARCH_HAVE_USART0

config AVR_USART1
	bool "USART1 specific serial device driver settings"
	select ARCH_HAVE_USART1

endif
```

## nuttx/arch/avr/src/avr/Kconfig
```kconfig
#
# For a description of the syntax of this configuration file,
# see misc/tools/kconfig-language.txt.
#

if ARCH_FAMILY_AVR
comment "AVR Configuration Options"

choice
	prompt "Toolchain"
	default AVR_WINAVR if HOST_WINDOWS
	default AVR_BUILDROOT if HOST_LINUX
	default AVR_CROSSPACK if HOST_OSX

config AVR_WINAVR
	bool "WinAVR"
	depends on HOST_WINDOWS
	---help---
		For Cygwin development environment on Windows machines, you
		can use WinAVR: http://sourceforge.net/projects/winavr/files/

		It is assumed in some places that WinAVR is installed at
		C:/WinAVR. Edit the setenv.sh file if this is not the case.

		WARNING: There is an incompatible version of cygwin.dll in
		the WinAVR/bin directory! Make sure that the path to the
		correct cygwin.dll file precedes the path to the WinAVR
		binaries!

config AVR_LINUXGCC
	bool "Linux GCC"
	depends on HOST_LINUX
	---help---
		For Linux, there are widely available avr-gcc packages. On
		Ubuntu, use: sudo apt-get install gcc-avr gdb-avr avr-libc

config AVR_CROSSPACK
	bool "CrossPack-AVR"
	depends on HOST_OSX
	---help---
		For OS X, the AVR CrossPack toolchain is supported:
		http://www.obdev.at/products/crosspack/index.html

		It is assumed that /usr/local/CrossPack-AVR/bin is on the
		user's path. Edit the setenv.sh file if this is not the
		case.

config AVR_BUILDROOT
	bool "Buildroot"
	depends on HOST_LINUX || HOST_WINDOWS
	---help---
		There is a DIY buildroot version for the AVR boards here:
		http://sourceforge.net/projects/nuttx/files/buildroot/. See
		the following section for details on building this toolchain.

		It is assumed in some places that buildroot toolchain is
		available at ../misc/buildroot/build_avr. Edit the setenv.sh
		file if this is not the case.

endchoice

endif
```

## nuttx/arch/hc/Kconfig
```kconfig
#
# For a description of the syntax of this configuration file,
# see misc/tools/kconfig-language.txt.
#

if ARCH_HC
choice
	prompt "HC chip selection"
	default ARCH_CHIP_MCS92S12NEC64

config ARCH_CHIP_MCS92S12NEC64
	bool "MCS92S12NEC64"
	---help---
		Motorola/Freescale MCS92S12NEC64 (M9S12)

endchoice

config ARCH_HSC12
	bool
	default y			if ARCH_CHIP_MCS92S12NEC64

config ARCH_CHIP
	string
	default "m9s12"		if ARCH_CHIP_MCS92S12NEC64

source arch/hc/src/m9s12/Kconfig

endif
```

## nuttx/arch/mips/Kconfig
```kconfig
#
# For a description of the syntax of this configuration file,
# see misc/tools/kconfig-language.txt.
#

if ARCH_MIPS
choice
	prompt "MIPS chip selection"
	default ARCH_CHIP_PIC32MX

config ARCH_CHIP_PIC32MX
	bool "PIC32MX"
	select ARCH_MIPS32
	select ARCH_IRQPRIO
	---help---
		Microchip PIC32MX320F032H (MIPS32)

endchoice

config ARCH_MIPS32
	bool
	default n

config ARCH_FAMILY
	string
	default "mips32"	if ARCH_MIPS32

config ARCH_CHIP
	string
	default "pic32mx"	if ARCH_CHIP_PIC32MX

config BOARD_LOOPSPERMSEC
	int "Delay loops per millisecond"
	default 5000
	---help---
		Delay loops nust be calibrated for correct operation.

config ARCH_CALIBRATION
	bool "Calibrate delay loop"
	default n
	---help---
		Enables some built in instrumentation that causes a 100 second delay
		during boot-up.  This 100 second delay serves no purpose other than it
		allows you to calibratre BOARD_LOOPSPERMSEC.  You simply use a stop
		watch to measure the 100 second delay then adjust BOARD_LOOPSPERMSEC until
		the delay actually is 100 seconds.

source arch/mips/src/common/Kconfig
source arch/mips/src/mips32/Kconfig
source arch/mips/src/pic32mx/Kconfig

endif
```

## nuttx/arch/mips/src/mips32/Kconfig
```kconfig
#
# For a description of the syntax of this configuration file,
# see misc/tools/kconfig-language.txt.
#

if ARCH_MIPS32
comment "MIPS32 Configuration Options"

choice
	prompt "Toolchain Selection"
	default MIPS32_TOOLCHAIN_MICROCHIPW_LITE if HOST_WINDOWS
	default MIPS32_TOOLCHAIN_GNU_ELF if !HOST_WINDOWS

config MIPS32_TOOLCHAIN_GNU_ELF
	bool "Generic GNU ELF toolchain"
	---help---
		This option should work for any modern GNU toolchain (GCC 4.5 or newer)
		configured for mips32-elf.

config MIPS32_TOOLCHAIN_MICROCHIPL
	bool "Microchip C32 toolchain under Linux"
	depends on HOST_LINUX

config MIPS32_TOOLCHAIN_MICROCHIPL_LITE
	bool "Microchip C32 toolchain under Linux (Lite edition)"
	depends on HOST_LINUX

config MIPS32_TOOLCHAIN_MICROCHIPW
	bool "Microchip C32 toolchain under Windows"
	depends on HOST_WINDOWS

config MIPS32_TOOLCHAIN_MICROCHIPW_LITE
	bool "Microchip C32 toolchain under Windows (Lite edition)"
	depends on HOST_WINDOWS

config MIPS32_TOOLCHAIN_MICROCHIPOPENL
	bool "microchipOpen toolchain under Linux"
	depends on HOST_LINUX

config MIPS32_TOOLCHAIN_PINGUINOW
	bool "Pinguino mips-elf toolchain under Windows"
	depends on HOST_WINDOWS

config MIPS32_TOOLCHAIN_PINGUINOL
	bool "Pinguino mips-elf toolchain under OS X or Linux"
	depends on HOST_LINUX || HOST_OSX

endchoice

config MIPS32_FRAMEPOINTER
	bool "ABI Uses Frame Pointer"
	default n
	depends on ARCH_HAVE_VFORK
	---help---
		Register r30 may be a frame pointer in some ABIs.  Or may just be
		saved register s8.  It makes a difference for vfork handling.

endif
```
