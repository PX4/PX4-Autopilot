## nuttx/arch/rgmp/Kconfig
```kconfig
#
# For a description of the syntax of this configuration file,
# see misc/tools/kconfig-language.txt.
#

if ARCH_RGMP
comment "RGMP Configuration Options"

choice
	prompt "RGMP Architecture"
	default RGMP_SUBARCH_X86

config RGMP_SUBARCH_ARM
	bool "ARM"
	---help---
		RGMP ARM architecture"

config RGMP_SUBARCH_X86
	bool "x86"
	---help---
		RGMP x86 architecture"

endchoice

config RGMP_SUBARCH
	string
	default "arm"		if RGMP_SUBARCH_ARM
	default "x86"		if RGMP_SUBARCH_X86

endif
```

## nuttx/arch/sh/Kconfig
```kconfig
#
# For a description of the syntax of this configuration file,
# see misc/tools/kconfig-language.txt.
#

if ARCH_SH
choice
	prompt "SH chip selection"
	default ARCH_CHIP_SH7032

config ARCH_CHIP_SH7032
	bool "SH7032"
	---help---
		Hitachi/Renesas SH7032 (SH1)

config ARCH_CHIP_M30262F8
	bool "M30262F8"
	---help---
		Renesas M30262F8 (M16C)

endchoice

config ARCH_SH1
	bool
	default y			if ARCH_CHIP_SH7032

config ARCH_M16C
	bool
	default y			if ARCH_CHIP_M30262F8

config ARCH_CHIP
	string
	default "sh1"		if ARCH_SH1
	default "m16c"		if ARCH_M16C

source arch/sh/src/common/Kconfig
source arch/sh/src/m16c/Kconfig
source arch/sh/src/sh1/Kconfig

endif
```

## nuttx/arch/sh/src/m16c/Kconfig
```kconfig
#
# For a description of the syntax of this configuration file,
# see misc/tools/kconfig-language.txt.
#

if ARCH_M16C

config M16C_UART0
	bool "UART0"
	select ARCH_HAVE_UART0
	default n

config M16C_UART1
	bool "UART1"
	select ARCH_HAVE_UART1
	default n

config M16C_UART2
	bool "UART2"
	select ARCH_HAVE_UART2
	default n

endif
```

## nuttx/arch/sim/Kconfig
```kconfig
#
# For a description of the syntax of this configuration file,
# see misc/tools/kconfig-language.txt.
#

if ARCH_SIM
comment "Simulation Configuration Options"

config SIM_M32
	bool "Build 32-bit simulation on 64-bit machine"
	default n
	---help---
		Simulation context switching is based on logic like setjmp and longjmp.  This
		context switching is only available for 32-bit targets.  On 64-bit machines,
		this context switching will fail.

		The workaround on 64-bit machines for now is to build for a 32-bit target on the
		64-bit machine.  The workaround for this issue has been included in NuttX 6.15 and
		beyond.  For thoses versions, you must add SIM_M32=y to the .config file in
		order to enable building a 32-bit image on a 64-bit platform.

config SIM_WALLTIME
	bool "Execution simulation in near real-time"
	default n
	---help---
		NOTE:  In order to facility fast testing, the sim target's IDLE loop, by default,
		calls the system timer "interrupt handler" as fast as possible.  As a result, there
		really are no noticeable delays when a task sleeps.  However, the task really does
		sleep -- but the time scale is wrong.  If you want behavior that is closer to
		normal timing, then you can define CONFIG_SIM_WALLTIME=y in your configuration
		file.  This configuration setting will cause the sim target's IDLE loop to delay
		on each call so that the system "timer interrupt" is called at a rate approximately
		correct for the system timer tick rate.  With this definition in the configuration,
		sleep() behavior is more or less normal.

config SIM_LCDDRIVER
	bool "Build a simulated LCD driver"
	default y
	depends on NX && NX_LCDDRIVER
	---help---
		Build a simulated LCD driver"

config SIM_FRAMEBUFFER
	bool "Build a simulated frame buffer driver"
	default y
	depends on NX && !NX_LCDDRIVER
	---help---
		Build a simulated frame buffer driver"

config SIM_X11FB
	bool "Use X11 window"
	default n
	depends on NX
	---help---
		Use an X11 graphics window to simulate the graphics device"

config SIM_X11NOSHM
	bool "Don't use shared memory with X11"
	default n
	depends on SIM_X11FB
	---help---
		Don't use shared memory with the X11 graphics device emulation."

config SIM_FBHEIGHT
	int "Display height"
	default 240
	depends on NX
	---help---
		Simulated display height.  Default: 240

config SIM_FBWIDTH
	int "Display width"
	default 320 if SIM_LCDDRIVER
	default 480 if SIM_FRAMEBUFFER
	depends on NX
	---help---
		Simulated width of the display.  Default: 320 or 480

config SIM_FBBPP
	int "Pixel depth in bits"
	default 8
	depends on NX
	---help---
		Pixel depth in bits.  Valid choices are 4, 8, 16, 24, or 32.
		If you use the X11 display emulation, the selected BPP must match the BPP
		of your graphics hardware (probably 32 bits).  Default: 8

config SIM_TOUCHSCREEN
	bool "Support an X11 mouse-based touchscreen emulation"
	default n
	depends on SIM_X11FB && INPUT
	---help---
		Support an X11 mouse-based touchscreen emulation.  Also needs INPUT=y

config SIM_TCNWAITERS
	bool "Maximum number poll() waiters"
	default 4
	depends on !POLL_DISABLE && SIM_TOUCHSCREEN
	---help---
		The maximum number of threads that can be waiting on poll() for a touchscreen event.
		Default: 4

endif
```

## nuttx/arch/x86/Kconfig
```kconfig
#
# For a description of the syntax of this configuration file,
# see misc/tools/kconfig-language.txt.
#

if ARCH_X86
comment "x86 Configuration Options"

choice
	prompt "x86 chip selection"
	default ARCH_I486

config ARCH_I486
	bool "i486"
	---help---
		Intel i486 architecture

endchoice

config ARCH_CHIP_QEMU
	bool "Qemu x86 emulation"
	---help---
		Intel i486 architecture

config ARCH_CHIP
	string
	default "qemu"		if ARCH_CHIP_QEMU

source arch/x86/src/common/Kconfig
source arch/x86/src/i486/Kconfig
source arch/x86/src/qemu/Kconfig

endif
```

## nuttx/arch/z16/Kconfig
```kconfig
#
# For a description of the syntax of this configuration file,
# see misc/tools/kconfig-language.txt.
#

if ARCH_Z16
comment "Z16 Configuration Options"

choice
	prompt "ZNEO chip selection"
	default ARCH_CHIP_Z16F2811

config ARCH_CHIP_Z16F2810
	bool "Z16F2810"
	select ARCH_CHIP_Z16F
	select ARCH_IRQPRIO
	---help---
		ZiLOG Z16F2810

config ARCH_CHIP_Z16F2811
	bool "Z16F2811"
	select ARCH_CHIP_Z16F
	select ARCH_IRQPRIO
	---help---
		ZiLOG Z16F2811

config ARCH_CHIP_Z16F3211
	bool "Z16F3211"
	select ARCH_CHIP_Z16F
	select ARCH_IRQPRIO
	---help---
		ZiLOG Z16F321

config ARCH_CHIP_Z16F6411
	bool "Z16F6411"
	select ARCH_CHIP_Z16F
	select ARCH_IRQPRIO
	---help---
		ZiLOG Z16F6411

endchoice

config ARCH_CHIP_Z16F
	bool

config ARCH_CHIP
	string
	default "z16f"		if ARCH_CHIP_Z16F

source arch/z16/src/common/Kconfig
source arch/z16/src/z16f/Kconfig

endif
```

## nuttx/arch/z16/src/z16f/Kconfig
```kconfig
#
# For a description of the syntax of this configuration file,
# see misc/tools/kconfig-language.txt.
#

if ARCH_CHIP_Z16F
comment "Z16F Configuration Options"

# UART0/1 always enabled

config Z16F_UART0
	bool
	default y
	select ARCH_HAVE_UART0

config Z16F_UART1
	bool
	default y
	select ARCH_HAVE_UART1

endif
```
