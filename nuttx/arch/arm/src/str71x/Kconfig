## nuttx/arch/mips/src/pic32mx/Kconfig
```kconfig
#
# For a description of the syntax of this configuration file,
# see misc/tools/kconfig-language.txt.
#

if ARCH_CHIP_PIC32MX
comment "PIC32MX Configuration Options"

choice
	prompt "PIC32MX chip selection"
	default ARCH_CHIP_PIC32MX460F512L

config ARCH_CHIP_PIC32MX110F016B
	bool "PIC32MX110F016B"
	---help---
		Microchip PIC32MX110F016B (MIPS32)

config ARCH_CHIP_PIC32MX110F016C
	bool "PIC32MX110F016C"
	---help---
		Microchip PIC32MX110F016C (MIPS32)

config ARCH_CHIP_PIC32MX110F016D
	bool "PIC32MX110F016D"
	---help---
		Microchip PIC32MX110F016D (MIPS32)

config ARCH_CHIP_PIC32MX120F032B
	bool "PIC32MX120F032B"
	---help---
		Microchip PIC32MX120F032B (MIPS32)

config ARCH_CHIP_PIC32MX120F032C
	bool "PIC32MX120F032C"
	---help---
		Microchip PIC32MX120F032C (MIPS32)

config ARCH_CHIP_PIC32MX120F032D
	bool "PIC32MX120F032D"
	---help---
		Microchip PIC32MX120F032D (MIPS32)

config ARCH_CHIP_PIC32MX130F064B
	bool "PIC32MX130F064B"
	---help---
		Microchip PIC32MX130F064B (MIPS32)

config ARCH_CHIP_PIC32MX130F064C
	bool "PIC32MX130F064C"
	---help---
		Microchip PIC32MX130F064C (MIPS32)

config ARCH_CHIP_PIC32MX130F064D
	bool "PIC32MX130F064D"
	---help---
		Microchip PIC32MX130F064D (MIPS32)

config ARCH_CHIP_PIC32MX150F128B
	bool "PIC32MX150F128B"
	---help---
		Microchip PIC32MX150F128B (MIPS32)

config ARCH_CHIP_PIC32MX150F128C
	bool "PIC32MX150F128C"
	---help---
		Microchip PIC32MX150F128C (MIPS32)

config ARCH_CHIP_PIC32MX150F128D
	bool "PIC32MX150F128D"
	---help---
		Microchip PIC32MX150F128D (MIPS32)

config ARCH_CHIP_PIC32MX210F016B
	bool "PIC32MX210F016B"
	---help---
		Microchip PIC32MX210F016B (MIPS32)

config ARCH_CHIP_PIC32MX210F016C
	bool "PIC32MX210F016C"
	---help---
		Microchip PIC32MX210F016C (MIPS32)

config ARCH_CHIP_PIC32MX210F016D
	bool "PIC32MX210F016D"
	---help---
		Microchip PIC32MX210F016D (MIPS32)

config ARCH_CHIP_PIC32MX220F032B
	bool "PIC32MX220F032B"
	---help---
		Microchip PIC32MX220F032B (MIPS32)

config ARCH_CHIP_PIC32MX220F032C
	bool "PIC32MX220F032C"
	---help---
		Microchip PIC32MX220F032C (MIPS32)

config ARCH_CHIP_PIC32MX220F032D
	bool "PIC32MX220F032D"
	---help---
		Microchip PIC32MX220F032D (MIPS32)

config ARCH_CHIP_PIC32MX230F064B
	bool "PIC32MX230F064B"
	---help---
		Microchip PIC32MX230F064B (MIPS32)

config ARCH_CHIP_PIC32MX230F064C
	bool "PIC32MX230F064C"
	---help---
		Microchip PIC32MX230F064C (MIPS32)

config ARCH_CHIP_PIC32MX230F064D
	bool "PIC32MX230F064D"
	---help---
		Microchip PIC32MX230F064D (MIPS32)

config ARCH_CHIP_PIC32MX250F128B
	bool "PIC32MX250F128B"
	---help---
		Microchip PIC32MX250F128B (MIPS32)

config ARCH_CHIP_PIC32MX250F128C
	bool "PIC32MX250F128C"
	---help---
		Microchip PIC32MX250F128C (MIPS32)

config ARCH_CHIP_PIC32MX250F128D
	bool "PIC32MX250F128D"
	---help---
		Microchip PIC32MX250F128D (MIPS32)

config ARCH_CHIP_PIC32MX320F032H
	bool "PIC32MX320F032H"
	---help---
		Microchip PIC32MX320F032H (MIPS32)

config ARCH_CHIP_PIC32MX320F064H
	bool "PIC32MX320F064H"
	---help---
		Microchip PIC32MX320F064H (MIPS32)

config ARCH_CHIP_PIC32MX320F128H
	bool "PIC32MX320F128H"
	---help---
		Microchip PIC32MX320F128H (MIPS32)

config ARCH_CHIP_PIC32MX320F128L
	bool "PIC32MX320F128L"
	---help---
		Microchip PIC32MX320F128L (MIPS32)

config ARCH_CHIP_PIC32MX340F128H
	bool "PIC32MX340F128H"
	---help---
		Microchip PIC32MX340F128H (MIPS32)

config ARCH_CHIP_PIC32MX340F256H
	bool "PIC32MX340F256H"
	---help---
		Microchip PIC32MX340F256H (MIPS32)

config ARCH_CHIP_PIC32MX340F512H
	bool "PIC32MX340F512H"
	---help---
		Microchip PIC32MX340F512H (MIPS32)

config ARCH_CHIP_PIC32MX340F128L
	bool "PIC32MX340F128L"
	---help---
		Microchip PIC32MX340F128L (MIPS32)

config ARCH_CHIP_PIC32MX360F256L
	bool "PIC32MX360F256L"
	---help---
		Microchip PIC32MX360F256L (MIPS32)

config ARCH_CHIP_PIC32MX360F512L
	bool "PIC32MX360F512L"
	---help---
		Microchip PIC32MX360F512L (MIPS32)

config ARCH_CHIP_PIC32MX420F032H
	bool "PIC32MX420F032H"
	---help---
		Microchip PIC32MX420F032H (MIPS32)

config ARCH_CHIP_PIC32MX440F128H
	bool "PIC32MX440F128H"
	---help---
		Microchip PIC32MX440F128H (MIPS32)

config ARCH_CHIP_PIC32MX440F128L
	bool "PIC32MX440F128L"
	---help---
		Microchip PIC32MX440F128L (MIPS32)

config ARCH_CHIP_PIC32MX440F256H
	bool "PIC32MX440F256H"
	---help---
		Microchip PIC32MX440F256H (MIPS32)

config ARCH_CHIP_PIC32MX440F512H
	bool "PIC32MX440F512H"
	---help---
		Microchip PIC32MX440F512H (MIPS32)

config ARCH_CHIP_PIC32MX460F256L
	bool "PIC32MX460F256L"
	---help---
		Microchip PIC32MX460F256L (MIPS32)

config ARCH_CHIP_PIC32MX460F512L
	bool "PIC32MX460F512L"
	---help---
		Microchip PIC32MX460F512L (MIPS32)

config ARCH_CHIP_PIC32MX534F064H
	bool "PIC32MX534F064H"
	---help---
		Microchip PIC32MX534F064H (MIPS32)

config ARCH_CHIP_PIC32MX534F064L
	bool "PIC32MX534F064L"
	---help---
		Microchip PIC32MX534F064L (MIPS32)

config ARCH_CHIP_PIC32MX564F064H
	bool "PIC32MX564F064H"
	---help---
		Microchip PIC32MX564F064H (MIPS32)

config ARCH_CHIP_PIC32MX564F064L
	bool "PIC32MX564F064L"
	---help---
		Microchip PIC32MX564F064L (MIPS32)

config ARCH_CHIP_PIC32MX564F128H
	bool "PIC32MX564F128H"
	---help---
		Microchip PIC32MX564F128H (MIPS32)

config ARCH_CHIP_PIC32MX564F128L
	bool "PIC32MX564F128L"
	---help---
		Microchip PIC32MX564F128L (MIPS32)

config ARCH_CHIP_PIC32MX575F256H
	bool "PIC32MX575F256H"
	---help---
		Microchip PIC32MX575F256H (MIPS32)

config ARCH_CHIP_PIC32MX575F256L
	bool "PIC32MX575F256L"
	---help---
		Microchip PIC32MX575F256L (MIPS32)

config ARCH_CHIP_PIC32MX575F512H
	bool "PIC32MX575F512H"
	---help---
		Microchip PIC32MX575F512H (MIPS32)

config ARCH_CHIP_PIC32MX575F512L
	bool "PIC32MX575F512L"
	---help---
		Microchip PIC32MX575F512L (MIPS32)

config ARCH_CHIP_PIC32MX664F064H
	bool "PIC32MX664F064H"
	---help---
		Microchip PIC32MX664F064H (MIPS32)

config ARCH_CHIP_PIC32MX664F064L
	bool "PIC32MX664F064L"
	---help---
		Microchip PIC32MX664F064L (MIPS32)

config ARCH_CHIP_PIC32MX664F128H
	bool "PIC32MX664F128H"
	---help---
		Microchip PIC32MX664F128H (MIPS32)

config ARCH_CHIP_PIC32MX664F128L
	bool "PIC32MX664F128L"
	---help---
		Microchip PIC32MX664F128L (MIPS32)

config ARCH_CHIP_PIC32MX675F256H
	bool "PIC32MX675F256H"
	---help---
		Microchip PIC32MX675F256H (MIPS32)

config ARCH_CHIP_PIC32MX675F256L
	bool "PIC32MX675F256L"
	---help---
		Microchip PIC32MX675F256L (MIPS32)

config ARCH_CHIP_PIC32MX675F512H
	bool "PIC32MX675F512H"
	---help---
		Microchip PIC32MX675F512H (MIPS32)

config ARCH_CHIP_PIC32MX675F512L
	bool "PIC32MX675F512L"
	---help---
		Microchip PIC32MX675F512L (MIPS32)

config ARCH_CHIP_PIC32MX695F512H
	bool "PIC32MX695F512H"
	---help---
		Microchip PIC32MX695F512H (MIPS32)

config ARCH_CHIP_PIC32MX695F512L
	bool "PIC32MX695F512L"
	---help---
		Microchip PIC32MX695F512L (MIPS32)

config ARCH_CHIP_PIC32MX764F128H
	bool "PIC32MX764F128H"
	---help---
		Microchip PIC32MX764F128H (MIPS32)

config ARCH_CHIP_PIC32MX764F128L
	bool "PIC32MX764F128L"
	---help---
		Microchip PIC32MX764F128L (MIPS32)

config ARCH_CHIP_PIC32MX775F256H
	bool "PIC32MX775F256H"
	---help---
		Microchip PIC32MX775F256H (MIPS32)

config ARCH_CHIP_PIC32MX775F256L
	bool "PIC32MX775F256L"
	---help---
		Microchip PIC32MX775F256L (MIPS32)

config ARCH_CHIP_PIC32MX775F512H
	bool "PIC32MX775F512H"
	---help---
		Microchip PIC32MX775F512H (MIPS32)

config ARCH_CHIP_PIC32MX775F512L
	bool "PIC32MX775F512L"
	---help---
		Microchip PIC32MX775F512L (MIPS32)

config ARCH_CHIP_PIC32MX795F512H
	bool "PIC32MX795F512H"
	---help---
		Microchip PIC32MX795F512H (MIPS32)

config ARCH_CHIP_PIC32MX795F512L
	bool "PIC32MX795F512L"
	---help---
		Microchip PIC32MX795F512L (MIPS32)

endchoice

config ARCH_CHIP_PIC32MX1
	bool
	default y		if ARCH_CHIP_PIC32MX110F016B || ARCH_CHIP_PIC32MX110F016C || ARCH_CHIP_PIC32MX110F016D || ARCH_CHIP_PIC32MX120F032B || ARCH_CHIP_PIC32MX120F032C ||  ARCH_CHIP_PIC32MX120F032D || ARCH_CHIP_PIC32MX130F064B ||  ARCH_CHIP_PIC32MX130F064C || ARCH_CHIP_PIC32MX130F064D || ARCH_CHIP_PIC32MX150F128B ||  ARCH_CHIP_PIC32MX150F128C || ARCH_CHIP_PIC32MX150F128D

config ARCH_CHIP_PIC32MX2
	bool
	default y		if ARCH_CHIP_PIC32MX210F016B || ARCH_CHIP_PIC32MX210F016C || ARCH_CHIP_PIC32MX210F016D || ARCH_CHIP_PIC32MX220F032B || ARCH_CHIP_PIC32MX220F032C || ARCH_CHIP_PIC32MX220F032D || ARCH_CHIP_PIC32MX230F064B || ARCH_CHIP_PIC32MX230F064C || ARCH_CHIP_PIC32MX230F064D || ARCH_CHIP_PIC32MX250F128B || ARCH_CHIP_PIC32MX250F128C || ARCH_CHIP_PIC32MX250F128D

config ARCH_CHIP_PIC32MX3
	bool
	default y		if ARCH_CHIP_PIC32MX320F032H || ARCH_CHIP_PIC32MX320F064H || ARCH_CHIP_PIC32MX320F128H || ARCH_CHIP_PIC32MX320F128L || ARCH_CHIP_PIC32MX340F128H || ARCH_CHIP_PIC32MX340F256H || ARCH_CHIP_PIC32MX340F512H || ARCH_CHIP_PIC32MX340F128L || ARCH_CHIP_PIC32MX360F256L || ARCH_CHIP_PIC32MX360F512L

config ARCH_CHIP_PIC32MX4
	bool
	default y		if ARCH_CHIP_PIC32MX420F032H || ARCH_CHIP_PIC32MX440F128H || ARCH_CHIP_PIC32MX440F128L || ARCH_CHIP_PIC32MX440F256H || ARCH_CHIP_PIC32MX440F512H || ARCH_CHIP_PIC32MX460F256L || ARCH_CHIP_PIC32MX460F512L

config ARCH_CHIP_PIC32MX5
	bool
	default y		if ARCH_CHIP_PIC32MX534F064H || ARCH_CHIP_PIC32MX534F064L || ARCH_CHIP_PIC32MX564F064H || ARCH_CHIP_PIC32MX564F064L || ARCH_CHIP_PIC32MX564F128H || ARCH_CHIP_PIC32MX564F128L || ARCH_CHIP_PIC32MX575F256H || ARCH_CHIP_PIC32MX575F256L || ARCH_CHIP_PIC32MX575F512H || ARCH_CHIP_PIC32MX575F512L

config ARCH_CHIP_PIC32MX6
	bool
	default y		if ARCH_CHIP_PIC32MX664F064H || ARCH_CHIP_PIC32MX664F064L || ARCH_CHIP_PIC32MX664F128H || ARCH_CHIP_PIC32MX664F128L || ARCH_CHIP_PIC32MX675F256H || ARCH_CHIP_PIC32MX675F256L || ARCH_CHIP_PIC32MX675F512H || ARCH_CHIP_PIC32MX675F512L || ARCH_CHIP_PIC32MX695F512H || ARCH_CHIP_PIC32MX695F512L

config ARCH_CHIP_PIC32MX7
	bool
	default y		if ARCH_CHIP_PIC32MX764F128H || ARCH_CHIP_PIC32MX764F128L || ARCH_CHIP_PIC32MX775F256H || ARCH_CHIP_PIC32MX775F256L || ARCH_CHIP_PIC32MX775F512H || ARCH_CHIP_PIC32MX775F512L || ARCH_CHIP_PIC32MX795F512H || ARCH_CHIP_PIC32MX795F512L

config PIC32MX_MVEC
	bool
	default n

config PIC32MX_T1
	bool
	default y

menu "PIC32MX Peripheral Support"

config PIC32MX_WDT
	bool "Watchdog timer (WDT)"
	default n

config PIC32MX_T2
	bool "Timer 2 (T2)"
	default n

config PIC32MX_T3
	bool "Timer 3 (T3)"
	default n

config PIC32MX_T4
	bool "Timer 4 (T4)"
	default n

config PIC32MX_T5
	bool "Timer 5 (T5)"
	default n

config PIC32MX_IC1
	bool "Input Capture 1 (IC1)"
	default n

config PIC32MX_IC2
	bool "Input Capture 2 (IC2)"
	default n

config PIC32MX_IC3
	bool "Input Capture 3 (IC3)"
	default n

config PIC32MX_IC4
	bool "Input Capture 4 (IC4)"
	default n

config PIC32MX_IC5
	bool "Input Capture 5 (IC5)"
	default n

config PIC32MX_OC1
	bool "Output Compare 1 (OC1)"
	default n

config PIC32MX_OC2
	bool "Output Compare 2 (OC2)"
	default n

config PIC32MX_OC3
	bool "Output Compare 3 (OC3)"
	default n

config PIC32MX_OC4
	bool "Output Compare 4 (OC4)"
	default n

config PIC32MX_OC5
	bool "Output Compare 5 (OC5)"
	default n

config PIC32MX_I2C1
	bool "I2C1"
	default n

config PIC32MX_I2C2
	bool "I2C2"
	default n

config PIC32MX_I2C3
	bool "I2C3"
	default n

config PIC32MX_I2C4
	bool "I2C4"
	default n

config PIC32MX_I2C5
	bool "I2C5"
	default n

config PIC32MX_SPI1
	bool "SPI1"
	default n

config PIC32MX_SPI2
	bool "SPI2"
	default n

config PIC32MX_SPI3
	bool "SPI3"
	default n

config PIC32MX_SPI4
	bool "SPI4"
	default n

config PIC32MX_UART1
	bool "UART1"
	default n
	select ARCH_HAVE_UART1

config PIC32MX_UART2
	bool "UART2"
	default n
	select ARCH_HAVE_UART1

config PIC32MX_UART3
	bool "UART3"
	default n
	select ARCH_HAVE_UART3

config PIC32MX_UART4
	bool "UART4"
	default n
	select ARCH_HAVE_UART4

config PIC32MX_UART5
	bool "UART5"
	default n
	select ARCH_HAVE_UART5

config PIC32MX_UART6
	bool "UART6"
	default n
	select ARCH_HAVE_UART6

config PIC32MX_ADC
	bool "ADC1"
	default n

config PIC32MX_PMP
	bool "Parallel Master Port (PMP)"
	default n

config PIC32MX_CM1
	bool "Comparator 1 (CM1)"
	default n

config PIC32MX_CM2
	bool "Comparator 2 (CM2)"
	default n

config PIC32MX_CM3
	bool "Comparator 3 (CM3)"
	default n

config PIC32MX_RTCC
	bool "Real-Time Clock and Calendar (RTCC)"
	default n

config PIC32MX_DMA
	bool "DMA"
	default n
	select ARCH_DMA

config PIC32MX_FLASH
	bool "FLASH"
	default n

config PIC32MX_USBDEV
	bool "USB device"
	default n

config PIC32MX_USBHOST
	bool "USB host"
	default n

config PIC32MX_CAN1
	bool "Controller area network 1 (CAN1)"
	default n

config PIC32MX_CAN2
	bool "Controller area network 2 (CAN2)"
	default n

config PIC32MX_ETHERNET
	bool "Ethernet"
	default n
	select NET
	select ARCH_HAVE_PHY

config PIC32MX_CTMU
	bool "Charge Time Measurement Unit (CMTU)"
	default n

endmenu

menu "PIC32MX Peripheral Interrupt Priorities"

config PIC32MX_CTPRIO
	int "Core Timer Interrupt (CT)"
	default 16
	---help---
		Core Timer Interrupt.  Range 4-31, Default 16.

config PIC32MX_CS0PRIO
	int "Core Software Interrupt 0 (CS0)"
	default 16
	---help---
		Core Software Interrupt 0.  Range 4-31, Default 16.

config PIC32MX_CS1PRIO
	int "Core Software Interrupt 1 (CS1)"
	default 16
	---help---
		Core Software Interrupt 1.  Range 4-31, Default 16.

config PIC32MX_INT0PRIO
	int "External Interrupt 0 (INT0)"
	default 16
	---help---
		External Interrupt 0.  Range 4-31, Default 16.

config PIC32MX_INT1PRIO
	int "External Interrupt 1 (INT1)"
	default 16
	---help---
		External Interrupt 1.  Range 4-31, Default 16.

config PIC32MX_INT2PRIO
	int "External Interrupt 2 (INT2)"
	default 16
	---help---
		External Interrupt 2.  Range 4-31, Default 16.

config PIC32MX_INT3PRIO
	int "External Interrupt 3 (INT3)"
	default 16
	---help---
		External Interrupt 3.  Range 4-31, Default 16.

config PIC32MX_INT4PRIO
	int "External Interrupt 4 (INT4)"
	default 16
	---help---
		External Interrupt 4.  Range 4-31, Default 16.

config PIC32MX_FSCMPRIO
	int "Fail-Safe Clock Monitor (FSCM)"
	default 16
	depends on PIC32MX_
	---help---
		Fail-Safe Clock Monitor.  Range 4-31, Default 16.

config PIC32MX_T1PRIO
	int "Timer 1 (T1)"
	default 16
	---help---
		Timer 1 (System timer) priority.  Range 4-31, Default 16.

config PIC32MX_T2PRIO
	int "Timer 2 (T2)"
	default 16
	depends on PIC32MX_T2
	---help---
		Timer 2 priority.  Range 4-31, Default 16.

config PIC32MX_T3PRIO
	int "Timer 3 (T3)"
	default 16
	depends on PIC32MX_T3
	---help---
		Timer 3 priority.  Range 4-31, Default 16.

config PIC32MX_T4PRIO
	int "Timer 4 (T4)"
	default 16
	depends on PIC32MX_T4
	---help---
		Timer 4 priority.  Range 4-31, Default 16.

config PIC32MX_T5PRIO
	int "Timer 5 (T5)"
	default 16
	depends on PIC32MX_
	---help---
		Timer 5 priority.  Range 4-31, Default 16.

config PIC32MX_IC1PRIO
	int "Input Capture 1 (IC1)"
	default 16
	depends on PIC32MX_IC1
	---help---
		Input Capture 1.  Range 4-31, Default 16.

config PIC32MX_IC2PRIO
	int "Input Capture 2 (IC2)"
	default 16
	depends on PIC32MX_IC2
	---help---
		Input Capture 2.  Range 4-31, Default 16.

config PIC32MX_IC3PRIO
	int "Input Capture 3 (IC3)"
	default 16
	depends on PIC32MX_IC3
	---help---
		Input Capture 3.  Range 4-31, Default 16.

config PIC32MX_IC4PRIO
	int "Input Capture 4 (IC4)"
	default 16
	depends on PIC32MX_IC4
	---help---
		Input Capture 4.  Range 4-31, Default 16.

config PIC32MX_IC5PRIO
	int "Input Capture 5 (IC5)"
	default 16
	depends on PIC32MX_IC5
	---help---
		Input Capture 5.  Range 4-31, Default 16.

config PIC32MX_OC1PRIO
	int "Output Compare 1 (OC1)"
	default 16
	depends on PIC32MX_OC1
	---help---
		Output Compare 1.  Range 4-31, Default 16.

config PIC32MX_OC2PRIO
	int "Output Compare 2 (OC2)"
	default 16
	depends on PIC32MX_OC2
	---help---
		Output Compare 2.  Range 4-31, Default 16.

config PIC32MX_OC3PRIO
	int "Output Compare 3 (OC3)"
	default 16
	depends on PIC32MX_OC3
	---help---
		Output Compare 3.  Range 4-31, Default 16.

config PIC32MX_OC4PRIO
	int "Output Compare 4 (OC4)"
	default 16
	depends on PIC32MX_OC4
	---help---
		Output Compare 4.  Range 4-31, Default 16.

config PIC32MX_OC5PRIO
	int "Output Compare 5 (OC5)"
	default 16
	depends on PIC32MX_OC5
	---help---
		Output Compare 5.  Range 4-31, Default 16.

config PIC32MX_I2C1PRIO
	int "I2C1"
	default 16
	depends on PIC32MX_I2C1
	---help---
		I2C 1.  Range 4-31, Default 16.

config PIC32MX_I2C2PRIO
	int "I2C2"
	default 16
	depends on PIC32MX_I2C3
	---help---
		I2C 2.  Range 4-31, Default 16.

config PIC32MX_I2C3PRIO
	int "I2C3"
	default 16
	depends on PIC32MX_I2C3
	---help---
		I2C 3.  Range 4-31, Default 16.

config PIC32MX_I2C4PRIO
	int "I2C4"
	default 16
	depends on PIC32MX_I2C4
	---help---
		I2C 4.  Range 4-31, Default 16.

config PIC32MX_I2C5PRIO
	int "I2C5"
	default 16
	depends on PIC32MX_I2C5
	---help---
		I2C 5.  Range 4-31, Default 16.

config PIC32MX_SPI1PRIO
	int "SPI1"
	default 16
	depends on PIC32MX_SPI1
	---help---
		SPI 2

config PIC32MX_SPI2PRIO
	int "SPI2"
	default 16
	depends on PIC32MX_SPI2
	---help---
		SPI 2

config PIC32MX_UART1PRIO
	int "UART1"
	default 16
	depends on PIC32MX_UART1
	---help---
		UART 1.  Range 4-31, Default 16.

config PIC32MX_UART2PRIO
	int "UART2"
	default 16
	depends on PIC32MX_UART2
	---help---
		UART 2.  Range 4-31, Default 16.

config PIC32MX_CNPRIO
	int "CN"
	default 16
	depends on PIC32MX_CN
	---help---
		Input Change Interrupt.  Range 4-31, Default 16.

config PIC32MX_ADCPRIO
	int "ADC1"
	default 16
	depends on PIC32MX_ADC1
	---help---
		ADC1 Convert Done.  Range 4-31, Default 16.

config PIC32MX_PMPPRIO
	int "Parallel Master Port (PMP)"
	default 16
	depends on PIC32MX_PMP
	---help---
		Parallel Master Port.  Range 4-31, Default 16.

config PIC32MX_CM1PRIO
	int "Comparator 1 (CM1)"
	default 16
	depends on PIC32MX_CM1
	---help---
		Comparator 1.  Range 4-31, Default 16.

config PIC32MX_CM2PRIO
	int "Comparator 2 (CM2)"
	default 16
	depends on PIC32MX_CM2
	---help---
		Comparator 2.  Range 4-31, Default 16.

config PIC32MX_RTCCPRIO
	int "Real-Time Clock and Calendar (RTCC)"
	default 16
	depends on PIC32MX_RTCC
	---help---
		Real-Time Clock and Calendar.  Range 4-31, Default 16.

config PIC32MX_DMA0PRIO
	int "DMA0"
	default 16
	depends on PIC32MX_DMA
	---help---
		DMA Channel 0.  Range 4-31, Default 16.

config PIC32MX_DMA1PRIO
	int "DMA1"
	default 16
	depends on PIC32MX_DMA
	---help---
		DMA Channel 1.  Range 4-31, Default 16.

config PIC32MX_DMA2PRIO
	int "DMA2"
	default 16
	depends on PIC32MX_DMA
	---help---
		DMA Channel 2.  Range 4-31, Default 16.

config PIC32MX_DMA3PRIO
	int "DMA3"
	default 16
	depends on PIC32MX_DMA
	---help---
		DMA Channel 3.  Range 4-31, Default 16.

config PIC32MX_DMA4PRIO
	int "DMA4"
	default 16
	depends on PIC32MX_DMA
	---help---
		DMA Channel 4.  Range 4-31, Default 16.

config PIC32MX_DMA5PRIO
	int "DMA5"
	default 16
	depends on PIC32MX_DMA
	---help---
		DMA Channel 5.  Range 4-31, Default 16.

config PIC32MX_DMA6PRIO
	int "DMA6"
	default 16
	depends on PIC32MX_DMA
	---help---
		DMA Channel 6.  Range 4-31, Default 16.

config PIC32MX_DMA7PRIO
	int "DMA7"
	default 16
	depends on PIC32MX_DMA
	---help---
		DMA Channel 7.  Range 4-31, Default 16.

config PIC32MX_FCEPRIO
	int "FCE"
	default 16
	depends on PIC32MX_FLASH
	---help---
		Flash Control Event.  Range 4-31, Default 16.

config PIC32MX_USBPRIO
	int "USB"
	default 16
	depends on PIC32MX_USBDEV || PIC32MX_USBHOST
	---help---
		USB.  Range 4-31, Default 16.

endmenu

config SERIAL_TERMIOS
	bool "Serial driver TERMIOS supported"
	depends on PIC32MX_UART1 || PIC32MX_UART2 || PIC32MX_UART3 || PIC32MX_UART4 || PIC32MX_UART5 || PIC32MX_UART6
	default n
	---help---
		Serial driver supports termios.h interfaces (tcsetattr, tcflush, etc.).
		If this is not defined, then the terminal settings (baud, parity, etc).
		are not configurable at runtime; serial streams cannot be flushed, etc..

menu "PIC32MX PHY/Ethernet device driver settings"
	depends on PIC32MX_ETHERNET

config PHY_AUTONEG
	bool "Auto-negotion"
	default y
	depends on PIC32MX_ETHERNET
	---help---
		Enable auto-negotion

config PHY_SPEED100
	bool "100Mbps spped"
	default n
	depends on PIC32MX_ETHERNET && !PHY_AUTONEG
	---help---
		Select 100Mbit vs. 10Mbit speed.

config PHY_FDUPLEX
	bool "Full duplex"
	default n
	depends on PIC32MX_ETHERNET && !PHY_AUTONEG
	---help---
		Select full (vs. half) duplex

config NET_NTXDESC
	int "Number Tx descriptors"
	default 2
	depends on PIC32MX_ETHERNET
	---help---
		Configured number of Tx descriptors. Default: 2

config NET_NRXDESC
	int "Number Rx descriptors"
	default 4
	depends on PIC32MX_ETHERNET
	---help---
		Configured number of Rx descriptors. Default: 4

config NET_PRIORITY
	int ""
	default 28
	depends on PIC32MX_ETHERNET
	---help---
		Ethernet interrupt priority.  The is default is the higest priority.

config NET_WOL
	bool "Wake-up on LAN"
	default n
	depends on PIC32MX_ETHERNET
	---help---
		Enable Wake-up on LAN (not fully implemented).

config NET_DUMPPACKET
	bool "Dump packets"
	default n
	depends on PIC32MX_ETHERNET && DEBUG
	---help---
		Dump all received and transmitted packets. Also needs DEBUG.

config NET_REGDEBUG
	bool "Register level debug"
	default n
	depends on PIC32MX_ETHERNET && DEBUG
	---help---
		Enabled low level register debug.  Also needs DEBUG.

config NET_HASH
	bool "Hash"
	default n
	depends on PIC32MX_ETHERNET
	---help---
		Enable receipt of near-perfect match frames.

config NET_MULTICAST
	bool "Multicast"
	default y if NET_IGMP
	depends on PIC32MX_ETHERNET
	---help---
		Enable receipt of multicast (and unicast) frames. Automatically set if
		NET_IGMP is selected.

endmenu

menu "Device Configuration 0 (DEVCFG0)"

config PIC32MX_DEBUGGER
	int "Debugger"
	default 3
	---help---
		Background Debugger Enable. Default 3 (disabled). The value 2 enables.

config PIC32MX_ICESEL
	int "ICE channel"
	default 1
	---help---
		In-Circuit Emulator/Debugger Communication Channel Select. Default 1 (PG2)

config PIC32MX_PROGFLASHWP
	hex "Program FLASH write protect"
	default 0xff
	---help---
		Program FLASH write protect.  Default 0xff (disabled)

config PIC32MX_BOOTFLASHWP
	int "Boot FLASH write protect"
	default 1
	---help---
		Default 1 (disabled)

config PIC32MX_CODEWP
	int "Code write protect"
	default 1
	---help---
		Default 1 (disabled)

endmenu

menu "Device Configuration 3 (DEVCFG3)"

config PIC32MX_USBIDO
	int "USB ID"
	default 1 if PIC32MX_USB
	default 0 if !PIC32MX_USB
	---help---
		USB USBID Selection.  Default 1 if USB enabled (USBID pin is controlled by the USB
		module), but 0 (GPIO) otherwise.

config PIC32MX_VBUSIO
	int "USB VBUSON"
	default 1 if PIC32MX_USB
	default 0 if !PIC32MX_USB
	---help---
		USB VBUSON Selection (Default 1 if USB enabled (VBUSON pin is controlled by the USB
		module, but 0 (GPIO) otherwise.

config PIC32MX_WDENABLE
	bool "Watchdog enable"
	default 0
	---help---
		Enabled watchdog on power up.  Default 0 (watchdog can be enabled later by software).

config PIC32MX_FETHIO
	int "Ethernet I/O pins"
	default 1
	---help---
		Ethernet I/O Pin Selection bit:

			1 = Default Ethernet I/O Pins
			0 = Alternate Ethernet I/O Pins

config PIC32MX_FMIIEN
	int "Ethernet MII"
	default 1
	---help---
		Ethernet MII Enable bit

			1 = MII enabled
			0 = RMII enabled

endmenu

endif
```
