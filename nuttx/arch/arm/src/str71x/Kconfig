## nuttx/arch/z80/Kconfig
```kconfig
#
# For a description of the syntax of this configuration file,
# see misc/tools/kconfig-language.txt.
#

if ARCH_Z80
choice
	prompt "ZiLOG 8-bit MCU"
	default ARCH_CHIP_Z80

config ARCH_CHIP_Z80
	bool "Classic z80"
	select ARCH_NOINTC
	---help---
		Classic ZiLOG z80 chip

config ARCH_CHIP_Z8018006VSG
	bool "Z8018006VSG"
	select ARCH_CHIP_Z180
	select ARCH_CHIP_Z80180
	select ARCH_NOINTC
	select ADDRENV
	select HAVE_LOWSERIALINIT
	---help---
		Z180: 68-pin PLCC Z80180

config ARCH_CHIP_Z8018010VSG
	bool "Z8018010VSG"
	select ARCH_CHIP_Z180
	select ARCH_CHIP_Z80180
	select ARCH_NOINTC
	select ADDRENV
	select HAVE_LOWSERIALINIT
	---help---
		Z180: 68-pin PLCC Z80180

config ARCH_CHIP_Z8018008VSG
	bool "Z8018008VSG"
	select ARCH_CHIP_Z180
	select ARCH_CHIP_Z80180
	select ARCH_NOINTC
	select ADDRENV
	select HAVE_LOWSERIALINIT
	---help---
		Z180: 68-pin PLCC Z80180

config ARCH_CHIP_Z8018010FSG
	bool "Z8018010FSG"
	select ARCH_CHIP_Z180
	select ARCH_CHIP_Z80180
	select ARCH_NOINTC
	select ADDRENV
	select HAVE_LOWSERIALINIT
	---help---
		Z180: 80-pin QFP (11 pins N/C) Z80180

config ARCH_CHIP_Z8018008VEG
	bool "Z8018008VEG"
	select ARCH_CHIP_Z180
	select ARCH_CHIP_Z80180
	select ARCH_NOINTC
	select ADDRENV
	select HAVE_LOWSERIALINIT
	---help---
		Z180: 68-pin PLCC Z80180

config ARCH_CHIP_Z8018006VEG
	bool "Z8018006VEG"
	select ARCH_CHIP_Z180
	select ARCH_CHIP_Z80180
	select ARCH_NOINTC
	select ADDRENV
	select HAVE_LOWSERIALINIT
	---help---
		Z180: 68-pin PLCC Z80180

config ARCH_CHIP_Z8018006PSG
	bool "Z8018006PSG"
	select ARCH_CHIP_Z180
	select ARCH_CHIP_Z80180
	select ARCH_NOINTC
	select ADDRENV
	select HAVE_LOWSERIALINIT
	---help---
		Z180: 64-pin DIP 6 MHz 5V Z80180

config ARCH_CHIP_Z8018008FSG
	bool "Z8018008FSG"
	select ARCH_CHIP_Z180
	select ARCH_CHIP_Z80180
	select ARCH_NOINTC
	select ADDRENV
	select HAVE_LOWSERIALINIT
	---help---
		Z180: 80-pin QFP (11 pins N/C) 8MHz 5V Z80180

config ARCH_CHIP_Z8018010PSG
	bool "Z8018010PSG"
	select ARCH_CHIP_Z180
	select ARCH_CHIP_Z80180
	select ARCH_NOINTC
	select ADDRENV
	select HAVE_LOWSERIALINIT
	---help---
		Z180: 64-pin DIP 10MHz 5V Z80180

config ARCH_CHIP_Z8018006PEG
	bool "Z8018006PEG"
	select ARCH_CHIP_Z180
	select ARCH_CHIP_Z80180
	select ARCH_NOINTC
	select ADDRENV
	select HAVE_LOWSERIALINIT
	---help---
		Z180: 64-pin DIP 6MHz 5V Z80180

config ARCH_CHIP_Z8018010VEG
	bool "Z8018010VEG"
	select ARCH_CHIP_Z180
	select ARCH_CHIP_Z80180
	select ARCH_NOINTC
	select ADDRENV
	select HAVE_LOWSERIALINIT
	---help---
		68-pin PLCC 10MHz 5V Z80180

config ARCH_CHIP_Z8018010PEG
	bool "Z8018010PEG"
	select ARCH_CHIP_Z180
	select ARCH_CHIP_Z80180
	select ARCH_NOINTC
	select ADDRENV
	select HAVE_LOWSERIALINIT
	---help---
		Z180: 64-pin DIP 10MHz 5V Z80180

config ARCH_CHIP_Z8018008PSG
	bool "Z8018008PSG"
	select ARCH_CHIP_Z180
	select ARCH_CHIP_Z80180
	select ARCH_NOINTC
	select ADDRENV
	select HAVE_LOWSERIALINIT
	---help---
		Z180: 64-pin DIP 8MHz 5V Z80180

config ARCH_CHIP_Z8018006FSG
	bool "Z8018006FSG"
	select ARCH_CHIP_Z180
	select ARCH_CHIP_Z80180
	select ARCH_NOINTC
	select ADDRENV
	select HAVE_LOWSERIALINIT
	---help---
		Z180: 80-pin QFP (11 pins N/C) 6MHz 5V Z80180

config ARCH_CHIP_Z8018000XSO
	bool "Z8018000XSO"
	select ARCH_CHIP_Z180
	select ARCH_CHIP_Z80180
	select ARCH_NOINTC
	select ADDRENV
	select HAVE_LOWSERIALINIT

config ARCH_CHIP_Z8018010FEG
	bool "Z8018010FEG"
	select ARCH_CHIP_Z180
	select ARCH_CHIP_Z80180
	select ARCH_NOINTC
	select ADDRENV
	select HAVE_LOWSERIALINIT

config ARCH_CHIP_Z8018000WSO
	bool "Z8018000WSO"
	select ARCH_CHIP_Z180
	select ARCH_CHIP_Z80180
	select ARCH_NOINTC
	select ADDRENV
	select HAVE_LOWSERIALINIT

config ARCH_CHIP_Z8018008PEG
	bool "Z8018008PEG"
	select ARCH_CHIP_Z180
	select ARCH_CHIP_Z80180
	select ARCH_NOINTC
	select ADDRENV
	select HAVE_LOWSERIALINIT

config ARCH_CHIP_Z8018110FEG
	bool "Z8018110FEG"
	select ARCH_CHIP_Z180
	select ARCH_CHIP_Z80181
	select ARCH_NOINTC
	select ADDRENV
	select HAVE_LOWSERIALINIT
	---help---
		Z180: 100-pin QFP Z80181

config ARCH_CHIP_Z8018233FSG
	bool "Z8018233FSG"
	select ARCH_CHIP_Z180
	select ARCH_CHIP_Z80182
	select ARCH_NOINTC
	select ADDRENV
	select HAVE_LOWSERIALINIT
	---help---
		100-pin QFP Z80182

config ARCH_CHIP_Z8018220AEG
	bool "Z8018220AEG"
	select ARCH_CHIP_Z180
	select ARCH_CHIP_Z80182
	select ARCH_NOINTC
	select ADDRENV
	select HAVE_LOWSERIALINIT
	---help---
		Z180: 100-pin LQFP 20MHz 5V Z80182

config ARCH_CHIP_Z8018216FSG
	bool "Z8018216FSG"
	select ARCH_CHIP_Z180
	select ARCH_CHIP_Z80182
	select ARCH_NOINTC
	select ADDRENV
	select HAVE_LOWSERIALINIT
	---help---
		Z180: 100-pin QFP 16MHz 5V Z80182

config ARCH_CHIP_Z8018216ASG
	bool "Z8018216ASG"
	select ARCH_CHIP_Z180
	select ARCH_CHIP_Z80182
	select ARCH_NOINTC
	select ADDRENV
	select HAVE_LOWSERIALINIT
	---help---
		Z180: 100-pin LQFP Z80182

config ARCH_CHIP_Z8018233ASG
	bool "Z8018233ASG"
	select ARCH_CHIP_Z180
	select ARCH_CHIP_Z80182
	select ARCH_NOINTC
	select ADDRENV
	select HAVE_LOWSERIALINIT
	---help---
		Z180: 100-pin LQFP 33MHz 5V Z80182

config ARCH_CHIP_Z8019520FSG
	bool "Z8019520FSG"
	select ARCH_CHIP_Z180
	select ARCH_CHIP_Z80195
	select ARCH_NOINTC
	select ADDRENV
	select HAVE_LOWSERIALINIT
	---help---
		Z180: 100-pin QFP 20MHz 5V Z80195

config ARCH_CHIP_Z8019533FSG
	bool "Z8019533FSG"
	select ARCH_CHIP_Z180
	select ARCH_CHIP_Z80195
	select ARCH_NOINTC
	select ADDRENV
	select HAVE_LOWSERIALINIT
	---help---
		Z180: 100-pin QFP 33MHz 5V Z80195

config ARCH_CHIP_Z8L18020VSG
	bool "Z8L18020VSG"
	select ARCH_CHIP_Z180
	select ARCH_CHIP_Z8L180
	select ARCH_NOINTC
	select ADDRENV
	select HAVE_LOWSERIALINIT
	---help---
		Z180: 68-pinn PLCC Z8L180

config ARCH_CHIP_Z8L18020FSG
	bool "Z8L18020FSG"
	select ARCH_CHIP_Z180
	select ARCH_CHIP_Z8L180
	select ARCH_NOINTC
	select ADDRENV
	select HAVE_LOWSERIALINIT
	---help---
		Z180: 80-pin GFP 20MHz 3.3V Z8L180

config ARCH_CHIP_Z8L18020PSG
	bool "Z8L18020PSG"
	select ARCH_CHIP_Z180
	select ARCH_CHIP_Z8L180
	select ARCH_NOINTC
	select ADDRENV
	select HAVE_LOWSERIALINIT

config ARCH_CHIP_Z8L18220ASG
	bool "Z8L18220ASG"
	select ARCH_CHIP_Z180
	select ARCH_CHIP_Z8L182
	select ARCH_NOINTC
	select ADDRENV
	select HAVE_LOWSERIALINIT
	---help---
		Z180: 100-pin LQFP Z8L182

config ARCH_CHIP_Z8L18220FSG
	bool "Z8L18220FSG"
	select ARCH_CHIP_Z180
	select ARCH_CHIP_Z8L182
	select ARCH_NOINTC
	select ADDRENV
	select HAVE_LOWSERIALINIT
	---help---
		100-pin QFP 20MHz 3.3V Z8L182

config ARCH_CHIP_Z8L18220AEG
	bool "Z8L18220AEG"
	select ARCH_CHIP_Z180
	select ARCH_CHIP_Z8L182
	select ARCH_NOINTC
	select ADDRENV
	select HAVE_LOWSERIALINIT

config ARCH_CHIP_Z8S18020VSG
	bool "Z8S18020VSG"
	select ARCH_CHIP_Z180
	select ARCH_CHIP_Z8S180
	select ARCH_NOINTC
	select ADDRENV
	select HAVE_LOWSERIALINIT
	---help---
		Z180: 68-pin PLCC Z8S180

config ARCH_CHIP_Z8S18020VSG1960
	bool "Z8S18020VSG1960"
	select ARCH_CHIP_Z180
	select ARCH_CHIP_Z8S180
	select ARCH_NOINTC
	select ADDRENV
	select HAVE_LOWSERIALINIT
	---help---
		Z180: 68-pin PLCC Z8S180

config ARCH_CHIP_Z8S18033VSG
	bool "Z8S18033VSG"
	select ARCH_CHIP_Z180
	select ARCH_CHIP_Z8S180
	select ARCH_NOINTC
	select ADDRENV
	select HAVE_LOWSERIALINIT
	---help---
		Z180: 68-pin PLCC Z8S180

config ARCH_CHIP_Z8S18010FSG
	bool "Z8S18010FSG"
	select ARCH_CHIP_Z180
	select ARCH_CHIP_Z8S180
	select ARCH_NOINTC
	select ADDRENV
	select HAVE_LOWSERIALINIT
	---help---
		80-pin QFP Z8S180

config ARCH_CHIP_Z8S18010VEG
	bool "Z8S18010VEG"
	select ARCH_CHIP_Z180
	select ARCH_CHIP_Z8S180
	select ARCH_NOINTC
	select ADDRENV
	select HAVE_LOWSERIALINIT
	---help---
		Z180: 68-pin PLCC Z8S180

config ARCH_CHIP_Z8S18020VEG
	bool "Z8S18020VEG"
	select ARCH_CHIP_Z180
	select ARCH_CHIP_Z8S180
	select ARCH_NOINTC
	select ADDRENV
	select HAVE_LOWSERIALINIT
	---help---
		Z180: 68-pin PLCC Z8S180

config ARCH_CHIP_Z8S18010VSG
	bool "Z8S18010VSG"
	select ARCH_CHIP_Z180
	select ARCH_CHIP_Z8S180
	select ARCH_NOINTC
	select ADDRENV
	select HAVE_LOWSERIALINIT
	---help---
		Z180: 68-pin PLCC Z8S180

config ARCH_CHIP_Z8S18020PSG
	bool "Z8S18020PSG"
	select ARCH_CHIP_Z180
	select ARCH_CHIP_Z8S180
	select ARCH_NOINTC
	select ADDRENV
	select HAVE_LOWSERIALINIT
	---help---
		64-pin DIP 10Mhz 5V Z8S180

config ARCH_CHIP_Z8S18033FSG
	bool "Z8S18033FSG"
	select ARCH_CHIP_Z180
	select ARCH_CHIP_Z8S180
	select ARCH_NOINTC
	select ADDRENV
	select HAVE_LOWSERIALINIT
	---help---
		Z180: 80-pin QFP 33MHz 5V Z8S180

config ARCH_CHIP_Z8S18033FEG
	bool "Z8S18033FEG"
	select ARCH_CHIP_Z180
	select ARCH_CHIP_Z8S180
	select ARCH_NOINTC
	select ADDRENV
	select HAVE_LOWSERIALINIT
	---help---
		Z180: 80-pin QFP 33MHz 5V Z8S180

config ARCH_CHIP_Z8S18020FSG
	bool "Z8S18020FSG"
	select ARCH_CHIP_Z180
	select ARCH_CHIP_Z8S180
	select ARCH_NOINTC
	select ADDRENV
	select HAVE_LOWSERIALINIT
	---help---
		Z180: 80-pin QFP 20MHz 5V Z8S180

config ARCH_CHIP_Z8S18033VEG
	bool "Z8S18033VEG"
	select ARCH_CHIP_Z180
	select ARCH_CHIP_Z8S180
	select ARCH_NOINTC
	select ADDRENV
	select HAVE_LOWSERIALINIT
	---help---
		Z180: 68-pin PLCC 33MHz 5V Z8S180

config ARCH_CHIP_Z8S18010PSG
	bool "Z8S18010PSG"
	select ARCH_CHIP_Z180
	select ARCH_CHIP_Z8S180
	select ARCH_NOINTC
	select ADDRENV
	select HAVE_LOWSERIALINIT
	---help---
		Z180: 64-pin DIP 10MHz 5V Z8S180

config ARCH_CHIP_Z8S18020FEG
	bool "Z8S18020FEG"
	select ARCH_CHIP_Z180
	select ARCH_CHIP_Z8S180
	select ARCH_NOINTC
	select ADDRENV
	select HAVE_LOWSERIALINIT

config ARCH_CHIP_Z8S18010PEG
	bool "Z8S18010PEG"
	select ARCH_CHIP_Z180
	select ARCH_CHIP_Z8S180
	select ARCH_NOINTC
	select ADDRENV
	select HAVE_LOWSERIALINIT

config ARCH_CHIP_Z8S18010FEG
	bool "Z8S18010FEG"
	select ARCH_CHIP_Z180
	select ARCH_CHIP_Z8S180
	select ARCH_NOINTC
	select ADDRENV
	select HAVE_LOWSERIALINIT

config ARCH_CHIP_Z8F6403
	bool "Z8F6403"
	select ARCH_CHIP_Z8
	select ARCH_CHIP_Z8F640X
	select ENDIAN_BIG
	select HAVE_LOWSERIALINIT
	---help---
		ZiLOG Z8F6403 (z8 Encore)

config ARCH_CHIP_Z8F6423
	bool "Z8F6423"
	select ARCH_CHIP_Z8
	select ARCH_CHIP_Z8F642X
	select ENDIAN_BIG
	select HAVE_LOWSERIALINIT
	---help---
		ZiLOG Z8F6423 (z8 Encore)

config ARCH_CHIP_EZ80F91
	bool "EZ80F91"
	select ARCH_CHIP_EZ80
	select HAVE_LOWSERIALINIT
	---help---
		ZiLOG EZ80F91 (ez80 Acclaim)

config ARCH_CHIP_EZ80F92
	bool "EZ80F92"
	select ARCH_CHIP_EZ80
	select HAVE_LOWSERIALINIT
	---help---
		ZiLOG EZ80F92 (ez80 Acclaim)

config ARCH_CHIP_EZ80F93
	bool "EZ80F93"
	select ARCH_CHIP_EZ80
	select HAVE_LOWSERIALINIT
	---help---
		ZiLOG EZ80F93 (ez80 Acclaim)

endchoice

config ARCH_CHIP_Z8F642X
	bool

config ARCH_CHIP_Z8F640X
	bool

config ARCH_CHIP_Z180
	bool

config ARCH_CHIP_Z80180
	bool

config ARCH_CHIP_Z80181
	bool

config ARCH_CHIP_Z80182
	bool

config ARCH_CHIP_Z80195
	bool

config ARCH_CHIP_Z8L180
	bool

config ARCH_CHIP_Z8L182
	bool

config ARCH_CHIP_Z8S180
	bool

config ARCH_CHIP_Z8
	bool

config ARCH_CHIP_EZ80
	bool

config HAVE_LOWSERIALINIT
	bool

config ARCH_CHIP
	string
	default "z80"		if ARCH_CHIP_Z80
	default "z180"		if ARCH_CHIP_Z180
	default "z8"		if ARCH_CHIP_Z8
	default "ez80"		if ARCH_CHIP_EZ80

source "arch/z80/src/common/Kconfig"
source "arch/z80/src/z80/Kconfig"
source "arch/z80/src/z180/Kconfig"
source "arch/z80/src/z8/Kconfig"
source "arch/z80/src/ez80/Kconfig"

endif
```
