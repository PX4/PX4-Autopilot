## nuttx/binfmt/Kconfig
```kconfig
#
# For a description of the syntax of this configuration file,
# see misc/tools/kconfig-language.txt.
#

config BINFMT_DISABLE
	bool "Disble BINFMT support"
	default n
	---help---
		By default, support for loadable binary formats is built.  This logic
		may be suppressed be defining this setting.

if !BINFMT_DISABLE

config BINFMT_EXEPATH
	bool "Support PATH variable"
	default n
	depends on !DISABLE_ENVIRON
	---help---
		Use the contents of the PATH environment variable to locate executable
		files.  Default: n

config PATH_INITIAL
	string "Initial PATH Value"
	default ""
	depends on BINFMT_EXEPATH
	---help---
		The initial value of the PATH variable.  This is the colon-separated
		list of absolute paths.  E.g., "/bin:/usr/bin:/sbin"

config NXFLAT
	bool "Enable the NXFLAT Binary Format"
	default n
	select PIC
	---help---
		Enable support for the NXFLAT binary format.  Default: n

if NXFLAT
source binfmt/libnxflat/Kconfig
endif

config ELF
	bool "Enable the ELF Binary Format"
	default n
	---help---
		Enable support for the ELF binary format.  Default: n

if ELF
source binfmt/libelf/Kconfig
endif

config BUILTIN
	bool "Support Builtin Applications"
	default n
	---help---
		Enable support for builtin applications.  This features assigns a string
		name to an application and in addition if FS_BINFS is defined, retaining
		those names in a file system from which they can be executed.  This feature
		is also the underlying requirement to support built-in applications in the
		NuttShell (NSH).

if BUILTIN
source binfmt/libbuiltin/Kconfig
endif

endif

config PIC
	bool
	default n

config BINFMT_CONSTRUCTORS
	bool "C++ Static Constructor Support"
	default n
	depends on HAVE_CXX && SCHED_STARTHOOK && ELF
	---help---
		Build in support for C++ constructors in loaded modules.  Currently
		only support for ELF binary formats.

config SYMTAB_ORDEREDBYNAME
	bool "Symbol Tables Ordered by Name"
	default n
```

## nuttx/binfmt/libelf/Kconfig
```kconfig
#
# For a description of the syntax of this configuration file,
# see misc/tools/kconfig-language.txt.
#

config ELF_ALIGN_LOG2
	int "Log2 Section Alignment"
	default 2
	---help---
		Align all sections to this Log2 value:  0->1, 1->2, 2->4, etc.

config ELF_STACKSIZE
	int "ELF Stack Size"
	default 2048
	---help---
		This is the default stack size that will will be used when starting ELF binaries.

config ELF_BUFFERSIZE
	int "ELF I/O Buffer Size"
	default 128
	---help---
		This is an I/O buffer that is used to access the ELF file.  Variable length items
		will need to be read (such as symbol names).  This is really just this initial
		size of the buffer; it will be reallocated as necessary to hold large symbol
		names).  Default: 128

config ELF_BUFFERINCR
	int "ELF I/O Buffer Realloc Increment"
	default 32
	---help---
		This is an I/O buffer that is used to access the ELF file.  Variable length items
		will need to be read (such as symbol names).  This value specifies the size
		increment to use each time the buffer is reallocated.  Default: 32

config ELF_DUMPBUFFER
	bool "Dump ELF buffers"
	default n
	depends on DEBUG && DEBUG_VERBOSE
	---help---
		Dump various ELF buffers for debug purposes
```

## nuttx/binfmt/libnxflat/Kconfig
```kconfig
#
# For a description of the syntax of this configuration file,
# see misc/tools/kconfig-language.txt.
#

config NXFLAT_DUMPBUFFER
	bool "Dump NXFLAT buffers"
	default n
	depends on DEBUG && DEBUG_VERBOSE
```
