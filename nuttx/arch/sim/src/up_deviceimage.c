/****************************************************************************
 * up_deviceimage.c
 *
 *   Copyright (C) 2007, 2009 Gregory Nutt. All rights reserved.
 *   Author: Gregory Nutt <gnutt@nuttx.org>
 *
 * Redistribution and use in source and binary forms, with or without
 * modification, are permitted provided that the following conditions
 * are met:
 *
 * 1. Redistributions of source code must retain the above copyright
 *    notice, this list of conditions and the following disclaimer.
 * 2. Redistributions in binary form must reproduce the above copyright
 *    notice, this list of conditions and the following disclaimer in
 *    the documentation and/or other materials provided with the
 *    distribution.
 * 3. Neither the name NuttX nor the names of its contributors may be
 *    used to endorse or promote products derived from this software
 *    without specific prior written permission.
 *
 * THIS SOFTWARE IS PROVIDED BY THE COPYRIGHT HOLDERS AND CONTRIBUTORS
 * "AS IS" AND ANY EXPRESS OR IMPLIED WARRANTIES, INCLUDING, BUT NOT
 * LIMITED TO, THE IMPLIED WARRANTIES OF MERCHANTABILITY AND FITNESS
 * FOR A PARTICULAR PURPOSE ARE DISCLAIMED. IN NO EVENT SHALL THE
 * COPYRIGHT OWNER OR CONTRIBUTORS BE LIABLE FOR ANY DIRECT, INDIRECT,
 * INCIDENTAL, SPECIAL, EXEMPLARY, OR CONSEQUENTIAL DAMAGES (INCLUDING,
 * BUT NOT LIMITED TO, PROCUREMENT OF SUBSTITUTE GOODS OR SERVICES; LOSS
 * OF USE, DATA, OR PROFITS; OR BUSINESS INTERRUPTION) HOWEVER CAUSED
 * AND ON ANY THEORY OF LIABILITY, WHETHER IN CONTRACT, STRICT
 * LIABILITY, OR TORT (INCLUDING NEGLIGENCE OR OTHERWISE) ARISING IN
 * ANY WAY OUT OF THE USE OF THIS SOFTWARE, EVEN IF ADVISED OF THE
 * POSSIBILITY OF SUCH DAMAGE.
 *
 ****************************************************************************/

/****************************************************************************
 * Included Files
 ****************************************************************************/

#ifdef VFAT_STANDALONE
# include <stdio.h>
# include <stdlib.h>
# include <zlib.h>
#else
# include <nuttx/config.h>
# include <stdlib.h>
# include <debug.h>
# include <zlib.h>
# include "up_internal.h"
#endif

/****************************************************************************
 * Private Definitions
 ****************************************************************************/

#ifdef VFAT_STANDALONE
# define sdbg(format, arg...) printf(format, ##arg)
#endif

/****************************************************************************
 * Private Types
 ****************************************************************************/

/****************************************************************************
 * Private Function Prototypes
 ****************************************************************************/

/****************************************************************************
 * Private Data
 ****************************************************************************/

/* This array holds a compressed VFAT file system created with:
 *
 *   /sbin/mkdosfs -C -F 32 -I -n "NuttXTestVol" -S 512 -v nuttx-test.vfat 1024
 *   sudo mkdir /mnt/loop
 *   sudo mount -o loop nuttx-test.vfat /mnt/loop
 *   mkdir /mnt/loop/TestDir
 *   echo "This is a test" >/mnt/loop/TestDir/TestFile.txt
 *   sudo umount /mnt/loop
 *   gzip nuttx-test.vfat
 *   xxd -g 1 nuttx-test.vfat.gz >some-file
 *
 * Then manually massaged from the gzip xxd output to zlib format.  See
 * http://www.faqs.org/rfcs/rfc1952.html.  This amounts to:
 *
 *   Remove all of the leading bytes through the null terminator of the file name
 *   Remove the last 8 bytes
 *   Add 0x08, 0x1d to the beginning.
 */

static const unsigned char g_vfatdata[] =
{
    0x08, 0x1d, 0xed, 0xdd, 0xcf, 0x6a, 0x13, 0x41, 0x18, 0x00, 0xf0, 0xa9, 0x16, 0x5b, 0x2a, 0x6d,
    0x73, 0x12, 0x3c, 0x39, 0x78, 0xf3, 0xb2, 0x87, 0x0a, 0x3d, 0x78, 0x32, 0xd0, 0x06, 0x0a, 0xa2,
    0xa5, 0xa6, 0xa5, 0x17, 0x95, 0x2d, 0xd9, 0x6a, 0x68, 0x4c, 0xda, 0xec, 0x8a, 0x2d, 0x78, 0xf3,
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    0x00, 0x00, 0x00, 0x00, 0x00, 0xe0, 0x77, 0x7d, 0x06
};


/****************************************************************************
 * Private Functions
 ****************************************************************************/

/****************************************************************************
 * Public Functions
 ****************************************************************************/

/****************************************************************************
 * Name: up_deviceimage
 *
 * Description: Return an allocated buffer representing an in-memory VFAT
 *   file system.
 *
 ****************************************************************************/

char *up_deviceimage(void)
{
    char    *pbuffer;
    int      bufsize = 1024*1024;
    int      offset  = 0;
    z_stream strm;
    int      ret;

    /* Ininitilize inflate state */

    strm.zalloc   = Z_NULL;
    strm.zfree    = Z_NULL;
    strm.opaque   = Z_NULL;
    strm.avail_in = 0;
    strm.next_in  = Z_NULL;
    ret           = inflateInit(&strm);
    if (ret != Z_OK)
      {
        sdbg("inflateInit FAILED: ret=%d msg=\"%s\"\n", ret, strm.msg ? strm.msg : "No message" );
        return NULL;
      }

    /* Allocate a buffer to hold the decompressed buffer.  We may have
     * to reallocate this a few times to get the size right.
     */
    pbuffer = (char*)malloc(bufsize);

    /* Set up the input buffer */

    strm.avail_in = sizeof(g_vfatdata);
    strm.next_in = (Bytef*)g_vfatdata;

    /* Run inflate() on input until output buffer not full */

    do {
        /* Set up to catch the next output chunk in the output buffer */

        strm.avail_out = bufsize - offset;
        strm.next_out  = (Bytef*)&pbuffer[offset];

        /* inflate */

        ret = inflate(&strm, Z_NO_FLUSH);

        /* Handle inflate() error return values */

        switch (ret)
          {
            case Z_NEED_DICT:
            case Z_DATA_ERROR:
            case Z_MEM_ERROR:
            case Z_STREAM_ERROR:
                sdbg("inflate FAILED: ret=%d msg=\"%s\"\n", ret, strm.msg ? strm.msg : "No message" );
                (void)inflateEnd(&strm);
                free(pbuffer);
                return NULL;
          }

        /* If avail_out is zero, then inflate() returned only
         * because it is out of buffer space.  In this case, we
         * will have to reallocate the buffer and try again.
         */

        if (strm.avail_out == 0)
          {
            int newbufsize = bufsize + 128*1024;
            char *newbuffer = realloc(pbuffer, newbufsize);
            if (!newbuffer)
              {
                free(pbuffer);
                return NULL;
              }
            else
              {
                pbuffer = newbuffer;
                offset  = bufsize;
                bufsize = newbufsize;
              }
          }
        else
          {
             /* There are unused bytes in the buffer, reallocate to
              * correct size.
              */

             int newbufsize = bufsize - strm.avail_out;
             char *newbuffer = realloc(pbuffer, newbufsize);
             if (!newbuffer)
               {
                free(pbuffer);
                return NULL;
              }
            else
              {
                pbuffer = newbuffer;
                bufsize = newbufsize;
              }
          }
    } while (strm.avail_out == 0 && ret != Z_STREAM_END);

    (void)inflateEnd(&strm);
    return pbuffer;
}

/****************************************************************************
 * Name: main
 *
 * Description: Used to test decompression logic
 *
 *  gcc -g -Wall -DVFAT_STANDALONE -lz -o vfat-test up_deviceimage.c
 *
 ****************************************************************************/

#ifdef VFAT_STANDALONE
int main(int argc, char **argv, char **envp)
{
    char *deviceimage;
    int cmf;
    int fdict;
    int flg;
    int check;

    cmf = g_vfatdata[0];
    printf("CMF=%02x: CM=%d CINFO=%d\n", cmf, cmf &0x0f, cmf >> 4);

    flg   = g_vfatdata[1];
    fdict = (flg >> 5) & 1;

    printf("FLG=%02x: FCHECK=%d FDICT=%d FLEVEL=%d\n", flg, flg &0x1f, fdict, flg >> 6);

    /* The FCHECK value must be such that CMF and FLG, when viewed as
     * a 16-bit unsigned integer stored in MSB order (CMF*256 + FLG),
     * is a multiple of 31.
     */

    check = cmf*256 + flg;
    if (check % 31 != 0)
    {
        printf("Fails check: %04x is not a multiple of 31\n", check);
    }

    deviceimage = up_deviceimage();
    if (deviceimage)
    {
        printf("Inflate SUCCEEDED\n");
        free(deviceimage);
        return 0;
    }
    else
    {
        printf("Inflate FAILED\n");
        return 1;
    }
}
#endif
