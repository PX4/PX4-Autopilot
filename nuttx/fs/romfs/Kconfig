## platforms/common/px4_work_queue/Kconfig
```kconfig
#
# Work Queue Configuration
#

menu "Work Queue Configuration"

config WQ_RATE_CTRL_STACKSIZE
	int "Stack size for wq:rate_ctrl"
	default 3150
	range 1000 10000
	help
	  Sets the stack size in bytes for the rate_ctrl work queue.

config WQ_RATE_CTRL_PRIORITY
	int "Relative priority for wq:rate_ctrl"
	default 0
	range -255 0
	help
	  Sets the relative priority for the rate_ctrl work queue.

menu "SPI Bus Work Queues"

config WQ_SPI_STACKSIZE
	int "Stack size for SPI work queues"
	default 2392
	range 1000 10000
	help
	  Sets the stack size for all SPI work queues (SPI0-SPI6).

config WQ_SPI0_PRIORITY
	int "Relative priority for wq:SPI0"
	default -1
	range -255 0
	help
	  Sets the relative priority for the SPI0 work queue.

config WQ_SPI1_PRIORITY
	int "Relative priority for wq:SPI1"
	default -2
	range -255 0
	help
	  Sets the relative priority for the SPI1 work queue.

config WQ_SPI2_PRIORITY
	int "Relative priority for wq:SPI2"
	default -3
	range -255 0
	help
	  Sets the relative priority for the SPI2 work queue.

config WQ_SPI3_PRIORITY
	int "Relative priority for wq:SPI3"
	default -4
	range -255 0
	help
	  Sets the relative priority for the SPI3 work queue.

config WQ_SPI4_PRIORITY
	int "Relative priority for wq:SPI4"
	default -5
	range -255 0
	help
	  Sets the relative priority for the SPI4 work queue.

config WQ_SPI5_PRIORITY
	int "Relative priority for wq:SPI5"
	default -6
	range -255 0
	help
	  Sets the relative priority for the SPI5 work queue.

config WQ_SPI6_PRIORITY
	int "Relative priority for wq:SPI6"
	default -7
	range -255 0
	help
	  Sets the relative priority for the SPI6 work queue.

endmenu # SPI Bus Work Queues

menu "I2C Bus Work Queues"

config WQ_I2C_STACKSIZE
	int "Stack size for I2C work queues"
	default 2336
	range 1000 10000
	help
	  Sets the stack size for all I2C work queues (I2C0-I2C4).

config WQ_I2C0_PRIORITY
	int "Relative priority for wq:I2C0"
	default -8
	range -255 0
	help
	  Sets the relative priority for the I2C0 work queue.

config WQ_I2C1_PRIORITY
	int "Relative priority for wq:I2C1"
	default -9
	range -255 0
	help
	  Sets the relative priority for the I2C1 work queue.

config WQ_I2C2_PRIORITY
	int "Relative priority for wq:I2C2"
	default -10
	range -255 0
	help
	  Sets the relative priority for the I2C2 work queue.

config WQ_I2C3_PRIORITY
	int "Relative priority for wq:I2C3"
	default -11
	range -255 0
	help
	  Sets the relative priority for the I2C3 work queue.

config WQ_I2C4_PRIORITY
	int "Relative priority for wq:I2C4"
	default -12
	range -255 0
	help
	  Sets the relative priority for the I2C4 work queue.

endmenu # I2C Bus Work Queues

config WQ_NAV_AND_CONTROLLERS_STACKSIZE
	int "Stack size for nav_and_controllers"
	default 2240
	range 1000 10000
	help
	  Sets the stack size for the nav_and_controllers work queue.

config WQ_NAV_AND_CONTROLLERS_PRIORITY
	int "Relative priority for nav_and_controllers"
	default -13
	range -255 0
	help
	  Sets the relative priority for the nav_and_controllers work queue.

menu "INS Work Queues"

config WQ_INS_STACKSIZE
	int "Stack size for INS work queues"
	default 6000
	range 1000 10000
	help
	  Sets the stack size for all INS work queues (INS0-INS3).

config WQ_INS0_PRIORITY
	int "Relative priority for wq:INS0"
	default -14
	range -255 0
	help
	  Sets the relative priority for the INS0 work queue.

config WQ_INS1_PRIORITY
	int "Relative priority for wq:INS1"
	default -15
	range -255 0
	help
	  Sets the relative priority for the INS1 work queue.

config WQ_INS2_PRIORITY
	int "Relative priority for wq:INS2"
	default -16
	range -255 0
	help
	  Sets the relative priority for the INS2 work queue.

config WQ_INS3_PRIORITY
	int "Relative priority for wq:INS3"
	default -17
	range -255 0
	help
	  Sets the relative priority for the INS3 work queue.

endmenu # INS Work Queues

config WQ_HP_DEFAULT_STACKSIZE
	int "Stack size for hp_default"
	default 2800
	range 1000 10000
	help
	  Sets the stack size for the hp_default work queue.

config WQ_HP_DEFAULT_PRIORITY
	int "Relative priority for hp_default"
	default -18
	range -255 0
	help
	  Sets the relative priority for the hp_default work queue.

config WQ_UAVCAN_STACKSIZE
	int "Stack size for uavcan"
	default 3624
	range 1000 10000
	help
	  Sets the stack size for the uavcan work queue.

config WQ_UAVCAN_PRIORITY
	int "Relative priority for wq:uavcan"
	default -19
	range -255 0
	help
	  Sets the relative priority for the uavcan work queue.

menu "TTY Bus Work Queues"

config WQ_TTY_STACKSIZE
	int "Stack size for TTY work queues"
	default 1728
	range 1000 10000
	help
	  Sets the stack size for all TTY work queues.

config WQ_TTY_S0_PRIORITY
	int "Relative priority for wq:ttyS0"
	default -21
	range -255 0
	help
	  Sets the relative priority for the ttyS0 work queue.

config WQ_TTY_S1_PRIORITY
	int "Relative priority for wq:ttyS1"
	default -22
	range -255 0
	help
	  Sets the relative priority for the ttyS1 work queue.

config WQ_TTY_S2_PRIORITY
	int "Relative priority for wq:ttyS2"
	default -23
	range -255 0
	help
	  Sets the relative priority for the ttyS2 work queue.

config WQ_TTY_S3_PRIORITY
	int "Relative priority for wq:ttyS3"
	default -24
	range -255 0
	help
	  Sets the relative priority for the ttyS3 work queue.

config WQ_TTY_S4_PRIORITY
	int "Relative priority for wq:ttyS4"
	default -25
	range -255 0
	help
	  Sets the relative priority for the ttyS4 work queue.

config WQ_TTY_S5_PRIORITY
	int "Relative priority for wq:ttyS5"
	default -26
	range -255 0
	help
	  Sets the relative priority for the ttyS5 work queue.

config WQ_TTY_S6_PRIORITY
	int "Relative priority for wq:ttyS6"
	default -27
	range -255 0
	help
	  Sets the relative priority for the ttyS6 work queue.

config WQ_TTY_S7_PRIORITY
	int "Relative priority for wq:ttyS7"
	default -28
	range -255 0
	help
	  Sets the relative priority for the ttyS7 work queue.

config WQ_TTY_S8_PRIORITY
	int "Relative priority for wq:ttyS8"
	default -29
	range -255 0
	help
	  Sets the relative priority for the ttyS8 work queue.

config WQ_TTY_S9_PRIORITY
	int "Relative priority for wq:ttyS9"
	default -30
	range -255 0
	help
	  Sets the relative priority for the ttyS9 work queue.

config WQ_TTY_ACM0_PRIORITY
	int "Relative priority for wq:ttyACM0"
	default -31
	range -255 0
	help
	  Sets the relative priority for the ttyACM0 work queue.

config WQ_TTY_UNKNOWN_PRIORITY
	int "Relative priority for wq:ttyUnknown"
	default -32
	range -255 0
	help
	  Sets the relative priority for the ttyUnknown work queue.

endmenu # TTY Bus Work Queues

config WQ_LP_DEFAULT_STACKSIZE
	int "Stack size for lp_default"
	default 3500
	range 1000 10000
	help
	  Sets the stack size for the lp_default work queue.

config WQ_LP_DEFAULT_PRIORITY
	int "Relative priority for wq:lp_default"
	default -50
	range -255 0
	help
	  Sets the relative priority for the lp_default work queue.

endmenu # Work Queue Configuration
```

## platforms/nuttx/nuttx-configs/aerofc-v1/nsh/defconfig
```kconfig
CONFIG_ARCH="arm"
CONFIG_ARCH_BOARD_CUSTOM=y
CONFIG_ARCH_BOARD_CUSTOM_DIR="../../nuttx-configs/aerofc-v1"
CONFIG_ARCH_BOARD_CUSTOM_NAME="aerofc-v1"
CONFIG_ARCH_BOARD_CUSTOM_DIR_RELPATH=y
CONFIG_ARCH_CHIP_STM32F429V=y
CONFIG_ARCH_CHIP_STM32=y
CONFIG_ARCH_HIPRI_INTERRUPT=y
CONFIG_ARCH_INTERRUPTSTACK=750
CONFIG_ARCH_MATH_H=y
CONFIG_ARCH_STACKDUMP=y
CONFIG_ARMV7M_CMNVECTOR=y
CONFIG_ARMV7M_MEMCPY=y
CONFIG_BOARDCTL_RESET=y
CONFIG_BOARD_LOOPSPERMSEC=16717
CONFIG_BUILTIN=y
CONFIG_C99_BOOL8=y
CONFIG_DEBUG_SYMBOLS=y
CONFIG_DEV_FIFO_SIZE=0
CONFIG_DEV_PIPE_SIZE=70
# CONFIG_DISABLE_OS_API is not set
CONFIG_EXAMPLES_NSH=y
CONFIG_FAT_LCNAMES=y
CONFIG_FAT_LFN=y
CONFIG_FDCLONE_STDIO=y
CONFIG_FS_BINFS=y
CONFIG_FS_FATTIME=y
CONFIG_FS_FAT=y
CONFIG_FS_PROCFS=y
CONFIG_FS_ROMFS=y
CONFIG_GRAN_INTR=y
CONFIG_GRAN=y
CONFIG_HAVE_CXXINITIALIZE=y
CONFIG_HAVE_CXX=y
CONFIG_I2C_RESET=y
CONFIG_I2C=y
CONFIG_IDLETHREAD_STACKSIZE=500
CONFIG_LIBC_FLOATINGPOINT=y
CONFIG_LIBC_STRERROR=y
CONFIG_MAX_WDOGPARMS=2
CONFIG_MEMSET_64BIT=y
CONFIG_MEMSET_OPTSPEED=y
CONFIG_MM_REGIONS=2
CONFIG_MTD_BYTE_WRITE=y
CONFIG_MTD_PARTITION=y
CONFIG_MTD=y
CONFIG_NFILE_DESCRIPTORS=54
CONFIG_NFILE_STREAMS=8
CONFIG_NSH_ARCHINIT=y
CONFIG_NSH_ARCHROMFS=y
CONFIG_NSH_BUILTIN_APPS=y
# CONFIG_NSH_CMDOPT_DF_H is not set
# CONFIG_NSH_CMDOPT_HEXDUMP is not set
CONFIG_NSH_DISABLE_IFUPDOWN=y
CONFIG_NSH_DISABLE_PSSTACKUSAGE=y
CONFIG_NSH_DISABLE_REBOOT=y
CONFIG_NSH_DISABLE_TELNETD=y
CONFIG_NSH_FILEIOSIZE=512
CONFIG_NSH_LINELEN=128
CONFIG_NSH_MAXARGUMENTS=12
CONFIG_NSH_NESTDEPTH=8
CONFIG_NSH_READLINE=y
CONFIG_NSH_ROMFSETC=y
CONFIG_NSH_ROMFSSECTSIZE=128
CONFIG_NSH_STRERROR=y
CONFIG_PIPES=y
CONFIG_PREALLOC_MQ_MSGS=4
CONFIG_PREALLOC_TIMERS=50
CONFIG_PREALLOC_WDOGS=50
CONFIG_PRIORITY_INHERITANCE=y
CONFIG_PTHREAD_STACK_MIN=512
CONFIG_RAM_SIZE=262144
CONFIG_RAM_START=0x20000000
CONFIG_RAW_BINARY=y
CONFIG_RTC_DATETIME=y
CONFIG_RTC_HSECLOCK=y
CONFIG_RTC_MAGIC_REG=1
CONFIG_RTC=y
CONFIG_SCHED_ATEXIT=y
CONFIG_SCHED_HPWORKPERIOD=5000
CONFIG_SCHED_HPWORKPRIORITY=249
CONFIG_SCHED_HPWORKSTACKSIZE=1800
CONFIG_SCHED_HPWORK=y
CONFIG_SCHED_INSTRUMENTATION=y
CONFIG_SCHED_LPWORKSTACKSIZE=1800
CONFIG_SCHED_LPWORK=y
CONFIG_SCHED_WAITPID=y
CONFIG_SDCLONE_DISABLE=y
CONFIG_SEM_NNESTPRIO=8
CONFIG_SEM_PREALLOCHOLDERS=0
CONFIG_SERIAL_DISABLE_REORDERING=y
CONFIG_SERIAL_TERMIOS=y
CONFIG_SIG_SIGWORK=4
CONFIG_STACK_COLORATION=y
CONFIG_START_DAY=30
CONFIG_START_MONTH=11
CONFIG_START_YEAR=2016
CONFIG_STDIO_BUFFER_SIZE=32
CONFIG_STM32_BBSRAM_FILES=5
CONFIG_STM32_BKPSRAM=y
CONFIG_STM32_CCMDATARAM=y
# CONFIG_STM32_CCMEXCLUDE is not set
CONFIG_STM32_DISABLE_IDLE_SLEEP_DURING_DEBUG=y
CONFIG_STM32_DMA1=y
CONFIG_STM32_DMA2=y
CONFIG_STM32_FLASH_CONFIG_I=y
CONFIG_STM32_FLASH_WORKAROUND_DATA_CACHE_CORRUPTION_ON_RWW=y
CONFIG_STM32_FLOWCONTROL_BROKEN=y
CONFIG_STM32_I2C1=y
CONFIG_STM32_I2C2=y
CONFIG_STM32_I2C3=y
CONFIG_STM32_I2CTIMEOMS=10
CONFIG_STM32_I2CTIMEOTICKS=10
CONFIG_STM32_JTAG_SW_ENABLE=y
CONFIG_STM32_OTGFS=y
CONFIG_STM32_PWR=y
CONFIG_STM32_SERIALBRK_BSDCOMPAT=y
CONFIG_STM32_SPI1=y
CONFIG_STM32_TIM10=y
CONFIG_STM32_TIM11=y
CONFIG_STM32_TIM1=y
CONFIG_STM32_TIM8=y
CONFIG_STM32_TIM9=y
CONFIG_STM32_UART4=y
CONFIG_STM32_UART5=y
CONFIG_STM32_UART7=y
CONFIG_STM32_USART1=y
CONFIG_STM32_USART2=y
CONFIG_STM32_USART6=y
CONFIG_STM32_USART_BREAKS=y
CONFIG_STM32_USART_SINGLEWIRE=y
CONFIG_STM32_WWDG=y
CONFIG_TASK_NAME_SIZE=24
CONFIG_TIME_EXTENDED=y
CONFIG_UART4_BAUD=57600
CONFIG_UART4_RXBUFSIZE=300
CONFIG_UART4_RXDMA=y
CONFIG_UART4_TXBUFSIZE=300
CONFIG_UART5_RXDMA=y
CONFIG_UART7_BAUD=57600
CONFIG_UART7_RXBUFSIZE=300
CONFIG_UART7_RXDMA=y
CONFIG_UART7_TXBUFSIZE=300
CONFIG_USART1_RXBUFSIZE=600
CONFIG_USART1_RXDMA=y
CONFIG_USART1_TXBUFSIZE=2500
CONFIG_USART2_BAUD=57600
CONFIG_USART2_RXBUFSIZE=600
CONFIG_USART2_RXDMA=y
CONFIG_USART2_TXBUFSIZE=1100
CONFIG_USART6_BAUD=57600
CONFIG_USART6_RXBUFSIZE=300
CONFIG_USART6_RXDMA=y
CONFIG_USART6_SERIAL_CONSOLE=y
CONFIG_USART6_TXBUFSIZE=300
CONFIG_USEC_PER_TICK=1000
CONFIG_USER_ENTRYPOINT="nsh_main"
CONFIG_USERMAIN_STACKSIZE=2500
```

## platforms/nuttx/nuttx-configs/px4-same70xplained-v1/nsh/defconfig
```kconfig
CONFIG_ARCH="arm"
CONFIG_ARCH_BOARD_CUSTOM=y
CONFIG_ARCH_BOARD_CUSTOM_DIR="../../nuttx-configs/px4-same70xplained-v1"
CONFIG_ARCH_BOARD_CUSTOM_NAME="px4-same70xplained-v1"
CONFIG_ARCH_BOARD_CUSTOM_DIR_RELPATH=y
CONFIG_ARCH_CHIP_SAME70Q21=y
CONFIG_ARCH_CHIP_SAME70Q=y
CONFIG_ARCH_CHIP_SAME70=y
CONFIG_ARCH_CHIP_SAMV7=y
# CONFIG_ARCH_DPFPU is not set
CONFIG_ARCH_INTERRUPTSTACK=4048
CONFIG_ARCH_MATH_H=y
# CONFIG_ARCH_RAMFUNCS is not set
CONFIG_ARCH_STACKDUMP=y
CONFIG_ARMV7M_DCACHE_WRITETHROUGH=y
CONFIG_ARMV7M_DCACHE=y
CONFIG_ARMV7M_ICACHE=y
CONFIG_ARMV7M_MEMCPY=y
CONFIG_ARMV7M_USEBASEPRI=y
CONFIG_AT24XX_ADDR=0x57
CONFIG_AT24XX_EXTENDED=y
CONFIG_AT24XX_EXTSIZE=160
CONFIG_AT24XX_SIZE=2
CONFIG_BOARD_CRASHDUMP=y
CONFIG_BOARDCTL_RESET=y
CONFIG_BOARD_LOOPSPERMSEC=51262
CONFIG_BOARD_RESET_ON_CRASH=y
CONFIG_BUILTIN=y
CONFIG_C99_BOOL8=y
CONFIG_CDCACM_PRODUCTID=0x006e
CONFIG_CDCACM_PRODUCTSTR="PX4 SAME70-XPLD V1.x"
CONFIG_CDCACM_VENDORID=0x26ac
CONFIG_CDCACM_VENDORSTR="3D Robotics"
CONFIG_CDCACM=y
CONFIG_DEBUG_FULLOPT=y
CONFIG_DEBUG_SYMBOLS=y
CONFIG_DEFAULT_SMALL=y
CONFIG_DEV_FIFO_SIZE=70
CONFIG_DEV_PIPE_MAXSIZE=1024
CONFIG_DEV_PIPE_SIZE=70
# CONFIG_DISABLE_OS_API is not set
# CONFIG_DISABLE_PSEUDOFS_OPERATIONS is not set
CONFIG_EXAMPLES_MOUNT=y
CONFIG_EXAMPLES_NSH=y
CONFIG_FAT_DMAMEMORY=y
CONFIG_FAT_LCNAMES=y
CONFIG_FAT_LFN=y
CONFIG_FDCLONE_STDIO=y
CONFIG_FS_BINFS=y
CONFIG_FS_FATTIME=y
CONFIG_FS_FAT=y
CONFIG_FS_PROCFS_REGISTER=y
CONFIG_FS_PROCFS=y
CONFIG_FS_ROMFS=y
CONFIG_GRAN_INTR=y
CONFIG_GRAN=y
CONFIG_HAVE_CXXINITIALIZE=y
CONFIG_HAVE_CXX=y
CONFIG_I2C_RESET=y
CONFIG_IDLETHREAD_STACKSIZE=500
CONFIG_LIBC_FLOATINGPOINT=y
CONFIG_LIBC_LONG_LONG=y
CONFIG_LIBC_STRERROR=y
CONFIG_MAX_WDOGPARMS=2
CONFIG_MEMSET_64BIT=y
CONFIG_MEMSET_OPTSPEED=y
# CONFIG_MMCSD_MMCSUPPORT is not set
CONFIG_MMCSD_MULTIBLOCK_DISABLE=y
CONFIG_MMCSD_SDIO=y
# CONFIG_MMCSD_SPI is not set
CONFIG_MTD_AT24XX=y
CONFIG_MTD_BYTE_WRITE=y
CONFIG_MTD_CONFIG=y
CONFIG_MTD_PARTITION=y
CONFIG_MTD=y
CONFIG_NFILE_DESCRIPTORS=54
CONFIG_NFILE_STREAMS=8
CONFIG_NSH_ARCHINIT=y
CONFIG_NSH_ARCHROMFS=y
CONFIG_NSH_ARGCAT=y
CONFIG_NSH_BUILTIN_APPS=y
CONFIG_NSH_CMDPARMS=y
# CONFIG_NSH_DISABLE_BASENAME is not set
# CONFIG_NSH_DISABLEBG is not set
# CONFIG_NSH_DISABLE_CMP is not set
# CONFIG_NSH_DISABLE_DD is not set
# CONFIG_NSH_DISABLE_DF is not set
# CONFIG_NSH_DISABLE_DIRNAME is not set
# CONFIG_NSH_DISABLE_EXEC is not set
# CONFIG_NSH_DISABLE_EXIT is not set
# CONFIG_NSH_DISABLE_GET is not set
CONFIG_NSH_DISABLE_IFCONFIG=y
CONFIG_NSH_DISABLE_IFUPDOWN=y
# CONFIG_NSH_DISABLE_ITEF is not set
# CONFIG_NSH_DISABLE_LOOPS is not set
CONFIG_NSH_DISABLE_MB=y
CONFIG_NSH_DISABLE_MH=y
# CONFIG_NSH_DISABLE_MKFATFS is not set
CONFIG_NSH_DISABLE_PSSTACKUSAGE=y
# CONFIG_NSH_DISABLESCRIPT is not set
# CONFIG_NSH_DISABLE_SEMICOLON is not set
# CONFIG_NSH_DISABLE_TIME is not set
# CONFIG_NSH_DISABLE_UNAME is not set
CONFIG_NSH_LINELEN=128
CONFIG_NSH_MAXARGUMENTS=12
CONFIG_NSH_NESTDEPTH=8
CONFIG_NSH_ROMFSETC=y
CONFIG_NSH_ROMFSSECTSIZE=128
CONFIG_NSH_STRERROR=y
CONFIG_PIPES=y
CONFIG_PREALLOC_MQ_MSGS=4
CONFIG_PREALLOC_TIMERS=50
CONFIG_PREALLOC_WDOGS=50
CONFIG_PRIORITY_INHERITANCE=y
CONFIG_PTHREAD_STACK_MIN=512
CONFIG_RAM_SIZE=393216
CONFIG_RAM_START=0x20400000
CONFIG_RAW_BINARY=y
CONFIG_RTC_DATETIME=y
CONFIG_RTC=y
CONFIG_SAMV7_GPIOA_IRQ=y
CONFIG_SAMV7_GPIOC_IRQ=y
CONFIG_SAMV7_GPIO_IRQ=y
CONFIG_SAMV7_HSMCI0=y
CONFIG_SAMV7_RTC=y
CONFIG_SAMV7_SDRAMC=y
# CONFIG_SAMV7_SDRAMHEAP is not set
CONFIG_SAMV7_SDRAMSIZE=2097152
CONFIG_SAMV7_SPI0=y
CONFIG_SAMV7_SYSTEMRESET=y
CONFIG_SAMV7_TC0=y
CONFIG_SAMV7_TC1=y
CONFIG_SAMV7_TC2=y
CONFIG_SAMV7_TC3=y
CONFIG_SAMV7_TWIHS0=y
# CONFIG_SAMV7_UART0 is not set
# CONFIG_SAMV7_UART2 is not set
# CONFIG_SAMV7_UART4 is not set
CONFIG_SAMV7_USART0=y
CONFIG_SAMV7_USART1=y
CONFIG_SAMV7_USBDEVHS=y
CONFIG_SAMV7_USBHS_EP7DMA_WAR=y
CONFIG_SAMV7_XDMAC=y
CONFIG_SCHED_ATEXIT=y
CONFIG_SCHED_HPWORKPERIOD=5000
CONFIG_SCHED_HPWORKPRIORITY=249
CONFIG_SCHED_HPWORKSTACKSIZE=1800
CONFIG_SCHED_HPWORK=y
CONFIG_SCHED_INSTRUMENTATION=y
CONFIG_SCHED_LPWORKSTACKSIZE=1800
CONFIG_SCHED_LPWORK=y
CONFIG_SCHED_WAITPID=y
CONFIG_SDCLONE_DISABLE=y
CONFIG_SDIO_BLOCKSETUP=y
CONFIG_SEM_NNESTPRIO=8
CONFIG_SEM_PREALLOCHOLDERS=0
CONFIG_SERIAL_TERMIOS=y
CONFIG_SIG_SIGWORK=4
CONFIG_STACK_COLORATION=y
CONFIG_START_DAY=30
CONFIG_START_MONTH=11
CONFIG_START_YEAR=2016
CONFIG_STDIO_BUFFER_SIZE=32
CONFIG_SYSTEM_CDCACM=y
CONFIG_TASK_NAME_SIZE=24
CONFIG_TIME_EXTENDED=y
CONFIG_USART1_BAUD=57600
CONFIG_USART1_RXBUFSIZE=128
CONFIG_USART1_SERIAL_CONSOLE=y
CONFIG_USART1_TXBUFSIZE=32
CONFIG_USBDEV_BUSPOWERED=y
CONFIG_USBDEV_DUALSPEED=y
CONFIG_USBDEV_MAXPOWER=500
CONFIG_USEC_PER_TICK=1000
CONFIG_USER_ENTRYPOINT="nsh_main"
CONFIG_USERMAIN_STACKSIZE=2500
CONFIG_WATCHDOG=y
```
