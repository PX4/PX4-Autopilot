## platforms/nuttx/nuttx-configs/px4fmu-v5/Kconfig
```kconfig
#
# For a description of the syntax of this configuration file,
# see misc/tools/kconfig-language.txt.
#

if ARCH_BOARD_PX4FMU_V5

config BOARD_HAS_PROBES
	bool "Board provides GPIO or other Hardware for signaling to timing analyze."
	default y
	---help---
		This board provides GPIO FMU-CH1-6 as PROBE_1-6 to provide timing signals from selected drivers.

config BOARD_USE_PROBES
	bool "Enable the use the board provided GPIO FMU-CH1-6 as PROBE_1-6 to provide timing signals from selected drivers"
	default n
	depends on BOARD_HAS_PROBES

	---help---
		Select to use GPIO FMU-CH1-6 to provide timing signals from selected drivers.

endif
```

## platforms/nuttx/nuttx-configs/tap-v1/nsh/defconfig
```kconfig
CONFIG_ARCH="arm"
CONFIG_ARCH_BOARD_CUSTOM=y
CONFIG_ARCH_BOARD_CUSTOM_DIR="../../nuttx-configs/tap-v1"
CONFIG_ARCH_BOARD_CUSTOM_NAME="tap-v1"
CONFIG_ARCH_BOARD_CUSTOM_DIR_RELPATH=y
CONFIG_ARCH_CHIP_STM32F405RG=y
CONFIG_ARCH_CHIP_STM32=y
CONFIG_ARCH_HIPRI_INTERRUPT=y
CONFIG_ARCH_INTERRUPTSTACK=750
CONFIG_ARCH_MATH_H=y
CONFIG_ARCH_STACKDUMP=y
CONFIG_ARMV7M_CMNVECTOR=y
CONFIG_ARMV7M_MEMCPY=y
CONFIG_BOARD_CRASHDUMP=y
CONFIG_BOARDCTL_RESET=y
CONFIG_BOARD_LOOPSPERMSEC=16717
CONFIG_BOARD_RESET_ON_CRASH=y
CONFIG_BUILTIN=y
CONFIG_C99_BOOL8=y
CONFIG_CDCACM_PRODUCTID=0x0010
CONFIG_CDCACM_PRODUCTSTR="PX4 TAP v1.x"
CONFIG_CDCACM_RXBUFSIZE=270
CONFIG_CDCACM_TXBUFSIZE=300
CONFIG_CDCACM_VENDORID=0x26ac
CONFIG_CDCACM_VENDORSTR="The Autopilot"
CONFIG_CDCACM=y
CONFIG_DEBUG_SYMBOLS=y
CONFIG_DEV_FIFO_SIZE=0
CONFIG_DEV_PIPE_SIZE=70
# CONFIG_DISABLE_OS_API is not set
CONFIG_EXAMPLES_MOUNT=y
CONFIG_EXAMPLES_NSH=y
CONFIG_FAT_DMAMEMORY=y
CONFIG_FAT_LCNAMES=y
CONFIG_FAT_LFN=y
CONFIG_FDCLONE_STDIO=y
CONFIG_FS_BINFS=y
CONFIG_FS_FATTIME=y
CONFIG_FS_FAT=y
CONFIG_FS_PROCFS_REGISTER=y
CONFIG_FS_PROCFS=y
CONFIG_FS_ROMFS=y
CONFIG_GRAN_INTR=y
CONFIG_GRAN=y
CONFIG_HAVE_CXXINITIALIZE=y
CONFIG_HAVE_CXX=y
CONFIG_I2C_RESET=y
CONFIG_I2C=y
CONFIG_IDLETHREAD_STACKSIZE=500
CONFIG_LIBC_FLOATINGPOINT=y
CONFIG_LIBC_STRERROR=y
CONFIG_MAX_WDOGPARMS=2
CONFIG_MEMSET_64BIT=y
CONFIG_MEMSET_OPTSPEED=y
# CONFIG_MMCSD_HAVECARDDETECT is not set
# CONFIG_MMCSD_MMCSUPPORT is not set
CONFIG_MMCSD_MULTIBLOCK_DISABLE=y
CONFIG_MMCSD_SPICLOCK=24000000
CONFIG_MMCSD=y
CONFIG_MM_REGIONS=2
CONFIG_NFILE_DESCRIPTORS=54
CONFIG_NFILE_STREAMS=8
CONFIG_NSH_ARCHINIT=y
CONFIG_NSH_ARCHROMFS=y
CONFIG_NSH_BUILTIN_APPS=y
CONFIG_NSH_DISABLE_BASENAME=y
CONFIG_NSH_DISABLE_CMP=y
CONFIG_NSH_DISABLE_DD=y
CONFIG_NSH_DISABLE_DF=y
CONFIG_NSH_DISABLE_DIRNAME=y
CONFIG_NSH_DISABLE_HEXDUMP=y
CONFIG_NSH_DISABLE_IFCONFIG=y
CONFIG_NSH_DISABLE_IFUPDOWN=y
CONFIG_NSH_DISABLE_LOSETUP=y
CONFIG_NSH_DISABLE_MB=y
CONFIG_NSH_DISABLE_MH=y
CONFIG_NSH_DISABLE_MKFIFO=y
CONFIG_NSH_DISABLE_MKRD=y
CONFIG_NSH_DISABLE_PSSTACKUSAGE=y
CONFIG_NSH_DISABLE_PUT=y
CONFIG_NSH_DISABLE_REBOOT=y
CONFIG_NSH_DISABLE_TELNETD=y
CONFIG_NSH_DISABLE_UNAME=y
CONFIG_NSH_DISABLE_WGET=y
CONFIG_NSH_DISABLE_XD=y
CONFIG_NSH_FILEIOSIZE=512
CONFIG_NSH_LINELEN=128
CONFIG_NSH_MAXARGUMENTS=12
CONFIG_NSH_MMCSDSPIPORTNO=2
CONFIG_NSH_NESTDEPTH=8
CONFIG_NSH_READLINE=y
CONFIG_NSH_ROMFSETC=y
CONFIG_NSH_ROMFSSECTSIZE=128
CONFIG_NSH_STRERROR=y
CONFIG_PIPES=y
CONFIG_PREALLOC_MQ_MSGS=4
CONFIG_PREALLOC_TIMERS=50
CONFIG_PREALLOC_WDOGS=50
CONFIG_PRIORITY_INHERITANCE=y
CONFIG_PTHREAD_STACK_MIN=512
CONFIG_RAM_SIZE=196608
CONFIG_RAM_START=0x20000000
CONFIG_RAW_BINARY=y
CONFIG_RTC_DATETIME=y
CONFIG_RTC_HSECLOCK=y
CONFIG_RTC_MAGIC_REG=1
CONFIG_RTC=y
CONFIG_SCHED_ATEXIT=y
CONFIG_SCHED_HPWORKPERIOD=5000
CONFIG_SCHED_HPWORKPRIORITY=249
CONFIG_SCHED_HPWORKSTACKSIZE=1800
CONFIG_SCHED_HPWORK=y
CONFIG_SCHED_INSTRUMENTATION=y
CONFIG_SCHED_LPWORKSTACKSIZE=1800
CONFIG_SCHED_LPWORK=y
CONFIG_SCHED_WAITPID=y
CONFIG_SDCLONE_DISABLE=y
CONFIG_SEM_NNESTPRIO=8
CONFIG_SEM_PREALLOCHOLDERS=0
CONFIG_SERIAL_DISABLE_REORDERING=y
CONFIG_SERIAL_TERMIOS=y
CONFIG_SIG_SIGWORK=4
# CONFIG_SPI_CALLBACK is not set
CONFIG_STACK_COLORATION=y
CONFIG_START_DAY=30
CONFIG_START_MONTH=11
CONFIG_START_YEAR=2016
CONFIG_STDIO_BUFFER_SIZE=32
CONFIG_STM32_ADC1=y
CONFIG_STM32_BBSRAM_FILES=5
CONFIG_STM32_BBSRAM=y
CONFIG_STM32_BKPSRAM=y
CONFIG_STM32_CCMDATARAM=y
# CONFIG_STM32_CCMEXCLUDE is not set
CONFIG_STM32_DISABLE_IDLE_SLEEP_DURING_DEBUG=y
CONFIG_STM32_DMA1=y
CONFIG_STM32_DMA2=y
CONFIG_STM32_FLASH_PREFETCH=y
CONFIG_STM32_FLOWCONTROL_BROKEN=y
CONFIG_STM32_I2C1=y
CONFIG_STM32_I2C2=y
CONFIG_STM32_I2C3=y
CONFIG_STM32_I2CTIMEOMS=10
CONFIG_STM32_I2CTIMEOTICKS=10
CONFIG_STM32_JTAG_SW_ENABLE=y
CONFIG_STM32_OTGFS=y
CONFIG_STM32_PWR=y
CONFIG_STM32_SAVE_CRASHDUMP=y
CONFIG_STM32_SERIALBRK_BSDCOMPAT=y
CONFIG_STM32_SPI2=y
CONFIG_STM32_TIM10=y
CONFIG_STM32_TIM11=y
CONFIG_STM32_TIM12=y
CONFIG_STM32_TIM13=y
CONFIG_STM32_TIM14=y
CONFIG_STM32_TIM4=y
CONFIG_STM32_TIM5=y
CONFIG_STM32_TIM6=y
CONFIG_STM32_TIM7=y
CONFIG_STM32_TIM9=y
CONFIG_STM32_UART4=y
CONFIG_STM32_UART5=y
CONFIG_STM32_USART1=y
CONFIG_STM32_USART2=y
CONFIG_STM32_USART3=y
CONFIG_STM32_USART6=y
CONFIG_STM32_USART_BREAKS=y
CONFIG_STM32_WWDG=y
CONFIG_SYSTEM_CDCACM=y
CONFIG_TASK_NAME_SIZE=24
CONFIG_TIME_EXTENDED=y
CONFIG_UART4_DMA=y
CONFIG_UART4_RXDMA=y
CONFIG_UART5_BAUD=57600
CONFIG_UART5_DMA=y
CONFIG_UART5_RXBUFSIZE=300
CONFIG_UART5_RXDMA=y
CONFIG_UART5_TXBUFSIZE=300
CONFIG_USART1_BAUD=57600
CONFIG_USART1_DMA=y
CONFIG_USART1_RXBUFSIZE=128
CONFIG_USART1_RXDMA=y
CONFIG_USART1_TXBUFSIZE=32
CONFIG_USART2_BAUD=57600
CONFIG_USART2_DMA=y
CONFIG_USART2_RXBUFSIZE=300
CONFIG_USART2_RXDMA=y
CONFIG_USART2_TXBUFSIZE=300
CONFIG_USART3_DMA=y
CONFIG_USART3_RXBUFSIZE=32
CONFIG_USART3_RXDMA=y
CONFIG_USART3_SERIAL_CONSOLE=y
CONFIG_USART6_BAUD=57600
CONFIG_USART6_DMA=y
CONFIG_USART6_RXBUFSIZE=128
CONFIG_USART6_RXDMA=y
CONFIG_USART6_TXBUFSIZE=64
CONFIG_USBDEV_BUSPOWERED=y
CONFIG_USBDEV_MAXPOWER=500
CONFIG_USBDEV=y
CONFIG_USEC_PER_TICK=1000
CONFIG_USER_ENTRYPOINT="nsh_main"
CONFIG_USERMAIN_STACKSIZE=2500
```

## src/atena/camera_gps/Kconfig
```kconfig
menuconfig ATENA_CAMERA_GPS
	bool "camera_gps"
	default n
	---help---
		Enable support for camera_gps
```

## src/atena/test_msg/Kconfig
```kconfig
menuconfig ATENA_TEST_MSG
	bool "test_msg"
	default n
	---help---
		Enable support for test_msg
```

## src/drivers/Kconfig
```kconfig
menuconfig ADC
	bool "ADC Support"
	default n
	---help---
		Enable support for ADC

menuconfig BAROMETER
	bool "Barometer Support"
	default n
	---help---
		Enable support for all available barometer drivers
		
menuconfig BOOTLOADERS
	bool "BOOTLOADERS Support"
	default n
	---help---
		Enable support for bootloaders
		
menuconfig DIFFERENTIAL_PRESSURE
	bool "Differential pressure Support"
	default n
	---help---
		Enable support for all available differential pressure drivers
		
menuconfig GPS
	bool "GPS Support"
	default n
	---help---
		Enable support for all available GPS drivers

menuconfig IMU
	bool "IMU Support"
	default n
	---help---
		Enable support for all available IMU drivers
		
menuconfig LIGHTS
	bool "Lights Support"
	default n
	---help---
		Enable support for lights
		
if LIGHTS
#source src/drivers/lights/Kconfig
endif #LIGHTS

menuconfig MAGNETOMETER
	bool "Magnetometer Support"
	default n
	---help---
		Enable support for all available magnetometer drivers
		
menuconfig OPTICAL_FLOW
	bool "Optical flow Support"
	default n
	---help---
		Enable support for all available optical flow drivers
		
menuconfig PWM_OUT
	bool "PWM Out Support"
	default n
	---help---
		Enable support for PWM Out
		
menuconfig SAFETY_BUTTON
	bool "Safety button Support"
	default n
	---help---
		Enable support for Safety button
		
menuconfig TONE_ALARM
	bool "Tone alarm Support"
	default n
	---help---
		Enable support for tone alarm
		
menuconfig UAVCAN_V1
	bool "UAVCANv1 Support"
	default n
	---help---
		Enable support for UAVCANv1

if UAVCAN_V1
source src/drivers/uavcan_v1/Kconfig
endif #UAVCAN_V1
```

## src/drivers/actuators/modal_io/Kconfig
```kconfig
menuconfig DRIVERS_ACTUATORS_MODAL_IO
	bool "modal_io"
	default n
	---help---
		Enable support for modal_io
```

## src/drivers/actuators/modal_pwm/Kconfig
```kconfig
menuconfig DRIVERS_ACTUATORS_MODAL_PWM
	bool "modal_pwm"
	default n
	---help---
		Enable support for modal_pwm
```

## src/drivers/actuators/modalai_esc/Kconfig
```kconfig
menuconfig DRIVERS_ACTUATORS_MODALAI_ESC
	bool "modalai_esc"
	default n
	---help---
		Enable support for modalai_esc
```

## src/drivers/actuators/rudder/Kconfig
```kconfig
menuconfig DRIVERS_ACTUATORS_RUDDER
	bool "rudder"
	default n
	---help---
		Enable support for rudder
```

## src/drivers/actuators/vertiq_io/Kconfig
```kconfig
menuconfig DRIVERS_ACTUATORS_VERTIQ_IO
	bool "vertiq_io"
	default n
	---help---
		Enable support for vertiq_io

if DRIVERS_ACTUATORS_VERTIQ_IO
	config USE_IFCI_CONFIGURATION
	bool "Include IFCI Configuration Parameters"
	default n

	if USE_IFCI_CONFIGURATION
		config USE_PULSING_CONFIGURATION
		bool "Include Pulsing Module Configuration Parameters"
		default n
	endif
endif
```
