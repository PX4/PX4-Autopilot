## CMakeLists.txt
```
cmake_minimum_required(VERSION 3.20.0)

find_package(Zephyr REQUIRED HINTS $ENV{ZEPHYR_BASE})
project(px4_zephyr)

target_sources(app PRIVATE src/main.c)
```

## sample.yaml
```
sample:
  name: PX4 Autopilot
  description: PX4 running on Zephyr
common:
  tags:
    - px4
tests:
  px4.app:
    platform_allow:
      - mps2/an386
    integration_platforms:
      - mps2/an386
    harness: console
    harness_config:
      type: multi_line
      ordered: true
      regex:
        - "HW arch: ZEPHYR_GENERIC"
        - "OS: Zephyr"
  px4.app.sih:
    platform_allow:
      - mps2/an386
    integration_platforms:
      - mps2/an386
    extra_args:
      - FILE_SUFFIX=sih
    timeout: 600
    harness: pytest
    harness_config:
      pytest_root:
        - "pytest/test_sih.py"
```

## prj.conf
```kconfig
CONFIG_PX4=y
CONFIG_SHELL=y
CONFIG_LOG=y
```

## prj_sih.conf
```kconfig
CONFIG_PX4=y
CONFIG_SHELL=y
CONFIG_LOG=y
CONFIG_PX4_BOARD_CONFIG="zephyr_generic_sih"
CONFIG_HEAP_MEM_POOL_SIZE=1048576

CONFIG_NETWORKING=y
CONFIG_ETH_DRIVER=y
CONFIG_NET_IPV4=y
CONFIG_NET_IPV6=n
CONFIG_NET_UDP=y
CONFIG_NET_SOCKETS=y
CONFIG_NET_CONTEXT_SNDTIMEO=y
CONFIG_XSI_STREAMS=y
```

## boards/mps2_an386_sih.conf
```kconfig
# a 250 MHz CPU, the speed of a flight controller
CONFIG_QEMU_ICOUNT=y
CONFIG_QEMU_ICOUNT_SHIFT=2

CONFIG_TEST_RANDOM_GENERATOR=y

# QEMU user networking, where the host is 10.0.2.2
CONFIG_NET_L2_ETHERNET=y
CONFIG_NET_QEMU_USER=y
CONFIG_NET_CONFIG_SETTINGS=y
CONFIG_NET_CONFIG_MY_IPV4_ADDR="10.0.2.15"
CONFIG_NET_CONFIG_MY_IPV4_NETMASK="255.255.255.0"
CONFIG_NET_CONFIG_MY_IPV4_GW="10.0.2.2"
```

## src/main.c
```c
/****************************************************************************
 *
 *   Copyright (c) 2026 PX4 Development Team. All rights reserved.
 *
 * Redistribution and use in source and binary forms, with or without
 * modification, are permitted provided that the following conditions
 * are met:
 *
 * 1. Redistributions of source code must retain the above copyright
 *    notice, this list of conditions and the following disclaimer.
 * 2. Redistributions in binary form must reproduce the above copyright
 *    notice, this list of conditions and the following disclaimer in
 *    the documentation and/or other materials provided with the
 *    distribution.
 * 3. Neither the name PX4 nor the names of its contributors may be
 *    used to endorse or promote products derived from this software
 *    without specific prior written permission.
 *
 * THIS SOFTWARE IS PROVIDED BY THE COPYRIGHT HOLDERS AND CONTRIBUTORS
 * "AS IS" AND ANY EXPRESS OR IMPLIED WARRANTIES, INCLUDING, BUT NOT
 * LIMITED TO, THE IMPLIED WARRANTIES OF MERCHANTABILITY AND FITNESS
 * FOR A PARTICULAR PURPOSE ARE DISCLAIMED. IN NO EVENT SHALL THE
 * COPYRIGHT OWNER OR CONTRIBUTORS BE LIABLE FOR ANY DIRECT, INDIRECT,
 * INCIDENTAL, SPECIAL, EXEMPLARY, OR CONSEQUENTIAL DAMAGES (INCLUDING,
 * BUT NOT LIMITED TO, PROCUREMENT OF SUBSTITUTE GOODS OR SERVICES; LOSS
 * OF USE, DATA, OR PROFITS; OR BUSINESS INTERRUPTION) HOWEVER CAUSED
 * AND ON ANY THEORY OF LIABILITY, WHETHER IN CONTRACT, STRICT
 * LIABILITY, OR TORT (INCLUDING NEGLIGENCE OR OTHERWISE) ARISING IN
 * ANY WAY OUT OF THE USE OF THIS SOFTWARE, EVEN IF ADVISED OF THE
 * POSSIBILITY OF SUCH DAMAGE.
 *
 ****************************************************************************/

#include <px4_zephyr.h>

int main(void)
{
	return px4_zephyr_start();
}
```
