## apps/builtin/Kconfig
```kconfig
#
# For a description of the syntax of this configuration file,
# see misc/tools/kconfig-language.txt.
#

if BUILTIN

config BUILTIN_PROXY_STACKSIZE
	int "Builtin Proxy Stack Size"
	default 1024
	---help---
		If exec_builtin uses I/O redirection options, then it will require
		an intermediary/proxy task to muck with the file descriptors.  This
		configuration item specifies the stack size used for the proxy. Default:
		1024 bytes.

endif
```

## apps/examples/Kconfig
```kconfig
#
# For a description of the syntax of this configuration file,
# see misc/tools/kconfig-language.txt.
#

source "$APPSDIR/examples/adc/Kconfig"
source "$APPSDIR/examples/buttons/Kconfig"
source "$APPSDIR/examples/can/Kconfig"
source "$APPSDIR/examples/cdcacm/Kconfig"
source "$APPSDIR/examples/composite/Kconfig"
source "$APPSDIR/examples/cxxtest/Kconfig"
source "$APPSDIR/examples/dhcpd/Kconfig"
source "$APPSDIR/examples/elf/Kconfig"
source "$APPSDIR/examples/ftpc/Kconfig"
source "$APPSDIR/examples/ftpd/Kconfig"
source "$APPSDIR/examples/hello/Kconfig"
source "$APPSDIR/examples/helloxx/Kconfig"
source "$APPSDIR/examples/json/Kconfig"
source "$APPSDIR/examples/hidkbd/Kconfig"
source "$APPSDIR/examples/keypadtest/Kconfig"
source "$APPSDIR/examples/igmp/Kconfig"
source "$APPSDIR/examples/lcdrw/Kconfig"
source "$APPSDIR/examples/mm/Kconfig"
source "$APPSDIR/examples/mount/Kconfig"
source "$APPSDIR/examples/modbus/Kconfig"
source "$APPSDIR/examples/nettest/Kconfig"
source "$APPSDIR/examples/nsh/Kconfig"
source "$APPSDIR/examples/null/Kconfig"
source "$APPSDIR/examples/nx/Kconfig"
source "$APPSDIR/examples/nxconsole/Kconfig"
source "$APPSDIR/examples/nxffs/Kconfig"
source "$APPSDIR/examples/nxflat/Kconfig"
source "$APPSDIR/examples/nxhello/Kconfig"
source "$APPSDIR/examples/nximage/Kconfig"
source "$APPSDIR/examples/nxlines/Kconfig"
source "$APPSDIR/examples/nxtext/Kconfig"
source "$APPSDIR/examples/ostest/Kconfig"
source "$APPSDIR/examples/pashello/Kconfig"
source "$APPSDIR/examples/pipe/Kconfig"
source "$APPSDIR/examples/poll/Kconfig"
source "$APPSDIR/examples/pwm/Kconfig"
source "$APPSDIR/examples/posix_spawn/Kconfig"
source "$APPSDIR/examples/qencoder/Kconfig"
source "$APPSDIR/examples/relays/Kconfig"
source "$APPSDIR/examples/rgmp/Kconfig"
source "$APPSDIR/examples/romfs/Kconfig"
source "$APPSDIR/examples/sendmail/Kconfig"
source "$APPSDIR/examples/serloop/Kconfig"
source "$APPSDIR/examples/telnetd/Kconfig"
source "$APPSDIR/examples/thttpd/Kconfig"
source "$APPSDIR/examples/tiff/Kconfig"
source "$APPSDIR/examples/touchscreen/Kconfig"
source "$APPSDIR/examples/udp/Kconfig"
source "$APPSDIR/examples/discover/Kconfig"
source "$APPSDIR/examples/uip/Kconfig"
source "$APPSDIR/examples/usbserial/Kconfig"
source "$APPSDIR/examples/usbstorage/Kconfig"
source "$APPSDIR/examples/usbterm/Kconfig"
source "$APPSDIR/examples/watchdog/Kconfig"
source "$APPSDIR/examples/wget/Kconfig"
source "$APPSDIR/examples/wgetjson/Kconfig"
source "$APPSDIR/examples/xmlrpc/Kconfig"
```

## apps/examples/adc/Kconfig
```kconfig
#
# For a description of the syntax of this configuration file,
# see misc/tools/kconfig-language.txt.
#

config EXAMPLES_ADC
	bool "ADC example"
	default n
	depends on ADC
	---help---
		Enable the ADC example

if EXAMPLES_ADC

config EXAMPLES_ADC_DEVPATH
	string "ADC device path"
	default "/dev/adc0"
	---help---
		The default path to the ADC device. Default: /dev/adc0

config EXAMPLES_ADC_NSAMPLES
	int "Number of Sample Groups"
	default 0
	depends on !NSH_BUILTIN_APPS
	---help---
		If NSH_BUILTIN_APPS is defined, then the number of samples is provided
		on the command line and this value is ignored.  Otherwise, this number
		of samples is collected and the program terminates.  Default:  0 (samples
		are collected indefinitely).

config EXAMPLES_ADC_GROUPSIZE
	int "Number of Samples per Group"
	default 4
	---help---
		The number of samples to read at once. Default: 4

endif
```

## apps/examples/buttons/Kconfig
```kconfig
#
# For a description of the syntax of this configuration file,
# see misc/tools/kconfig-language.txt.
#

config EXAMPLES_BUTTONS
	bool "Buttons example"
	default n
	---help---
		Enable the buttons example.  May require ARCH_BUTTONS on some boards.

if EXAMPLES_BUTTONS
config EXAMPLES_BUTTONS_MIN
int "Lowest Button Number"
default 0

config EXAMPLES_BUTTONS_MAX
int "Highest Button Number"
default 7

if ARCH_IRQBUTTONS 
config EXAMPLES_IRQBUTTONS_MIN
int "Lowest Interrupting Button Number"
default 0

config EXAMPLES_IRQBUTTONS_MAX
int "Highest Interrupting Button Number"
default 7

config EXAMPLES_BUTTONS_NAME0
string "Button 0 Name"
default "Button 0"

config EXAMPLES_BUTTONS_NAME1
string "Button 1 Name"
default "Button 1"

config EXAMPLES_BUTTONS_NAME2
string "Button 2 Name"
default "Button 2"

config EXAMPLES_BUTTONS_NAME3
string "Button 3 Name"
default "Button 3"

config EXAMPLES_BUTTONS_NAME4
string "Button 4 Name"
default "Button 4"

config EXAMPLES_BUTTONS_NAME5
string "Button 5 Name"
default "Button 5"

config EXAMPLES_BUTTONS_NAME6
string "Button 6 Name"
default "Button 6"

config EXAMPLES_BUTTONS_NAME7
string "Button 7 Name"
default "Button 7"

endif
endif
```

## apps/examples/can/Kconfig
```kconfig
#
# For a description of the syntax of this configuration file,
# see misc/tools/kconfig-language.txt.
#

config EXAMPLES_CAN
	bool "CAN example"
	default n
	---help---
		Enable the CAN example

if EXAMPLES_CAN
endif
```

## apps/examples/cdcacm/Kconfig
```kconfig
#
# For a description of the syntax of this configuration file,
# see misc/tools/kconfig-language.txt.
#

config EXAMPLES_CDCACM
	bool "CAN example"
	default n
	---help---
		Enable the USB CDC/ACM class driver example

if EXAMPLES_CDCACM
endif
```

## apps/examples/composite/Kconfig
```kconfig
#
# For a description of the syntax of this configuration file,
# see misc/tools/kconfig-language.txt.
#

config EXAMPLES_COMPOSITE
	bool "USB composite class driver example"
	default n
	---help---
		Enable the USB compsite class driver example

if EXAMPLES_COMPOSITE
endif
```

## apps/examples/cxxtest/Kconfig
```kconfig
#
# For a description of the syntax of this configuration file,
# see misc/tools/kconfig-language.txt.
#

config EXAMPLES_CXXTEST
	bool "C++ test program"
	default n
	depends on HAVE_CXX
	---help---
		Enable the C++ test program

if EXAMPLES_CXXTEST
endif
```

## apps/examples/dhcpd/Kconfig
```kconfig
#
# For a description of the syntax of this configuration file,
# see misc/tools/kconfig-language.txt.
#

config EXAMPLES_DHCPD
	bool "DHCP server example"
	default n
	---help---
		Enable the DHCP server example

if EXAMPLES_DHCPD
endif
```

## apps/examples/discover/Kconfig
```kconfig
#
# For a description of the syntax of this configuration file,
# see misc/tools/kconfig-language.txt.
#

config EXAMPLES_DISCOVER
	bool "UDP Discovery Example"
	default n
	depends on NET_UDP
	select NETUTILS_DISCOVER
	---help---
		Enable the netutils/discover utility.  This example initializes and
		starts the UDP discover daemon. This daemon is useful for
		discovering devices in local networks, especially with DHCP
		configured devices.  It listens for UDP broadcasts which also can
		include a device class so that groups of devices can be discovered.
		It is also possible to address all classes with a kind of broadcast
		discover.

config EXAMPLES_DISCOVER_DHCPC
	bool "DHCP Client"
	default n
	depends on EXAMPLES_DISCOVER && !NSH_BUILTIN_APPS
	select NETUTILS_DHCPC
	select NETUTILS_RESOLV

config EXAMPLES_DISCOVER_NOMAC
	bool "Use Canned MAC Address"
	default n
	depends on EXAMPLES_DISCOVER && !NSH_BUILTIN_APPS

config EXAMPLES_DISCOVER_IPADDR
	hex "Target IP address"
	default 0x0a000002
	depends on EXAMPLES_DISCOVER && !NSH_BUILTIN_APPS && !EXAMPLES_DISCOVER_DHCPC

config EXAMPLES_DISCOVER_DRIPADDR
	hex "Default Router IP address (Gateway)"
	default 0x0a000001
	depends on EXAMPLES_DISCOVER && !NSH_BUILTIN_APPS

config EXAMPLES_DISCOVER_NETMASK
	hex "Network Mask"
	default 0xffffff00
	depends on EXAMPLES_DISCOVER && !NSH_BUILTIN_APPS
```

## apps/examples/elf/Kconfig
```kconfig
#
# For a description of the syntax of this configuration file,
# see misc/tools/kconfig-language.txt.
#

config EXAMPLES_ELF
	bool "ELF Loader Example"
	default n
	---help---
		Enable the ELF loader example

if EXAMPLES_ELF
config EXAMPLES_ELF_DEVMINOR
	int "ROMFS Minor Device Number"
	default 0
	---help---
		The minor device number of the ROMFS block. For example, the N in /dev/ramN.
		Used for registering the RAM block driver that will hold the ROMFS file system
		containing the ELF executables to be tested.  Default: 0

config EXAMPLES_ELF_DEVPATH
	string "ROMFS Devie Path"
	default "/dev/ram0"
	---help---
		The path to the ROMFS block driver device.  This must match EXAMPLES_ELF_DEVMINOR.
		Used for registering the RAM block driver that will hold the ROMFS file system
		containing the ELF executables to be tested.  Default: "/dev/ram0"

endif
```

## apps/examples/ftpc/Kconfig
```kconfig
#
# For a description of the syntax of this configuration file,
# see misc/tools/kconfig-language.txt.
#

config EXAMPLES_FTPC
	bool "FTP client example"
	default n
	---help---
		Enable the FTP client example

if EXAMPLES_FTPC
endif
```

## apps/examples/ftpd/Kconfig
```kconfig
#
# For a description of the syntax of this configuration file,
# see misc/tools/kconfig-language.txt.
#

config EXAMPLES_FTPD
	bool "FTP server example"
	default n
	---help---
		Enable the FTP server example

if EXAMPLES_FTPD
endif
```

## apps/examples/hello/Kconfig
```kconfig
#
# For a description of the syntax of this configuration file,
# see misc/tools/kconfig-language.txt.
#

config EXAMPLES_HELLO
	bool "\"Hello, World!\" example"
	default n
	---help---
		Enable the \"Hello, World!\" example

if EXAMPLES_HELLO
endif
```

## apps/examples/helloxx/Kconfig
```kconfig
#
# For a description of the syntax of this configuration file,
# see misc/tools/kconfig-language.txt.
#

config EXAMPLES_HELLOXX
	bool "\"Hello, World!\" C++ example"
	default n
	---help---
		Enable the \"Hello, World!\" C++ example

if EXAMPLES_HELLOXX
endif
```

## apps/examples/hidkbd/Kconfig
```kconfig
#
# For a description of the syntax of this configuration file,
# see misc/tools/kconfig-language.txt.
#

config EXAMPLES_HIDKBD
	bool "USB HID keyboard example"
	default n
	---help---
		Enable the USB HID keyboard example

if EXAMPLES_HIDKBD

config EXAMPLES_HIDKBD_DEFPRIO
	int "Waiter Thread Priority"
	default 50
	---help---
		Priority of "waiter" thread.  Default: 50

config EXAMPLES_HIDKBD_STACKSIZE
	int "Waiter Thread Stack Size"
	default 1024
	---help---
		Stacksize of "waiter" thread. Default 1024

config EXAMPLES_HIDKBD_DEVNAME
	string "Keyboard Device Name"
	default "/dev/kbda"
	---help---
		Name of keyboard device to be used. Default: "/dev/kbda"

config EXAMPLES_HIDKBD_ENCODED
	bool "Encode Special Keys"
	default y
	depends on HIDKBD_ENCODED && LIB_KBDCODEC
	---help---
		Decode special key press events in the user buffer.  In this case,
		the example coded will use the interfaces defined in
		include/nuttx/input/kbd_codec.h to decode the returned keyboard
		data.  These special keys include such things as up/down arrows,
		home and end keys, etc.  If this not defined, only 7-bit print-able
		and control ASCII characters will be provided to the user.

endif
```

## apps/examples/igmp/Kconfig
```kconfig
#
# For a description of the syntax of this configuration file,
# see misc/tools/kconfig-language.txt.
#

config EXAMPLES_IGMP
	bool "IGMP example"
	default n
	---help---
		Enable the IGMP example

if EXAMPLES_IGMP
endif
```

## apps/examples/json/Kconfig
```kconfig
#
# For a description of the syntax of this configuration file,
# see misc/tools/kconfig-language.txt.
#

config EXAMPLES_JSON
	bool "JSON example"
	default n
	select NETUTILS_JSON
	---help---
		An example for the netutils/json library.

if EXAMPLES_JSON
endif
```

## apps/examples/keypadtest/Kconfig
```kconfig
#
# For a description of the syntax of this configuration file,
# see misc/tools/kconfig-language.txt.
#

config EXAMPLES_KEYPADTEST
	bool "Keypad test example program"
	default n
	---help---
		Enable the Keypad test example programe

if EXAMPLES_KEYPADTEST

	config EXAMPLES_KEYPAD_DEVNAME
	string "Keypad Device Name"
	default "/dev/keypad"
	---help---
		The name of the keypad device that will be opened in order to perform
		the keypad test.  Default: "/dev/keypad"

config EXAMPLES_KEYPADTEST_ENCODED
	bool "Use Keyboard CODEC"
	default n
	---help---
		Use the keyboard encoded/decoder to pass control information from
		the keypad driver to the keypad test.  This is the keyboard CODEC
		defined in nuttx/input/kbd_codec.h.

endif
```
