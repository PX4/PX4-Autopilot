## Kconfig
```kconfig
# PX4 Firmware Configuration


mainmenu "PX4 Firmware Configuration"

comment "Vendor: $(VENDOR)"
comment "Model: $(MODEL)"
comment "Label: $(LABEL)"

menu "Toolchain"
    choice
        prompt "Platform"
        default PLATFORM_NUTTX
        config PLATFORM_NUTTX
            bool "nuttx"
        config PLATFORM_POSIX
            bool "posix"
        config PLATFORM_QURT
            bool "qurt"
        config PLATFORM_ROS2
            bool "ros2"
    endchoice

    config BOARD_PLATFORM
        string
        default "nuttx" if PLATFORM_NUTTX
        default "posix" if PLATFORM_POSIX
        default "qurt" if PLATFORM_QURT
        default "ros2" if PLATFORM_ROS2

    config BOARD_LOCKSTEP
        bool "Force enable lockstep"
        depends on PLATFORM_POSIX
        help
            forces lockstep behaviour, despite REPLAY env variable

    config BOARD_NOLOCKSTEP
        bool "Force disable lockstep"
        depends on PLATFORM_POSIX
        help
            forces nolockstep behaviour, despite REPLAY env variable

    config BOARD_LINUX_TARGET
        bool "Linux OS Target"
        depends on PLATFORM_POSIX
        help
            Board Platform is running the Linux operating system

    config BOARD_TOOLCHAIN
        string "Toolchain"
        default ""

    config BOARD_ARCHITECTURE
        string "Architecture"
        default ""

    config BOARD_LTO
        bool "(EXPERIMENTAL) Link Time Optimization (LTO)"
        default n
        help
            Enables LTO flag in linker
            Note: Highly EXPERIMENTAL, furthermore make sure you're using a modern compiler GCC 9 or later

    config BOARD_FULL_OPTIMIZATION
        bool "Full optmization (O3)"
        default n
        help
            Enables Cmake Release for -O3 optimization

    config BOARD_ROMFSROOT
        string "ROMFSROOT"
        default "px4fmu_common"
        help
            relative path to the ROMFS root directory

    config BOARD_IO
        string "IO board name"
        default "px4_io-v2_default"
        depends on DRIVERS_PX4IO
        help
            name of IO board to be built and included in the ROMFS (requires a valid ROMFSROOT)

    config BOARD_CONSTRAINED_FLASH
        bool "Contrained flash"
        help
            flag to enable constrained flash options (eg limit init script status text)

    config BOARD_NO_HELP
        bool "No help"
        help
            optional condition flag to disable help text on constrained flash systems

    config BOARD_CONSTRAINED_MEMORY
        bool "Contrained memory"
        help
            flag to enable constrained memory options (eg limit maximum number of uORB publications)

    config BOARD_EXTERNAL_METADATA
        bool "External metadata"
        help
            flag to exclude metadata to reduce flash

    config BOARD_LINKER_PREFIX
        string "linker prefix"
        help
            optional to prefix on the Linker script.

    config BOARD_COMPILE_DEFINITIONS
        string "add custom compile definitions"
        help
            add custom compile defitions to this specific target
endmenu #Toolchain

config BOARD_TESTING
    bool "Testing"
    select SYSTEMCMDS_TESTS
    help
        flag to enable automatic inclusion of PX4 testing modules


config BOARD_ETHERNET
    bool "Ethernet"
    help
        flag to indicate that ethernet is enabled

config BOARD_CRYPTO
    bool "Crypto support"
    help
        Enable PX4 Crypto Support. Select the implementation under drivers

config BOARD_PROTECTED
    bool "Memory protection"
    help
        Enable memory protection via MPU/MMU

menu "Serial ports"

    config BOARD_SERIAL_URT6
        string "URT6 tty port"

    config BOARD_SERIAL_GPS1
        string "GPS1 tty port"

    config BOARD_SERIAL_GPS2
        string "GPS2 tty port"

    config BOARD_SERIAL_GPS3
        string "GPS3 tty port"

    config BOARD_SERIAL_GPS4
        string "GPS4 tty port"

    config BOARD_SERIAL_GPS5
        string "GPS5 tty port"

    config BOARD_SERIAL_TEL1
        string "TEL1 tty port"

    config BOARD_SERIAL_TEL2
        string "TEL2 tty port"

    config BOARD_SERIAL_TEL3
        string "TEL3 tty port"

    config BOARD_SERIAL_TEL4
        string "TEL4 tty port"

    config BOARD_SERIAL_TEL5
        string "TEL5 tty port"

    config BOARD_SERIAL_RC
        string "RC tty port"

    config BOARD_SERIAL_WIFI
        string "WIFI tty port"

    config BOARD_SERIAL_EXT2
        string "EXT2 tty port"
endmenu

menu "File paths"

    config BOARD_ROOT_PATH
        string "PX4 Root file path"
        default "/fs/microsd"

    config BOARD_PARAM_FILE
        string "Parameter file"
        default "/fs/mtd_params"
endmenu

menu "drivers"
source "src/drivers/Kconfig"
endmenu

menu "modules"
source "src/modules/Kconfig"
endmenu

menu "systemcmds"
source "src/systemcmds/Kconfig"
endmenu

menu "examples"
source "src/examples/Kconfig"
endmenu

menu "platforms"
depends on PLATFORM_QURT || PLATFORM_POSIX
source "platforms/common/Kconfig"
endmenu

source "src/lib/*/Kconfig"
```

## Kconfig.target_classes
```kconfig
# Target classes
#
# A target class bundles the controllers (and, for some classes, the platform /
# ROMFS / drivers) that define a build's "shape". The membership lives in the
# class base fragment target_classes/<class>.px4board as explicit CONFIG_* lines;
# cmake merges that fragment by class name (see cmake/kconfig.cmake).
#
# These CONFIG_TARGET_CLASS_<X> symbols are the declarative tag the class base
# sets to name itself. They keep the class visible in the resolved config and are
# available to ROMFS/tooling, but they do NOT pull modules in -- the controllers
# are the fragment's explicit CONFIG_MODULES_*=y lines, so module Kconfigs stay
# class-agnostic. A board drops a class controller with a plain
# `# CONFIG_MODULES_X is not set` line in its overlay (the fragment's =y is
# overridden on merge).

menu "Target classes"

config TARGET_CLASS_COPTER
	bool "Copter target class"
	help
		Multicopter controllers. Set by target_classes/copter.px4board.

config TARGET_CLASS_PLANE
	bool "Plane target class"
	help
		Fixed-wing controllers. Set by target_classes/plane.px4board.

config TARGET_CLASS_VTOL
	bool "VTOL target class"
	help
		Air superset: multicopter + fixed-wing + VTOL controllers, one binary.

config TARGET_CLASS_ROVER
	bool "Rover target class"
	help
		Rover controllers (differential + ackermann + mecanum).

config TARGET_CLASS_UUV
	bool "Underwater (UUV) target class"
	help
		Unmanned underwater vehicle controllers.

config TARGET_CLASS_SPACECRAFT
	bool "Spacecraft target class"

config TARGET_CLASS_AIRSHIP
	bool "Airship target class"

config TARGET_CLASS_CANNODE
	bool "CAN node target class"
	help
		UAVCAN node: cannode ROMFS + uavcannode driver, no vehicle controllers.

config TARGET_CLASS_LINUX
	bool "Linux SBC flight controller target class"
	help
		One all-vehicle binary cross-compiled for a Linux SBC, runtime-selecting
		its airframe via init.d-posix. The class base provides the mc+fw+vtol+uuv
		controllers and the POSIX/Linux platform (PLATFORM_POSIX + BOARD_LINUX_TARGET).

config TARGET_CLASS_SITL
	bool "SITL simulator target class"
	help
		Software-in-the-loop simulator. The class base provides the POSIX
		platform and the full controller set, runtime-selecting its airframe
		via init.d-posix.

config TARGET_CLASS_IO
	bool "PX4IO coprocessor firmware target class"
	help
		PX4IO I/O coprocessor firmware blob (no ROMFS, no vehicle controllers).
		The class base provides MODULES_PX4IOFIRMWARE.

config TARGET_CLASS_ROS2
	bool "ROS2 platform target class"
	help
		ROS2 platform build (PLATFORM_ROS2), built within a colcon workspace.

endmenu
```
